/dts-v1/;

/ {
	model = "MT6768";
	compatible = "mediatek,MT6768";
	interrupt-parent = <0x01>;
	#address-cells = <0x02>;
	#size-cells = <0x02>;

	chosen {
		bootargs = "root=/dev/ram vmalloc=400M slub_debug=OFZPU swiotlb=noforce cgroup.memory=nosocket,nokmem firmware_class.path=/vendor/firmware page_owner=on loop.max_part=16";
		kaslr-seed = <0x00 0x00>;
		phandle = <0x66>;
	};

	cpus {
		#address-cells = <0x01>;
		#size-cells = <0x00>;

		cpu@000 {
			device_type = "cpu";
			compatible = "arm,cortex-a55";
			reg = <0x00>;
			enable-method = "psci";
			clock-frequency = <0x65633340>;
			cpu-idle-states = <0x02 0x03 0x04 0x05 0x06 0x07 0x08>;
			phandle = <0x09>;
		};

		cpu@001 {
			device_type = "cpu";
			compatible = "arm,cortex-a55";
			reg = <0x100>;
			enable-method = "psci";
			clock-frequency = <0x65633340>;
			cpu-idle-states = <0x02 0x03 0x04 0x05 0x06 0x07 0x08>;
			phandle = <0x0a>;
		};

		cpu@002 {
			device_type = "cpu";
			compatible = "arm,cortex-a55";
			reg = <0x200>;
			enable-method = "psci";
			clock-frequency = <0x65633340>;
			cpu-idle-states = <0x02 0x03 0x04 0x05 0x06 0x07 0x08>;
			phandle = <0x0b>;
		};

		cpu@003 {
			device_type = "cpu";
			compatible = "arm,cortex-a55";
			reg = <0x300>;
			enable-method = "psci";
			clock-frequency = <0x65633340>;
			cpu-idle-states = <0x02 0x03 0x04 0x05 0x06 0x07 0x08>;
			phandle = <0x0c>;
		};

		cpu@100 {
			device_type = "cpu";
			compatible = "arm,cortex-a55";
			reg = <0x400>;
			enable-method = "psci";
			clock-frequency = <0x65633340>;
			cpu-idle-states = <0x02 0x03 0x04 0x05 0x06 0x07 0x08>;
			phandle = <0x0d>;
		};

		cpu@101 {
			device_type = "cpu";
			compatible = "arm,cortex-a55";
			reg = <0x500>;
			enable-method = "psci";
			clock-frequency = <0x65633340>;
			cpu-idle-states = <0x02 0x03 0x04 0x05 0x06 0x07 0x08>;
			phandle = <0x0e>;
		};

		cpu@102 {
			device_type = "cpu";
			compatible = "arm,cortex-a75";
			reg = <0x600>;
			enable-method = "psci";
			clock-frequency = <0x8166d4c0>;
			cpu-idle-states = <0x02 0x03 0x04 0x05 0x06 0x07 0x08>;
			phandle = <0x0f>;
		};

		cpu@103 {
			device_type = "cpu";
			compatible = "arm,cortex-a75";
			reg = <0x700>;
			enable-method = "psci";
			clock-frequency = <0x8166d4c0>;
			cpu-idle-states = <0x02 0x03 0x04 0x05 0x06 0x07 0x08>;
			phandle = <0x10>;
		};

		cpu-map {

			cluster0 {

				core0 {
					cpu = <0x09>;
				};

				core1 {
					cpu = <0x0a>;
				};

				core2 {
					cpu = <0x0b>;
				};

				core3 {
					cpu = <0x0c>;
				};

				core4 {
					cpu = <0x0d>;
				};

				core5 {
					cpu = <0x0e>;
				};

				doe {
					phandle = <0x67>;
				};
			};

			cluster1 {

				core0 {
					cpu = <0x0f>;
				};

				core1 {
					cpu = <0x10>;
				};

				doe {
					phandle = <0x68>;
				};
			};
		};

		idle-states {
			entry-method = "arm,psci";

			standby {
				compatible = "arm,idle-state";
				arm,psci-suspend-param = <0x01>;
				entry-latency-us = <0x258>;
				exit-latency-us = <0x258>;
				min-residency-us = <0x4b0>;
				phandle = <0x02>;
			};

			mcdi-cpu {
				compatible = "arm,idle-state";
				arm,psci-suspend-param = <0x10001>;
				entry-latency-us = <0x258>;
				exit-latency-us = <0x258>;
				min-residency-us = <0x4b0>;
				phandle = <0x03>;
			};

			mcdi-cluster {
				compatible = "arm,idle-state";
				arm,psci-suspend-param = <0x1010001>;
				entry-latency-us = <0x258>;
				exit-latency-us = <0x258>;
				min-residency-us = <0x4b0>;
				phandle = <0x04>;
			};

			idledram {
				compatible = "arm,idle-state";
				arm,psci-suspend-param = <0x1010002>;
				entry-latency-us = <0x320>;
				exit-latency-us = <0x3e8>;
				min-residency-us = <0x7d0>;
				status = "okay";
				phandle = <0x05>;
			};

			idlesyspll {
				compatible = "arm,idle-state";
				arm,psci-suspend-param = <0x1010003>;
				entry-latency-us = <0x320>;
				exit-latency-us = <0x3e8>;
				min-residency-us = <0x7d0>;
				status = "okay";
				phandle = <0x06>;
			};

			idlebus26m {
				compatible = "arm,idle-state";
				arm,psci-suspend-param = <0x1010004>;
				entry-latency-us = <0x320>;
				exit-latency-us = <0x3e8>;
				min-residency-us = <0x7d0>;
				status = "okay";
				phandle = <0x07>;
			};

			suspend {
				compatible = "arm,idle-state";
				arm,psci-suspend-param = <0x1010005>;
				entry-latency-us = <0x320>;
				exit-latency-us = <0x3e8>;
				min-residency-us = <0x7d0>;
				phandle = <0x08>;
			};
		};
	};

	cache_parity {
		compatible = "mediatek,cache_parity";
		version = <0x01>;
		reg = <0x00 0xc530000 0x00 0x10000>;
		err_level = <0x01>;
		irq_config = <0x00 0x8090 0xff00 0x8090 0x44 0x8090 0xff 0x01 0x8090 0xff00 0x8090 0x44 0x8090 0xff 0x02 0x8090 0xff00 0x8090 0x44 0x8090 0xff 0x03 0x8090 0xff00 0x8090 0x44 0x8090 0xff 0x04 0x8090 0xff00 0x8090 0x44 0x8090 0xff 0x05 0x8090 0xff00 0x8090 0x44 0x8090 0xff 0x06 0x8090 0xff00 0x8090 0x44 0x8090 0xff 0x07 0x8090 0xff00 0x8090 0x44 0x8090 0xff 0x400 0xc8c0 0x1000000 0xc8c0 0x0c 0xc8c8 0x01>;
		interrupts = <0x00 0x16 0x04 0x00 0x17 0x04 0x00 0x18 0x04 0x00 0x19 0x04 0x00 0x1a 0x04 0x00 0x1b 0x04 0x00 0x1c 0x04 0x00 0x1d 0x04 0x00 0x13 0x04>;
	};

	memory {
		device_type = "memory";
		reg = <0x00 0x40000000 0x00 0x3e605000>;
	};

	psci {
		compatible = "arm,psci-1.0";
		method = "smc";
	};

	mobicore {
		compatible = "trustonic,mobicore";
		interrupts = <0x00 0x129 0x01>;
	};

	tee_sanity {
		compatible = "mediatek,tee_sanity";
		interrupts = <0x00 0x12a 0x01>;
	};

	utos {
		compatible = "microtrust,utos";
		interrupts = <0x00 0x12b 0x01 0x00 0x12c 0x01>;
	};

	utos_tester {
		compatible = "microtrust,tester-v1";
	};

	pmu {
		compatible = "arm,armv8-pmuv3";
		interrupt-parent = <0x11>;
		interrupts = <0x01 0x07 0x08>;
	};

	dsu-pmu-0 {
		compatible = "arm,dsu-pmu";
		interrupts = <0x00 0x12 0x04>;
		cpus = <0x09 0x0a 0x0b 0x0c 0x0d 0x0e 0x0f 0x10>;
	};

	reserved-memory {
		#address-cells = <0x02>;
		#size-cells = <0x02>;
		ranges;
		phandle = <0x69>;

		zmc-default {
			compatible = "mediatek,zone_movable_cma";
			size = <0x00 0x2d000000>;
			alignment = <0x00 0x1000000>;
			alloc-ranges = <0x00 0xc0000000 0x04 0x00>;
		};

		reserve-memory-sspm_share {
			compatible = "mediatek,reserve-memory-sspm_share";
			no-map;
			status = "okay";
			size = <0x00 0x510000>;
			alignment = <0x00 0x10000>;
			alloc-ranges = <0x00 0x40000000 0x00 0x60000000>;
		};

		reserve-memory-scp_share {
			compatible = "mediatek,reserve-memory-scp_share";
			no-map;
			size = <0x00 0x300000>;
			alignment = <0x00 0x1000000>;
			alloc-ranges = <0x00 0x40000000 0x00 0x50000000>;
		};

		ion-carveout-heap {
			compatible = "mediatek,ion-carveout-heap";
			no-map;
			size = <0x00 0x9000>;
			alignment = <0x00 0x1000>;
			alloc-ranges = <0x00 0xc0000000 0x04 0x00>;
		};

		consys-reserve-memory {
			compatible = "mediatek,consys-reserve-memory";
			no-map;
			size = <0x00 0x400000>;
			alignment = <0x00 0x1000000>;
			alloc-ranges = <0x00 0x40000000 0x00 0x80000000>;
		};

		wifi-reserve-memory {
			compatible = "shared-dma-pool";
			no-map;
			size = <0x00 0x300000>;
			alignment = <0x00 0x1000000>;
			alloc-ranges = <0x00 0x40000000 0x00 0x80000000>;
			phandle = <0x5f>;
		};

		soter-shared-mem {
			compatible = "microtrust,shared_mem";
			no-map;
			size = <0x00 0xc00000>;
			alignment = <0x00 0x1000000>;
			alloc-ranges = <0x00 0x40000000 0x00 0x50000000>;
		};
	};

	cpu_dbgapb@0e010000 {
		compatible = "mediatek,hw_dbg";
		num = <0x08>;
		reg = <0x00 0xe010000 0x00 0x1000 0x00 0xe110000 0x00 0x1000 0x00 0xe210000 0x00 0x1000 0x00 0xe310000 0x00 0x1000 0x00 0xe410000 0x00 0x1000 0x00 0xe510000 0x00 0x1000 0x00 0xe610000 0x00 0x1000 0x00 0xe710000 0x00 0x1000>;
		phandle = <0x6a>;
	};

	interrupt-controller {
		compatible = "arm,gic-v3";
		#interrupt-cells = <0x03>;
		#address-cells = <0x02>;
		#size-cells = <0x02>;
		#redistributor-regions = <0x01>;
		interrupt-parent = <0x11>;
		interrupt-controller;
		reg = <0x00 0xc000000 0x00 0x40000 0x00 0xc040000 0x00 0x200000 0x00 0xc53a650 0x00 0x50>;
		interrupts = <0x01 0x09 0x04>;
		phandle = <0x11>;
	};

	intpol-controller@0 {
		compatible = "mediatek,mt6577-sysirq";
		interrupt-controller;
		#interrupt-cells = <0x03>;
		interrupt-parent = <0x11>;
		reg = <0x00 0xc53a650 0x00 0x50>;
		phandle = <0x01>;
	};

	chipid@08000000 {
		compatible = "mediatek,chipid";
		reg = <0x00 0x8000000 0x00 0x04 0x00 0x8000004 0x00 0x04 0x00 0x8000008 0x00 0x04 0x00 0x800000c 0x00 0x04>;
	};

	timer {
		compatible = "arm,armv8-timer";
		interrupt-parent = <0x11>;
		interrupts = <0x01 0x0d 0x08 0x01 0x0e 0x08 0x01 0x0b 0x08 0x01 0x0a 0x08>;
		clock-frequency = <0xc65d40>;
		phandle = <0x6b>;
	};

	infracfg_ao@10001000 {
		compatible = "mediatek,infracfg_ao", "syscon";
		reg = <0x00 0x10001000 0x00 0x1000>;
		interrupts = <0x00 0x47 0x01>;
		#clock-cells = <0x01>;
		phandle = <0x21>;
	};

	scpsys@10001000 {
		compatible = "mediatek,scpsys", "syscon";
		reg = <0x00 0x10001000 0x00 0x1000 0x00 0x10006000 0x00 0x1000 0x00 0x14002000 0x00 0x1000 0x00 0x1020e000 0x00 0x1000 0x00 0x18004000 0x00 0x1000 0x00 0x18002000 0x00 0x1000 0x00 0x10000000 0x00 0x1000 0x00 0x16000000 0x00 0x1000 0x00 0x16025000 0x00 0x1000>;
		#clock-cells = <0x01>;
		phandle = <0x22>;
	};

	mcdi@0010fc00 {
		compatible = "mediatek,mt6768-mcdi";
		mediatek,enabled = <0x01>;
		reg = <0x00 0x10fc00 0x00 0x800 0x00 0xc53a000 0x00 0x1000>;
		phandle = <0x6c>;
	};

	scp@10500000 {
		compatible = "mediatek,scp";
		status = "okay";
		reg = <0x00 0x10500000 0x00 0x80000 0x00 0x105c0000 0x00 0x3000 0x00 0x105c4000 0x00 0x1000 0x00 0x105d4000 0x00 0x6000>;
		interrupts = <0x00 0xcd 0x04>;
		core_1 = "enable";
		scp_sramSize = <0x80000>;
	};

	scp_dvfs {
		compatible = "mediatek,scp_dvfs";
		clocks = <0x12 0x53 0x13 0x12 0x0e 0x12 0x1a 0x12 0x02 0x12 0x17 0x12 0x06 0x12 0x19>;
		clock-names = "clk_mux", "clk_pll_0", "clk_pll_1", "clk_pll_2", "clk_pll_3", "clk_pll_4", "clk_pll_5", "clk_pll_6";
	};

	topckgen@10000000 {
		compatible = "mediatek,topckgen", "syscon";
		reg = <0x00 0x10000000 0x00 0x1000>;
		#clock-cells = <0x01>;
		phandle = <0x12>;
	};

	io_cfg_lt@10002000 {
		compatible = "mediatek,io_cfg_lt";
		reg = <0x00 0x10002000 0x00 0x200>;
		phandle = <0x15>;
	};

	io_cfg_lm@10002200 {
		compatible = "mediatek,io_cfg_lm";
		reg = <0x00 0x10002200 0x00 0x200>;
		phandle = <0x16>;
	};

	io_cfg_lb@10002400 {
		compatible = "mediatek,io_cfg_lb";
		reg = <0x00 0x10002400 0x00 0x200>;
		phandle = <0x17>;
	};

	io_cfg_bl@10002600 {
		compatible = "mediatek,io_cfg_bl";
		reg = <0x00 0x10002600 0x00 0x200>;
		phandle = <0x18>;
	};

	io_cfg_rm@10002800 {
		compatible = "mediatek,io_cfg_rm";
		reg = <0x00 0x10002800 0x00 0x200>;
		phandle = <0x19>;
	};

	io_cfg_rb@10002a00 {
		compatible = "mediatek,io_cfg_rb";
		reg = <0x00 0x10002a00 0x00 0x200>;
		phandle = <0x1a>;
	};

	io_cfg_rt@10002c00 {
		compatible = "mediatek,io_cfg_rt";
		reg = <0x00 0x10002c00 0x00 0x200>;
		phandle = <0x1b>;
	};

	io_cfg_tl@10002e00 {
		compatible = "mediatek,io_cfg_tl";
		reg = <0x00 0x10002e00 0x00 0x200>;
		phandle = <0x1c>;
	};

	pericfg@10003000 {
		compatible = "mediatek,pericfg", "syscon";
		reg = <0x00 0x10003000 0x00 0x1000>;
		#clock-cells = <0x01>;
		phandle = <0x6d>;
	};

	efuse_dbg@10004000 {
		compatible = "mediatek,efuse_dbg";
		reg = <0x00 0x10004000 0x00 0x1000>;
	};

	gpio@10005000 {
		compatible = "mediatek,gpio";
		reg = <0x00 0x10005000 0x00 0x1000>;
		phandle = <0x14>;
	};

	pinctrl {
		compatible = "mediatek,mt6768-pinctrl";
		reg_bases = <0x14 0x15 0x16 0x17 0x18 0x19 0x1a 0x1b 0x1c>;
		reg_base_eint = <0x1d>;
		pins-are-numbered;
		gpio-controller;
		gpio-ranges = <0x1e 0x00 0x00 0xba>;
		#gpio-cells = <0x02>;
		interrupt-controller;
		interrupts = <0x00 0xba 0x04>;
		#interrupt-cells = <0x04>;
		phandle = <0x1e>;

		aud_clk_mosi_off {
			phandle = <0x3f>;

			pins_cmd0_dat {
				pinmux = <0x8800 0x8900>;
			};
		};

		aud_clk_mosi_on {
			phandle = <0x40>;

			pins_cmd0_dat {
				pinmux = <0x8801>;
				input-schmitt-enable;
			};

			pins_cmd1_dat {
				pinmux = <0x8901>;
				input-schmitt-enable;
			};
		};

		aud_clk_miso_off {
			phandle = <0x41>;

			pins_cmd0_dat {
				pinmux = <0x8c00 0x8d00>;
			};
		};

		aud_clk_miso_on {
			phandle = <0x42>;

			pins_cmd0_dat {
				pinmux = <0x8c01>;
				input-schmitt-enable;
			};

			pins_cmd1_dat {
				pinmux = <0x8d01>;
				input-schmitt-enable;
			};
		};

		aud_dat_mosi_off {
			phandle = <0x43>;

			pins_cmd0_dat {
				pinmux = <0x8800>;
				input-enable;
				slew-rate = <0x00>;
				bias-disable;
			};

			pins_cmd1_dat {
				pinmux = <0x8900>;
				input-enable;
				slew-rate = <0x00>;
				bias-disable;
			};

			pins_cmd2_dat {
				pinmux = <0x8a00>;
				input-enable;
				slew-rate = <0x00>;
				bias-disable;
			};

			pins_cmd3_dat {
				pinmux = <0x8b00>;
				input-enable;
				slew-rate = <0x00>;
				bias-pull-down;
			};
		};

		aud_dat_mosi_on {
			phandle = <0x44>;

			pins_cmd0_dat {
				pinmux = <0x8801>;
				drive-strength = <0x03>;
			};

			pins_cmd1_dat {
				pinmux = <0x8901>;
				drive-strength = <0x03>;
			};

			pins_cmd2_dat {
				pinmux = <0x8a01>;
				drive-strength = <0x03>;
			};

			pins_cmd3_dat {
				pinmux = <0x8b01>;
				drive-strength = <0x03>;
			};
		};

		aud_dat_miso_off {
			phandle = <0x45>;

			pins_cmd0_dat {
				pinmux = <0x8c00>;
				input-enable;
				slew-rate = <0x00>;
				bias-disable;
			};

			pins_cmd1_dat {
				pinmux = <0x8d00>;
				input-enable;
				slew-rate = <0x00>;
				bias-disable;
			};

			pins_cmd2_dat {
				pinmux = <0x8e00>;
				input-enable;
				slew-rate = <0x00>;
				bias-disable;
			};

			pins_cmd3_dat {
				pinmux = <0x8f00>;
				input-enable;
				slew-rate = <0x00>;
				bias-disable;
			};
		};

		aud_dat_miso_on {
			phandle = <0x46>;

			pins_cmd0_dat {
				pinmux = <0x8c01>;
				drive-strength = <0x03>;
			};

			pins_cmd1_dat {
				pinmux = <0x8d01>;
				drive-strength = <0x03>;
			};

			pins_cmd2_dat {
				pinmux = <0x8e01>;
				drive-strength = <0x03>;
			};

			pins_cmd3_dat {
				pinmux = <0x8f01>;
				drive-strength = <0x03>;
			};
		};

		aud_gpio_i2s0_off {
			phandle = <0x47>;

			pins_cmd_dat {
				pinmux = <0x2800>;
			};
		};

		aud_gpio_i2s0_on {
			phandle = <0x48>;

			pins_cmd_dat {
				pinmux = <0x2802>;
			};
		};

		aud_gpio_i2s1_off {
			phandle = <0x49>;
		};

		aud_gpio_i2s1_on {
			phandle = <0x4a>;
		};

		aud_gpio_i2s2_off {
			phandle = <0x4b>;
		};

		aud_gpio_i2s2_on {
			phandle = <0x4c>;
		};

		aud_gpio_i2s3_off {
			phandle = <0x4d>;

			pins_cmd_dat {
				pinmux = <0x2500 0x2600 0x2400>;
			};
		};

		aud_gpio_i2s3_on {
			phandle = <0x4e>;

			pins_cmd_dat {
				pinmux = <0x2502 0x2602 0x2402>;
			};
		};

		vow_dat_miso_off {
			phandle = <0x4f>;

			pins_cmd1_dat {
				pinmux = <0x8e00>;
			};
		};

		vow_dat_miso_on {
			phandle = <0x50>;

			pins_cmd1_dat {
				pinmux = <0x8e04>;
			};
		};

		vow_clk_miso_off {
			phandle = <0x51>;

			pins_cmd3_dat {
				pinmux = <0x8f00>;
			};
		};

		vow_clk_miso_on {
			phandle = <0x52>;

			pins_cmd3_dat {
				pinmux = <0x8f04>;
			};
		};

		reverse_high {
			phandle = <0x6e>;

			pins_cmd_dat {
				pinmux = <0x5b00>;
				slew-rate = <0x01>;
				output-high;
			};
		};

		reverse_low {
			phandle = <0x6f>;

			pins_cmd_dat {
				pinmux = <0x5b00>;
				slew-rate = <0x01>;
				output-low;
			};
		};

		msdc0@default {
			phandle = <0x31>;

			pins_cmd {
				drive-strength = [03];
			};

			pins_dat {
				drive-strength = [03];
			};

			pins_clk {
				drive-strength = [03];
			};

			pins_rst {
				drive-strength = [03];
			};

			pins_ds {
				drive-strength = [03];
			};
		};

		msdc0@hs400 {
			phandle = <0x32>;

			pins_cmd {
				drive-strength = [03];
			};

			pins_dat {
				drive-strength = [04];
			};

			pins_clk {
				drive-strength = [04];
			};

			pins_rst {
				drive-strength = [03];
			};

			pins_ds {
				drive-strength = [04];
			};
		};

		msdc0@hs200 {
			phandle = <0x33>;

			pins_cmd {
				drive-strength = [03];
			};

			pins_dat {
				drive-strength = [04];
			};

			pins_clk {
				drive-strength = [04];
			};

			pins_rst {
				drive-strength = [03];
			};

			pins_ds {
				drive-strength = [04];
			};
		};

		msdc0@register_default {
			cmd_edge = [00];
			rdata_edge = [00];
			wdata_edge = [00];
			phandle = <0x34>;
		};

		msdc1@default {
			phandle = <0x36>;

			pins_cmd {
				drive-strength = [03];
			};

			pins_dat {
				drive-strength = [03];
			};

			pins_clk {
				drive-strength = [03];
			};
		};

		msdc1@sdr104 {
			phandle = <0x37>;

			pins_cmd {
				drive-strength = [03];
			};

			pins_dat {
				drive-strength = [03];
			};

			pins_clk {
				drive-strength = [03];
			};
		};

		msdc1@sdr50 {
			phandle = <0x38>;

			pins_cmd {
				drive-strength = [03];
			};

			pins_dat {
				drive-strength = [03];
			};

			pins_clk {
				drive-strength = [03];
			};
		};

		msdc1@ddr50 {
			phandle = <0x39>;

			pins_cmd {
				drive-strength = [03];
			};

			pins_dat {
				drive-strength = [03];
			};

			pins_clk {
				drive-strength = [03];
			};
		};

		msdc1@register_default {
			cmd_edge = [00];
			rdata_edge = [00];
			wdata_edge = [00];
			phandle = <0x3a>;
		};
	};

	sleep@10006000 {
		compatible = "mediatek,sleep";
		reg = <0x00 0x10006000 0x00 0x1000>;
		interrupts = <0x00 0xc3 0x08>;
		phandle = <0x70>;
	};

	toprgu@10007000 {
		compatible = "mediatek,toprgu";
		reg = <0x00 0x10007000 0x00 0x1000>;
		interrupts = <0x00 0x9c 0x08>;
		phandle = <0x71>;
	};

	clocks {

		clk26m {
			compatible = "fixed-clock";
			#clock-cells = <0x00>;
			clock-frequency = <0x18cba80>;
			phandle = <0x13>;
		};

		clk32k {
			compatible = "fixed-clock";
			#clock-cells = <0x00>;
			clock-frequency = <0x7d00>;
			phandle = <0x1f>;
		};
	};

	dcm {
		compatible = "mediatek,dcm";
		phandle = <0x72>;
	};

	apxgpt@10008000 {
		compatible = "mediatek,apxgpt";
		reg = <0x00 0x10008000 0x00 0x1000>;
		interrupts = <0x00 0xb9 0x08>;
		clocks = <0x1f>;
	};

	hacc@1000a000 {
		compatible = "mediatek,hacc";
		reg = <0x00 0x1000a000 0x00 0x1000>;
		interrupts = <0x00 0xcb 0x08>;
	};

	apirq@1000b000 {
		compatible = "mediatek,apirq";
		reg = <0x00 0x1000b000 0x00 0x1000>;
		interrupts = <0x00 0xba 0x04>;
		phandle = <0x1d>;
	};

	apmixed@1000c000 {
		compatible = "mediatek,apmixed", "syscon";
		reg = <0x00 0x1000c000 0x00 0x1000>;
		#clock-cells = <0x01>;
		phandle = <0x3d>;
	};

	fhctl@1000ce00 {
		compatible = "mediatek,fhctl";
		reg = <0x00 0x1000ce00 0x00 0x200>;
	};

	pwrap@1000d000 {
		compatible = "mediatek,mt6768-pwrap";
		reg = <0x00 0x1000d000 0x00 0x1000>;
		reg-names = "pwrap";
		interrupts = <0x00 0xc2 0x04>;
		clocks = <0x13 0x13>;
		clock-names = "spi", "wrap";
		phandle = <0x20>;

		mt6358-pmic {
			compatible = "mediatek,mt6358-pmic";
			interrupt-parent = <0x1e>;
			interrupts = <0x90 0x04 0x90 0x00>;
			status = "okay";
			interrupt-controller;
			#interrupt-cells = <0x02>;
			mediatek,num-pmic-irqs = <0x91>;
			mediatek,pmic-irqs = <0x00 0x00 0x01 0x00 0x02 0x00 0x03 0x00 0x04 0x00 0x05 0x00 0x06 0x00 0x07 0x00 0x08 0x00 0x09 0x00 0x10 0x01 0x11 0x01 0x12 0x01 0x13 0x01 0x14 0x01 0x15 0x01 0x16 0x01 0x17 0x01 0x18 0x01 0x19 0x01 0x1a 0x01 0x1b 0x01 0x1c 0x01 0x1d 0x01 0x1e 0x01 0x1f 0x01 0x20 0x01 0x21 0x01 0x22 0x01 0x23 0x01 0x24 0x01 0x25 0x01 0x26 0x01 0x27 0x01 0x28 0x01 0x29 0x01 0x2a 0x01 0x2b 0x01 0x2c 0x01 0x2d 0x01 0x2e 0x01 0x30 0x02 0x31 0x02 0x32 0x02 0x33 0x02 0x34 0x02 0x35 0x02 0x36 0x02 0x37 0x02 0x40 0x03 0x50 0x04 0x51 0x04 0x52 0x04 0x53 0x04 0x54 0x04 0x55 0x04 0x56 0x04 0x57 0x04 0x58 0x04 0x59 0x04 0x5a 0x04 0x5b 0x04 0x5c 0x04 0x60 0x04 0x61 0x04 0x62 0x04 0x63 0x04 0x64 0x04 0x70 0x05 0x71 0x05 0x72 0x05 0x73 0x05 0x74 0x05 0x75 0x05 0x76 0x05 0x77 0x05 0x80 0x06 0x85 0x06 0x86 0x06 0x87 0x06 0x90 0x07>;
			interrupt-names = "vproc11_oc", "vproc12_oc", "vcore_oc", "vgpu_oc", "vmodem_oc", "vdram1_oc", "vs1_oc", "vs2_oc", "vpa_oc", "vcore_preoc", "vfe28_oc", "vxo22_oc", "vrf18_oc", "vrf12_oc", "vefuse_oc", "vcn33_oc", "vcn28_oc", "vcn18_oc", "vcama1_oc", "vcama2_oc", "vcamd_oc", "vcamio_oc", "vldo28_oc", "va12_oc", "vaux18_oc", "vaud28_oc", "vio28_oc", "vio18_oc", "vsram_proc11_oc", "vsram_proc12_oc", "vsram_others_oc", "vsram_gpu_oc", "vdram2_oc", "vmc_oc", "vmch_oc", "vemc_oc", "vsim1_oc", "vsim2_oc", "vibr_oc", "vusb_oc", "vbif28_oc", "pwrkey", "homekey", "pwrkey_r", "homekey_r", "ni_lbat_int", "chrdet", "chrdet_edge", "vcdt_hv_det", "rtc", "fg_bat0_h", "fg_bat0_l", "fg_cur_h", "fg_cur_l", "fg_zcv", "fg_bat1_h", "fg_bat1_l", "fg_n_charge_l", "fg_iavg_h", "fg_iavg_l", "fg_time_h", "fg_discharge", "fg_charge", "baton_lv", "baton_ht", "baton_bat_in", "baton_bat_out", "bif", "bat_h", "bat_l", "bat2_h", "bat2_l", "bat_temp_h", "bat_temp_l", "auxadc_imp", "nag_c_dltv", "audio", "accdet", "accdet_eint0", "accdet_eint1", "spi_cmd_alert";
			phandle = <0x73>;

			mt-pmic {
				compatible = "mediatek,mt-pmic";
				interrupts = <0x30 0x04 0x32 0x04 0x31 0x04 0x33 0x04 0x70 0x04 0x71 0x04 0x52 0x04 0x53 0x04>;
				interrupt-names = "pwrkey", "pwrkey_r", "homekey", "homekey_r", "bat_h", "bat_l", "fg_cur_h", "fg_cur_l";
				phandle = <0x74>;
			};

			mt635x-auxadc {
				compatible = "mediatek,mt6358-auxadc";
				#io-channel-cells = <0x01>;
				phandle = <0x75>;

				batadc {
					channel = <0x00>;
					resistance-ratio = <0x03 0x01>;
					avg-num = <0x80>;
				};

				vcdt {
					channel = <0x02>;
				};

				bat_temp {
					channel = <0x03>;
					resistance-ratio = <0x02 0x01>;
				};

				chip_temp {
					channel = <0x05>;
				};

				vcore_temp {
					channel = <0x06>;
				};

				vproc_temp {
					channel = <0x07>;
				};

				vgpu_temp {
					channel = <0x08>;
				};

				accdet {
					channel = <0x09>;
				};

				dcxo_volt {
					channel = <0x0a>;
					resistance-ratio = <0x03 0x02>;
				};

				tsx_temp {
					channel = <0x0b>;
					avg-num = <0x80>;
				};

				hpofs_cal {
					channel = <0x0c>;
					avg-num = <0x100>;
				};

				dcxo_temp {
					channel = <0x0d>;
					avg-num = <0x10>;
				};

				vbif {
					channel = <0x0e>;
					resistance-ratio = <0x02 0x01>;
				};
			};

			mt6358regulator {
				compatible = "mediatek,mt6358-regulator";
				phandle = <0x76>;

				buck_vdram1 {
					regulator-name = "vdram1";
					regulator-min-microvolt = <0x7a120>;
					regulator-max-microvolt = <0x1fda4c>;
					regulator-enable-ramp-delay = <0x00>;
					phandle = <0x77>;
				};

				buck_vcore {
					regulator-name = "vcore";
					regulator-min-microvolt = <0x7a120>;
					regulator-max-microvolt = <0x13bdb6>;
					regulator-enable-ramp-delay = <0xc8>;
					phandle = <0x78>;
				};

				buck_vpa {
					regulator-name = "vpa";
					regulator-min-microvolt = <0x7a120>;
					regulator-max-microvolt = <0x37b1d0>;
					regulator-enable-ramp-delay = <0xfa>;
					phandle = <0x79>;
				};

				buck_vproc11 {
					regulator-name = "vproc11";
					regulator-min-microvolt = <0x7a120>;
					regulator-max-microvolt = <0x13bdb6>;
					regulator-enable-ramp-delay = <0xc8>;
					phandle = <0x7a>;
				};

				buck_vproc12 {
					regulator-name = "vproc12";
					regulator-min-microvolt = <0x7a120>;
					regulator-max-microvolt = <0x13bdb6>;
					regulator-enable-ramp-delay = <0xc8>;
					phandle = <0x7b>;
				};

				buck_vgpu {
					regulator-name = "vgpu";
					regulator-min-microvolt = <0x7a120>;
					regulator-max-microvolt = <0x13bdb6>;
					regulator-enable-ramp-delay = <0xc8>;
					phandle = <0x7c>;
				};

				buck_vs2 {
					regulator-name = "vs2";
					regulator-min-microvolt = <0x7a120>;
					regulator-max-microvolt = <0x1fda4c>;
					regulator-enable-ramp-delay = <0x00>;
					phandle = <0x7d>;
				};

				buck_vmodem {
					regulator-name = "vmodem";
					regulator-min-microvolt = <0x7a120>;
					regulator-max-microvolt = <0x13bdb6>;
					regulator-enable-ramp-delay = <0x384>;
					phandle = <0x7e>;
				};

				buck_vs1 {
					regulator-name = "vs1";
					regulator-min-microvolt = <0xf4240>;
					regulator-max-microvolt = <0x277b6c>;
					regulator-enable-ramp-delay = <0x00>;
					phandle = <0x7f>;
				};

				ldo_vdram2 {
					regulator-name = "vdram2";
					regulator-min-microvolt = <0x927c0>;
					regulator-max-microvolt = <0x1b7740>;
					regulator-enable-ramp-delay = <0xce4>;
					phandle = <0x80>;
				};

				ldo_vsim1 {
					regulator-name = "vsim1";
					regulator-min-microvolt = <0x19f0a0>;
					regulator-max-microvolt = <0x2f4d60>;
					regulator-enable-ramp-delay = <0x21c>;
					phandle = <0x81>;
				};

				ldo_vibr {
					regulator-name = "vibr";
					regulator-min-microvolt = <0x124f80>;
					regulator-max-microvolt = <0x325aa0>;
					regulator-enable-ramp-delay = <0x3c>;
					phandle = <0x82>;
				};

				ldo_vrf12 {
					compatible = "regulator-fixed";
					regulator-name = "vrf12";
					regulator-min-microvolt = <0x124f80>;
					regulator-max-microvolt = <0x124f80>;
					regulator-enable-ramp-delay = <0x78>;
					phandle = <0x83>;
				};

				ldo_vio18 {
					compatible = "regulator-fixed";
					regulator-name = "vio18";
					regulator-min-microvolt = <0x1b7740>;
					regulator-max-microvolt = <0x1b7740>;
					regulator-enable-ramp-delay = <0xa8c>;
					phandle = <0x84>;
				};

				ldo_vusb {
					regulator-name = "vusb";
					regulator-min-microvolt = <0x2dc6c0>;
					regulator-max-microvolt = <0x2f4d60>;
					regulator-enable-ramp-delay = <0x10e>;
					phandle = <0x85>;
				};

				ldo_vcamio {
					compatible = "regulator-fixed";
					regulator-name = "vcamio";
					regulator-min-microvolt = <0x1b7740>;
					regulator-max-microvolt = <0x1b7740>;
					regulator-enable-ramp-delay = <0x10e>;
					phandle = <0x86>;
				};

				ldo_vcamd {
					regulator-name = "vcamd";
					regulator-min-microvolt = <0xdbba0>;
					regulator-max-microvolt = <0x1b7740>;
					regulator-enable-ramp-delay = <0x10e>;
					phandle = <0x87>;
				};

				ldo_vcn18 {
					compatible = "regulator-fixed";
					regulator-name = "vcn18";
					regulator-min-microvolt = <0x1b7740>;
					regulator-max-microvolt = <0x1b7740>;
					regulator-enable-ramp-delay = <0x10e>;
					phandle = <0x88>;
				};

				ldo_vfe28 {
					compatible = "regulator-fixed";
					regulator-name = "vfe28";
					regulator-min-microvolt = <0x2ab980>;
					regulator-max-microvolt = <0x2ab980>;
					regulator-enable-ramp-delay = <0x10e>;
					phandle = <0x89>;
				};

				ldo_vsram_proc11 {
					regulator-name = "vsram_proc11";
					regulator-min-microvolt = <0x7a120>;
					regulator-max-microvolt = <0x13bdb6>;
					regulator-enable-ramp-delay = <0xf0>;
					phandle = <0x8a>;
				};

				ldo_vcn28 {
					compatible = "regulator-fixed";
					regulator-name = "vcn28";
					regulator-min-microvolt = <0x2ab980>;
					regulator-max-microvolt = <0x2ab980>;
					regulator-enable-ramp-delay = <0x10e>;
					phandle = <0x8b>;
				};

				ldo_vsram_others {
					regulator-name = "vsram_others";
					regulator-min-microvolt = <0x7a120>;
					regulator-max-microvolt = <0x13bdb6>;
					regulator-enable-ramp-delay = <0xf0>;
					phandle = <0x8c>;
				};

				ldo_vsram_gpu {
					regulator-name = "vsram_gpu";
					regulator-min-microvolt = <0x7a120>;
					regulator-max-microvolt = <0x13bdb6>;
					regulator-enable-ramp-delay = <0xf0>;
					phandle = <0x8d>;
				};

				ldo_vxo22 {
					compatible = "regulator-fixed";
					regulator-name = "vxo22";
					regulator-min-microvolt = <0x2191c0>;
					regulator-max-microvolt = <0x2191c0>;
					regulator-enable-ramp-delay = <0x78>;
					phandle = <0x8e>;
				};

				ldo_vefuse {
					regulator-name = "vefuse";
					regulator-min-microvolt = <0x19f0a0>;
					regulator-max-microvolt = <0x1cfde0>;
					regulator-enable-ramp-delay = <0x10e>;
					phandle = <0x8f>;
				};

				ldo_vaux18 {
					compatible = "regulator-fixed";
					regulator-name = "vaux18";
					regulator-min-microvolt = <0x1b7740>;
					regulator-max-microvolt = <0x1b7740>;
					regulator-enable-ramp-delay = <0x10e>;
					phandle = <0x90>;
				};

				ldo_vmch {
					regulator-name = "vmch";
					regulator-min-microvolt = <0x2c4020>;
					regulator-max-microvolt = <0x325aa0>;
					regulator-enable-ramp-delay = <0x3c>;
					phandle = <0x3b>;
				};

				ldo_vbif28 {
					compatible = "regulator-fixed";
					regulator-name = "vbif28";
					regulator-min-microvolt = <0x2ab980>;
					regulator-max-microvolt = <0x2ab980>;
					regulator-enable-ramp-delay = <0x10e>;
					phandle = <0x91>;
				};

				ldo_vsram_proc12 {
					regulator-name = "vsram_proc12";
					regulator-min-microvolt = <0x7a120>;
					regulator-max-microvolt = <0x13bdb6>;
					regulator-enable-ramp-delay = <0xf0>;
					phandle = <0x92>;
				};

				ldo_vcama1 {
					regulator-name = "vcama1";
					regulator-min-microvolt = <0x1b7740>;
					regulator-max-microvolt = <0x2dc6c0>;
					regulator-enable-ramp-delay = <0x10e>;
					phandle = <0x93>;
				};

				ldo_vemc {
					regulator-name = "vemc";
					regulator-min-microvolt = <0x2c4020>;
					regulator-max-microvolt = <0x325aa0>;
					regulator-enable-ramp-delay = <0x3c>;
					phandle = <0x35>;
				};

				ldo_vio28 {
					compatible = "regulator-fixed";
					regulator-name = "vio28";
					regulator-min-microvolt = <0x2ab980>;
					regulator-max-microvolt = <0x2ab980>;
					regulator-enable-ramp-delay = <0x10e>;
					phandle = <0x94>;
				};

				ldo_va12 {
					compatible = "regulator-fixed";
					regulator-name = "va12";
					regulator-min-microvolt = <0x124f80>;
					regulator-max-microvolt = <0x124f80>;
					regulator-enable-ramp-delay = <0x10e>;
					phandle = <0x95>;
				};

				ldo_vrf18 {
					compatible = "regulator-fixed";
					regulator-name = "vrf18";
					regulator-min-microvolt = <0x1b7740>;
					regulator-max-microvolt = <0x1b7740>;
					regulator-enable-ramp-delay = <0x78>;
					phandle = <0x96>;
				};

				ldo_vcn33_bt {
					regulator-name = "vcn33_bt";
					regulator-min-microvolt = <0x325aa0>;
					regulator-max-microvolt = <0x3567e0>;
					regulator-enable-ramp-delay = <0x10e>;
					phandle = <0x97>;
				};

				ldo_vcn33_wifi {
					regulator-name = "vcn33_wifi";
					regulator-min-microvolt = <0x325aa0>;
					regulator-max-microvolt = <0x3567e0>;
					regulator-enable-ramp-delay = <0x10e>;
					phandle = <0x98>;
				};

				ldo_vcama2 {
					regulator-name = "vcama2";
					regulator-min-microvolt = <0x1b7740>;
					regulator-max-microvolt = <0x2dc6c0>;
					regulator-enable-ramp-delay = <0x10e>;
					phandle = <0x99>;
				};

				ldo_vmc {
					regulator-name = "vmc";
					regulator-min-microvolt = <0x1b7740>;
					regulator-max-microvolt = <0x325aa0>;
					regulator-enable-ramp-delay = <0x3c>;
					phandle = <0x3c>;
				};

				ldo_vldo28 {
					compatible = "regulator-fixed";
					regulator-name = "vldo28";
					regulator-min-microvolt = <0x2ab980>;
					regulator-max-microvolt = <0x2ab980>;
					regulator-enable-ramp-delay = <0x10e>;
					phandle = <0x9a>;
				};

				ldo_vaud28 {
					compatible = "regulator-fixed";
					regulator-name = "vaud28";
					regulator-min-microvolt = <0x2ab980>;
					regulator-max-microvolt = <0x2ab980>;
					regulator-enable-ramp-delay = <0x10e>;
					phandle = <0x9b>;
				};

				ldo_vsim2 {
					regulator-name = "vsim2";
					regulator-min-microvolt = <0x19f0a0>;
					regulator-max-microvolt = <0x2f4d60>;
					regulator-enable-ramp-delay = <0x21c>;
					phandle = <0x9c>;
				};

				ldo_va09 {
					compatible = "regulator-fixed";
					regulator-name = "va09";
					regulator-min-microvolt = <0xdbba0>;
					regulator-max-microvolt = <0xdbba0>;
					regulator-enable-ramp-delay = <0x108>;
					regulator-boot-on;
					phandle = <0x9d>;
				};
			};

			mt6358_rtc {
				compatible = "mediatek,mt6358-rtc";
				interrupts = <0x40 0x00>;
				interrupt-names = "rtc";
				base = <0x580>;
				apply-lpsd-solution;
				phandle = <0x9e>;
			};

			mt6358_misc {
				compatible = "mediatek,mt6358-misc";
				base = <0x580>;
				apply-lpsd-solution;
				dcxo-switch;
				phandle = <0x9f>;
			};
		};
	};

	pwraphal@ {
		compatible = "mediatek,pwraph";
		mediatek,pwrap-regmap = <0x20>;
		phandle = <0xa0>;
	};

	pwrap_mpu@1000d000 {
		compatible = "mediatek,pwrap_mpu";
		reg = <0x00 0x1000d000 0x00 0x1000>;
	};

	pwrap_p2p@1005cb000 {
		compatible = "mediatek,pwrap_p2p";
		reg = <0x00 0x105cb000 0x00 0x1000>;
	};

	pwrap_md32@10448000 {
		compatible = "mediatek,pwrap_md32";
		reg = <0x00 0x10448000 0x00 0x1000>;
	};

	sleep_reg_md@1000f000 {
		compatible = "mediatek,sleep_reg_md";
		reg = <0x00 0x1000f000 0x00 0x1000>;
	};

	kp@10010000 {
		compatible = "mediatek,kp";
		reg = <0x00 0x10010000 0x00 0x1000>;
		interrupts = <0x00 0x49 0x02>;
		phandle = <0xa1>;
	};

	mrdump_ext_rst {
		compatible = "mediatek, mrdump_ext_rst-eint";
		mode = "IRQ";
		status = "okay";
		phandle = <0xa2>;
	};

	topmisc@10011000 {
		compatible = "mediatek,topmisc";
		reg = <0x00 0x10011000 0x00 0x1000>;
	};

	dvfsrc@10012000 {
		compatible = "mediatek,dvfsrc";
		reg = <0x00 0x10012000 0x00 0x1000 0x00 0x110780 0x00 0x80>;
		phandle = <0xa3>;
	};

	mbist_ao@10013000 {
		compatible = "mediatek,mbist_ao";
		reg = <0x00 0x10013000 0x00 0x1000>;
	};

	apcldmain_ao@10014000 {
		compatible = "mediatek,apcldmain_ao";
		reg = <0x00 0x10014000 0x00 0x400>;
	};

	apcldmaout_ao@10014400 {
		compatible = "mediatek,apcldmaout_ao";
		reg = <0x00 0x10014400 0x00 0x400>;
	};

	apcldmamisc_ao@10014800 {
		compatible = "mediatek,apcldmamisc_ao";
		reg = <0x00 0x10014800 0x00 0x400>;
	};

	apcldmamisc_ao@10014c00 {
		compatible = "mediatek,apcldmamisc_ao";
		reg = <0x00 0x10014c00 0x00 0x400>;
	};

	ddrphy@10015000 {
		compatible = "mediatek,ddrphy";
		reg = <0x00 0x10015000 0x00 0x1000>;
	};

	aes_top0@10016000 {
		compatible = "mediatek,aes_top0";
		reg = <0x00 0x10016000 0x00 0x1000>;
	};

	sys_timer@10017000 {
		compatible = "mediatek,sys_timer";
		reg = <0x00 0x10017000 0x00 0x1000>;
		reg-names = "sys_timer_base";
		interrupts = <0x00 0xcf 0x04>;
		clocks = <0x12 0x86>;
	};

	modem_temp_share@10018000 {
		compatible = "mediatek,modem_temp_share";
		reg = <0x00 0x10018000 0x00 0x1000>;
	};

	security_ao@1001a000 {
		compatible = "mediatek,security_ao";
		reg = <0x00 0x1001a000 0x00 0x1000>;
	};

	topckgen_ao@1001b000 {
		compatible = "mediatek,topckgen_ao";
		reg = <0x00 0x1001b000 0x00 0x1000>;
	};

	iocfg_0@10002000 {
		compatible = "mediatek,iocfg_0";
		reg = <0x00 0x10002000 0x00 0x200>;
	};

	iocfg_1@10002200 {
		compatible = "mediatek,iocfg_1";
		reg = <0x00 0x10002200 0x00 0x200>;
	};

	iocfg_2@10002400 {
		compatible = "mediatek,iocfg_2";
		reg = <0x00 0x10002400 0x00 0x200>;
	};

	iocfg_3@10002600 {
		compatible = "mediatek,iocfg_3";
		reg = <0x00 0x10002600 0x00 0x200>;
	};

	iocfg_4@10002800 {
		compatible = "mediatek,iocfg_4";
		reg = <0x00 0x10002800 0x00 0x200>;
	};

	iocfg_5@10002a00 {
		compatible = "mediatek,iocfg_5";
		reg = <0x00 0x10002a00 0x00 0x200>;
	};

	mdcldmain_ao@10015000 {
		compatible = "mediatek,mdcldmain_ao";
		reg = <0x00 0x10015000 0x00 0x400>;
	};

	mdcldmaout_ao@10015400 {
		compatible = "mediatek,mdcldmaout_ao";
		reg = <0x00 0x10015400 0x00 0x400>;
	};

	mdcldmamisc_ao@10015800 {
		compatible = "mediatek,mdcldmamisc_ao";
		reg = <0x00 0x10015800 0x00 0x400>;
	};

	sys_cirq@10204000 {
		compatible = "mediatek,sys_cirq";
		reg = <0x00 0x10204000 0x00 0x1000>;
		mediatek,cirq_num = <0xe8>;
		mediatek,spi_start_offset = <0x40>;
		interrupts = <0x00 0x127 0x08>;
	};

	mcucfg_mp0_counter@0c530000 {
		compatible = "mediatek,mcucfg_mp0_counter";
		reg = <0x00 0xc530000 0x00 0x10000>;
	};

	mcucfg@0c530000 {
		compatible = "mediatek,mcucfg";
		reg = <0x00 0xc530000 0x00 0x10000>;
		phandle = <0xa4>;
	};

	m4u@10205000 {
		cell-index = <0x00>;
		compatible = "mediatek,m4u";
		reg = <0x00 0x10205000 0x00 0x1000>;
		interrupts = <0x00 0xae 0x08>;
	};

	devapc@10207000 {
		compatible = "mediatek,mt6768-devapc";
		reg = <0x00 0x10207000 0x00 0x1000 0x00 0x1000e000 0x00 0x1000 0x00 0x10033000 0x00 0x1000>;
		interrupts = <0x00 0x9f 0x08>;
		clocks = <0x21 0x28>;
		clock-names = "devapc-infra-clock";
	};

	hwrng {
		compatible = "mediatek,mt67xx-rng";
		phandle = <0xa5>;
	};

	bus_dbg@10208000 {
		compatible = "mediatek,bus_dbg-v2";
		reg = <0x00 0x10208000 0x00 0x1000 0x00 0x10001000 0x00 0x1000>;
		mediatek,bus_dbg_con_offset = <0x2fc>;
		interrupts = <0x00 0x9e 0x08>;
	};

	ap_ccif0@10209000 {
		compatible = "mediatek,ap_ccif0";
		reg = <0x00 0x10209000 0x00 0x1000>;
		interrupts = <0x00 0xa4 0x08>;
	};

	md_ccif0@1020a000 {
		compatible = "mediatek,md_ccif0";
		reg = <0x00 0x1020a000 0x00 0x1000>;
	};

	ap_ccif1@1020b000 {
		compatible = "mediatek,ap_ccif1";
		reg = <0x00 0x1020b000 0x00 0x1000>;
		interrupts = <0x00 0xa6 0x08>;
	};

	md_ccif1@1020c000 {
		compatible = "mediatek,md_ccif1";
		reg = <0x00 0x1020c000 0x00 0x1000>;
	};

	infra_mbist@1020d000 {
		compatible = "mediatek,infra_mbist";
		reg = <0x00 0x1020d000 0x00 0x1000>;
	};

	infracfg@1020e000 {
		compatible = "mediatek,infracfg";
		reg = <0x00 0x1020e000 0x00 0x1000>;
	};

	trng@1020f000 {
		compatible = "mediatek,trng";
		reg = <0x00 0x1020f000 0x00 0x1000>;
		interrupts = <0x00 0xb0 0x08>;
	};

	dxcc_sec@10210000 {
		compatible = "mediatek,dxcc_sec";
		reg = <0x00 0x10210000 0x00 0x1000>;
		interrupts = <0x00 0xb1 0x04>;
	};

	mcupm_sram2@10211000 {
		compatible = "mediatek,mcupm_sram2";
		reg = <0x00 0x10211000 0x00 0x1000>;
	};

	cq_dma@10212000 {
		compatible = "mediatek,mt-cqdma-v1";
		reg = <0x00 0x10212000 0x00 0x80 0x00 0x10212080 0x00 0x80 0x00 0x10212100 0x00 0x80>;
		interrupts = <0x00 0x86 0x08 0x00 0x87 0x08 0x00 0x88 0x08>;
		nr_channel = <0x03>;
		clocks = <0x21 0x43>;
		clock-names = "cqdma";
	};

	mcupm_sram3@10213000 {
		compatible = "mediatek,mcupm_sram3";
		reg = <0x00 0x10213000 0x00 0x1000>;
	};

	sramrom@10214000 {
		compatible = "mediatek,sramrom";
		reg = <0x00 0x10214000 0x00 0x1000>;
	};

	mcupm_reg@10216000 {
		compatible = "mediatek,mcupm_reg";
		reg = <0x00 0x10216000 0x00 0x1000>;
	};

	mcupm_sram0@10217000 {
		compatible = "mediatek,mcupm_sram0";
		reg = <0x00 0x10217000 0x00 0x1000>;
	};

	mcupm_sram1@10218000 {
		compatible = "mediatek,mcupm_sram1";
		reg = <0x00 0x10218000 0x00 0x1000>;
	};

	emi@10219000 {
		compatible = "mediatek,emi";
		reg = <0x00 0x10219000 0x00 0x1000 0x00 0x10226000 0x00 0x1000 0x00 0x1022d000 0x00 0x1000 0x00 0x10235000 0x00 0x1000 0x00 0x1020e000 0x00 0x1000>;
		interrupts = <0x00 0xa1 0x08>;
	};

	chn_emi@1021a000 {
		compatible = "mediatek,chn_emi";
		reg = <0x00 0x1021a000 0x00 0x1000>;
	};

	apcldmain@1021b000 {
		compatible = "mediatek,apcldmain";
		reg = <0x00 0x1021b000 0x00 0x100>;
	};

	apcldmain@1021b100 {
		compatible = "mediatek,apcldmain";
		reg = <0x00 0x1021b100 0x00 0x100>;
	};

	apcldmaout@1021b400 {
		compatible = "mediatek,apcldmaout";
		reg = <0x00 0x1021b400 0x00 0x100>;
	};

	apcldmaout@1021b500 {
		compatible = "mediatek,apcldmaout";
		reg = <0x00 0x1021b500 0x00 0x100>;
	};

	apcldmamisc@1021b800 {
		compatible = "mediatek,apcldmamisc";
		reg = <0x00 0x1021b800 0x00 0x100>;
		interrupts = <0x00 0xb4 0x04>;
	};

	apcldmamisc@1021b900 {
		compatible = "mediatek,apcldmamisc";
		reg = <0x00 0x1021b900 0x00 0x400>;
	};

	mdcldmain@1021c000 {
		compatible = "mediatek,mdcldmain";
		reg = <0x00 0x1021c000 0x00 0x400>;
	};

	mdcldmaout@1021c400 {
		compatible = "mediatek,mdcldmaout";
		reg = <0x00 0x1021c400 0x00 0x400>;
	};

	mdcldmamisc@1021c000 {
		compatible = "mediatek,mdcldmamisc";
		reg = <0x00 0x1021c000 0x00 0x1000>;
	};

	mdcldmamisc@1021c900 {
		compatible = "mediatek,mdcldmamisc";
		reg = <0x00 0x1021c900 0x00 0x400>;
	};

	mdcldma@10014000 {
		compatible = "mediatek,mdcldma";
		reg = <0x00 0x10014000 0x00 0x1000 0x00 0x1021b000 0x00 0x1000 0x00 0x10209000 0x00 0x1000 0x00 0x1020a000 0x00 0x1000>;
		interrupts = <0x00 0xb4 0x04 0x00 0xa4 0x08 0x00 0xa5 0x08 0x00 0x4b 0x02>;
		mediatek,md_id = <0x00>;
		mediatek,cldma_capability = <0x06>;
		clocks = <0x22 0x00 0x21 0x32 0x21 0x29 0x21 0x2c 0x21 0x23 0x21 0x24 0x21 0x51 0x21 0x52>;
		clock-names = "scp-sys-md1-main", "infra-cldma-bclk", "infra-ccif-ap", "infra-ccif-md", "infra-ccif1-ap", "infra-ccif1-md", "infra-ccif2-ap", "infra-ccif2-md";
		phandle = <0xa6>;
	};

	md_auxadc {
		compatible = "mediatek,md_auxadc";
		io-channels = <0x23 0x02>;
		io-channel-names = "md-channel";
		phandle = <0xa7>;
	};

	bpi_bsi_slv0@1021e000 {
		compatible = "mediatek,bpi_bsi_slv0";
		reg = <0x00 0x1021e000 0x00 0x1000>;
	};

	bpi_bsi_slv1@1021f000 {
		compatible = "mediatek,bpi_bsi_slv1";
		reg = <0x00 0x1021f000 0x00 0x6000>;
	};

	bpi_bsi_slv2@10225000 {
		compatible = "mediatek,bpi_bsi_slv2";
		reg = <0x00 0x10225000 0x00 0x1000>;
	};

	emi_mpu@10226000 {
		compatible = "mediatek,emi_mpu";
		reg = <0x00 0x10226000 0x00 0x1000>;
	};

	dvfsp@10227000 {
		compatible = "mediatek,dvfsp";
		reg = <0x00 0x10227000 0x00 0x1000>;
	};

	dvfsp@00110800 {
		compatible = "mediatek,mt6768-dvfsp";
		reg = <0x00 0x110800 0x00 0x1400 0x00 0x110800 0x00 0x1400>;
		state = <0x01>;
		change_flag = <0x00>;
		little-rise-time = <0x3e8>;
		little-down-time = <0x2ee>;
		big-rise-time = <0x3e8>;
		big-down-time = <0x2ee>;
		L-table = <0x6a4 0x38 0x02 0x01 0x659 0x35 0x02 0x01 0x5dc 0x30 0x02 0x01 0x5aa 0x2e 0x02 0x01 0x55f 0x2b 0x02 0x01 0x52d 0x29 0x02 0x01 0x4fb 0x27 0x02 0x01 0x497 0x22 0x02 0x01 0x44c 0x29 0x02 0x01 0x41a 0x1d 0x02 0x01 0x3e7 0x1b 0x02 0x01 0x3b6 0x19 0x02 0x01 0x384 0x17 0x02 0x01 0x352 0x15 0x04 0x01 0x306 0x13 0x04 0x01 0x1f4 0x10 0x04 0x01>;
		B-table = <0x7d0 0x48 0x01 0x01 0x79e 0x45 0x01 0x01 0x76c 0x41 0x01 0x01 0x73a 0x3d 0x01 0x01 0x708 0x3a 0x01 0x01 0x6ae 0x36 0x01 0x01 0x655 0x32 0x01 0x01 0x60c 0x30 0x02 0x01 0x5a3 0x2b 0x02 0x01 0x54a 0x27 0x02 0x01 0x4f1 0x24 0x02 0x01 0x498 0x20 0x02 0x01 0x43f 0x1d 0x02 0x01 0x3e6 0x19 0x02 0x01 0x38d 0x16 0x02 0x01 0x352 0x13 0x02 0x01>;
		CCI-table = <0x4a3 0x38 0x02 0x01 0x460 0x34 0x02 0x01 0x419 0x30 0x02 0x01 0x3f6 0x2e 0x02 0x01 0x3c1 0x2b 0x02 0x01 0x38d 0x28 0x02 0x01 0x358 0x24 0x02 0x01 0x335 0x22 0x02 0x01 0x300 0x1f 0x02 0x01 0x2dd 0x1d 0x04 0x01 0x2ba 0x1b 0x04 0x01 0x297 0x19 0x04 0x01 0x274 0x17 0x04 0x01 0x251 0x15 0x04 0x01 0x3a 0x13 0x04 0x01 0x1f4 0x10 0x04 0x01>;
		phandle = <0xa8>;
	};

	mt_cpufreq {
		compatible = "mediatek,mt-cpufreq";
		phandle = <0xa9>;
	};

	dramc@1022a000 {
		compatible = "mediatek,dramc";
		reg = <0x00 0x1022a000 0x00 0x2000 0x00 0x10232000 0x00 0x2000 0x00 0x1022c000 0x00 0x1000 0x00 0x10234000 0x00 0x1000 0x00 0x10228000 0x00 0x2000 0x00 0x10230000 0x00 0x2000 0x00 0x1022e000 0x00 0x1000 0x00 0x10236000 0x00 0x1000>;
	};

	gce@10238000 {
		compatible = "mediatek,gce", "syscon";
		reg = <0x00 0x10238000 0x00 0x4000>;
		#clock-cells = <0x01>;
		interrupts = <0x00 0xaa 0x08>;
		disp_mutex_reg = <0x14016000 0x1000>;
		g3d_config_base = <0x13000000 0x00 0xffff0000>;
		mmsys_config_base = <0x14000000 0x01 0xffff0000>;
		disp_dither_base = <0x14010000 0x02 0xffff0000>;
		mm_na_base = <0x14020000 0x03 0xffff0000>;
		imgsys_base = <0x15020000 0x04 0xffff0000>;
		vdec_gcon_base = <0x18800000 0x05 0xffff0000>;
		venc_gcon_base = <0x18810000 0x06 0xffff0000>;
		conn_peri_base = <0x18820000 0x07 0xffff0000>;
		topckgen_base = <0x18830000 0x08 0xffff0000>;
		kp_base = <0x18840000 0x09 0xffff0000>;
		scp_sram_base = <0x10000000 0x0a 0xffff0000>;
		infra_na3_base = <0x10010000 0x0b 0xffff0000>;
		infra_na4_base = <0x10020000 0x0c 0xffff0000>;
		scp_base = <0x10030000 0x0d 0xffff0000>;
		mcucfg_base = <0x10040000 0x0e 0xffff0000>;
		gcpu_base = <0x10050000 0x0f 0xffff0000>;
		usb0_base = <0x10200000 0x10 0xffff0000>;
		usb_sif_base = <0x10280000 0x11 0xffff0000>;
		audio_base = <0x17000000 0x12 0xffff0000>;
		vdec_base = <0x17010000 0x13 0xffff0000>;
		msdc2_base = <0x17020000 0x14 0xffff0000>;
		vdec1_base = <0x17030000 0x15 0xffff0000>;
		msdc3_base = <0x18000000 0x16 0xffff0000>;
		ap_dma_base = <0x18010000 0x17 0xffff0000>;
		gce_base = <0x18020000 0x18 0xffff0000>;
		vdec2_base = <0x18040000 0x19 0xffff0000>;
		vdec3_base = <0x18050000 0x1a 0xffff0000>;
		camsys_base = <0x18080000 0x1b 0xffff0000>;
		camsys1_base = <0x180a0000 0x1c 0xffff0000>;
		camsys2_base = <0x180b0000 0x1d 0xffff0000>;
		pwm_sw_base = <0x1100e000 0x63 0xffff0000>;
		mdp_rdma0_sof = <0x00>;
		mdp_ccorr0_sof = <0x01>;
		mdp_rsz0_sof = <0x02>;
		mdp_rsz1_sof = <0x03>;
		mdp_wdma_sof = <0x04>;
		mdp_wrot0_sof = <0x05>;
		mdp_tdshp0_sof = <0x06>;
		disp_ovl0_sof = <0x07>;
		disp_2l_ovl0_sof = <0x08>;
		disp_rdma0_sof = <0x09>;
		disp_wdma0_sof = <0x0a>;
		disp_color0_sof = <0x0b>;
		disp_ccorr0_sof = <0x0c>;
		disp_aal0_sof = <0x0d>;
		disp_gamma0_sof = <0x0e>;
		disp_dither0_sof = <0x0f>;
		disp_dsi0_sof = <0x10>;
		disp_rsz0_sof = <0x11>;
		img_dl_relay_sof = <0x12>;
		disp_pwm0_sof = <0x13>;
		mdp_rdma0_frame_done = <0x14>;
		mdp_ccorr0_frame_done = <0x15>;
		mdp_rsz0_frame_done = <0x16>;
		mdp_rsz1_frame_done = <0x17>;
		mdp_wrot0_write_frame_done = <0x18>;
		mdp_wdma_frame_done = <0x19>;
		mdp_tdshp0_frame_done = <0x1a>;
		disp_ovl0_frame_done = <0x1b>;
		disp_2l_ovl0_frame_done = <0x1c>;
		disp_rsz0_frame_done = <0x1d>;
		disp_rdma0_frame_done = <0x1e>;
		disp_wdma0_frame_done = <0x1f>;
		disp_color0_frame_done = <0x20>;
		disp_ccorr0_frame_done = <0x21>;
		disp_aal0_frame_done = <0x22>;
		disp_gamma0_frame_done = <0x23>;
		disp_dither0_frame_done = <0x24>;
		disp_dsi0_frame_done = <0x25>;
		stream_done_0 = <0x82>;
		stream_done_1 = <0x83>;
		stream_done_2 = <0x84>;
		stream_done_3 = <0x85>;
		stream_done_4 = <0x86>;
		stream_done_5 = <0x87>;
		stream_done_6 = <0x88>;
		stream_done_7 = <0x89>;
		stream_done_8 = <0x8a>;
		stream_done_9 = <0x8b>;
		buf_underrun_event_0 = <0x8c>;
		dsi0_te_event = <0x8d>;
		dsi0_irq_event = <0x8e>;
		dsi0_done_event = <0x8f>;
		disp_wdma0_rst_done = <0x93>;
		mdp_wdma_rst_done = <0x94>;
		mdp_wrot0_rst_done = <0x95>;
		mdp_rdma0_rst_done = <0x97>;
		disp_ovl0_frame_rst_done_pusle = <0x98>;
		dip_cq_thread0_frame_done = <0x101>;
		dip_cq_thread1_frame_done = <0x102>;
		dip_cq_thread2_frame_done = <0x103>;
		dip_cq_thread3_frame_done = <0x104>;
		dip_cq_thread4_frame_done = <0x105>;
		dip_cq_thread5_frame_done = <0x106>;
		dip_cq_thread6_frame_done = <0x107>;
		dip_cq_thread7_frame_done = <0x108>;
		dip_cq_thread8_frame_done = <0x109>;
		dip_cq_thread9_frame_done = <0x10a>;
		dip_cq_thread10_frame_done = <0x10b>;
		dip_cq_thread11_frame_done = <0x10c>;
		dip_cq_thread12_frame_done = <0x10d>;
		dip_cq_thread13_frame_done = <0x10e>;
		dip_cq_thread14_frame_done = <0x10f>;
		dip_cq_thread15_frame_done = <0x110>;
		dip_cq_thread16_frame_done = <0x111>;
		dip_cq_thread17_frame_done = <0x112>;
		dip_cq_thread18_frame_done = <0x113>;
		dve_frame_done = <0x114>;
		wmf_frame_done = <0x115>;
		rsc_frame_done = <0x116>;
		venc_frame_done = <0x121>;
		venc_pause_done = <0x122>;
		jpgenc_done = <0x123>;
		venc_mb_done = <0x124>;
		venc_128byte_cnt_done = <0x125>;
		isp_frame_done_b = <0x142>;
		camsv_0_pass1_done = <0x143>;
		camsv_1_pass1_done = <0x144>;
		camsv_2_pass1_done = <0x145>;
		tsf_done = <0x146>;
		seninf_0_fifo_full = <0x147>;
		seninf_1_fifo_full = <0x148>;
		seninf_2_fifo_full = <0x149>;
		seninf_3_fifo_full = <0x14a>;
		seninf_4_fifo_full = <0x14b>;
		seninf_5_fifo_full = <0x14c>;
		seninf_6_fifo_full = <0x14d>;
		seninf_7_fifo_full = <0x14e>;
		dsi0_te_from_infra = <0x382>;
		mmsys_config = <0x24>;
		mdp_rdma0 = <0x25>;
		mdp_rsz0 = <0x26>;
		mdp_rsz1 = <0x27>;
		mdp_wdma0 = <0x28>;
		mdp_wrot0 = <0x29>;
		mdp_tdshp0 = <0x2a>;
		mdp_color0 = <0x2b>;
		mdp_ccorr0 = <0x2c>;
		mm_mutex = <0x2d>;
		sram_share_cnt = <0x01>;
		sram_share_engine = <0x0d>;
		sram_share_event = <0x2c6>;
		mediatek,mailbox-gce = <0x2e>;
		secure_thread = <0x06 0x08>;
		mboxes = <0x2e 0x00 0x00 0x04 0x2e 0x02 0x00 0x05 0x2e 0x03 0x00 0x04 0x2e 0x04 0x00 0x04 0x2e 0x06 0x00 0x03 0x2e 0x07 0xffffffff 0x02 0x2f 0x08 0x00 0x04 0x2f 0x09 0x00 0x04 0x2f 0x0a 0x00 0x01 0x2e 0x0b 0x00 0x01 0x2e 0x0c 0x00 0x01 0x2e 0x0d 0x00 0x01 0x2e 0x0e 0x00 0x01 0x2e 0x0f 0xffffffff 0x01>;
		clocks = <0x21 0x09 0x21 0x18 0x22 0x03>;
		clock-names = "GCE", "GCE_TIMER", "MMSYS_MTCMOS";
		phandle = <0xaa>;
	};

	gce_mbox@10238000 {
		compatible = "mediatek,mt6768-gce";
		reg = <0x00 0x10238000 0x00 0x4000>;
		interrupts = <0x00 0xaa 0x08>;
		default_tokens = [02 bc 02 bd 02 be 02 bf 02 c0 02 c6 02 c7];
		clocks = <0x21 0x09 0x21 0x18>;
		clock-names = "gce", "gce-timer";
		#mbox-cells = <0x03>;
		#gce-event-cells = <0x01>;
		#gce-subsys-cells = <0x02>;
		phandle = <0x2e>;
	};

	gce_mbox_svp@10238000 {
		compatible = "mediatek,mailbox-gce-svp";
		reg = <0x00 0x10238000 0x00 0x4000>;
		interrupts = <0x00 0xaa 0x08 0x00 0xab 0x08>;
		#mbox-cells = <0x03>;
		clocks = <0x21 0x09 0x21 0x18>;
		clock-names = "gce", "gce-timer";
		phandle = <0x2f>;
	};

	ap_ccif2@1023c000 {
		compatible = "mediatek,ap_ccif2";
		reg = <0x00 0x1023c000 0x00 0x1000>;
		interrupts = <0x00 0xa0 0x08>;
	};

	md_ccif2@1023d000 {
		compatible = "mediatek,md_ccif2";
		reg = <0x00 0x1023d000 0x00 0x1000>;
	};

	ap_ccif3@1023e000 {
		compatible = "mediatek,ap_ccif3";
		reg = <0x00 0x1023e000 0x00 0x1000>;
		interrupts = <0x00 0xa3 0x08>;
	};

	fingerprint {
		compatible = "mediatek,fpc1022_irq", "mediatek,goodix-fp";
		status = "okay";
		phandle = <0xab>;
	};

	accdet {
		compatible = "mediatek,pmic-accdet";
		phandle = <0xac>;
	};

	swtp {
		compatible = "mediatek, swtp-eint";
		ant_sw_gpios = <0x1e 0x48 0x00>;
		phandle = <0xad>;
	};

	mt6358_gauge {
		compatible = "mediatek,mt6358_gauge";
		gauge_name = "gauge";
		alias_name = "MT6358";
	};

	gauge_timer {
		compatible = "mediatek,gauge_timer_service";
	};

	simtray {
		compatible = "xiaomi,simtray-status";
		status-gpio = <0x1e 0x2e 0x00>;
	};

	battery {
		compatible = "mediatek,bat_gm30";
		io-channels = <0x23 0x02>;
		io-channel-names = "batteryID-channel";
		DIFFERENCE_FULLOCV_ITH = <0xfa>;
		SHUTDOWN_1_TIME = <0x05>;
		KEEP_100_PERCENT = <0x01>;
		R_FG_VALUE = <0x0a>;
		EMBEDDED_SEL = <0x01>;
		PMIC_SHUTDOWN_CURRENT = <0x14>;
		FG_METER_RESISTANCE = <0x4b>;
		CAR_TUNE_VALUE = <0x63>;
		PMIC_MIN_VOL = <0x82dc>;
		POWERON_SYSTEM_IBOOT = <0x1f4>;
		SHUTDOWN_GAUGE0_VOLTAGE = <0x84d0>;
		TEMPERATURE_T0 = <0x32>;
		TEMPERATURE_T1 = <0x19>;
		TEMPERATURE_T2 = <0x0a>;
		TEMPERATURE_T3 = <0x00>;
		TEMPERATURE_T4 = <0xfffffff6>;
		g_FG_PSEUDO100_T0 = <0x5f>;
		g_FG_PSEUDO100_T1 = <0x5f>;
		g_FG_PSEUDO100_T2 = <0x5f>;
		g_FG_PSEUDO100_T3 = <0x5f>;
		g_FG_PSEUDO100_T4 = <0x5f>;
		Q_MAX_SYS_VOLTAGE_BAT0 = <0xdde>;
		Q_MAX_SYS_VOLTAGE_BAT1 = <0xdde>;
		Q_MAX_SYS_VOLTAGE_BAT2 = <0xdde>;
		Q_MAX_SYS_VOLTAGE_BAT3 = <0xdde>;
		COM_FG_METER_RESISTANCE = <0x64>;
		COM_R_FG_VALUE = <0x00>;
		enable_tmp_intr_suspend = <0x00>;
		ACTIVE_TABLE = <0x05>;
		MULTI_TEMP_GAUGE0 = <0x01>;
		battery0_profile_t0_num = <0x64>;
		battery0_profile_t0_col = <0x03>;
		battery0_profile_t0 = <0x00 0xacd0 0x384 0x200 0xac3f 0x384 0x400 0xabbc 0x384 0x600 0xab42 0x384 0x800 0xaace 0x37a 0xa01 0xaa5f 0x36b 0xc01 0xa9f0 0x36b 0xe01 0xa981 0x36b 0x1001 0xa91b 0x380 0x1201 0xa8a7 0x373 0x1401 0xa834 0x378 0x1601 0xa7c2 0x384 0x1801 0xa74a 0x384 0x1a02 0xa6d3 0x386 0x1c02 0xa65b 0x39c 0x1e02 0xa5dc 0x389 0x2002 0xa562 0x384 0x2202 0xa4e5 0x377 0x2402 0xa468 0x36b 0x2602 0xa3f2 0x371 0x2802 0xa381 0x384 0x2a03 0xa301 0x384 0x2c03 0xa291 0x398 0x2e03 0xa21b 0x38d 0x3003 0xa1a9 0x391 0x3203 0xa136 0x39d 0x3403 0xa0c1 0x39d 0x3603 0xa052 0x39d 0x3803 0x9fe3 0x39d 0x3a04 0x9f74 0x39d 0x3c04 0x9f0b 0x39d 0x3e04 0x9ea5 0x39d 0x4004 0x9e3e 0x3a5 0x4204 0x9dd8 0x3b1 0x4404 0x9d72 0x39e 0x4604 0x9d14 0x3b3 0x4804 0x9cb6 0x3c9 0x4a04 0x9c58 0x3cf 0x4c05 0x9bfa 0x3cf 0x4e05 0x9ba0 0x3d7 0x5005 0x9b49 0x3ec 0x5205 0x9aeb 0x402 0x5405 0x9a8d 0x42c 0x5605 0x9a12 0x40f 0x5805 0x997b 0x3d6 0x5a05 0x98ee 0x3a1 0x5c06 0x987f 0x37d 0x5e06 0x9825 0x36e 0x6006 0x97e1 0x384 0x6206 0x979d 0x384 0x6406 0x9759 0x373 0x6606 0x971a 0x379 0x6806 0x96de 0x384 0x6a06 0x96a4 0x384 0x6c07 0x9671 0x384 0x6e07 0x963d 0x384 0x7007 0x960a 0x384 0x7207 0x95d7 0x384 0x7407 0x95a4 0x377 0x7607 0x9574 0x375 0x7807 0x954a 0x37e 0x7a07 0x9520 0x36d 0x7c08 0x94fe 0x383 0x7e08 0x94d4 0x384 0x8008 0x94b0 0x394 0x8208 0x948d 0x39d 0x8408 0x946b 0x3a6 0x8608 0x9449 0x3b6 0x8808 0x9426 0x3b6 0x8a08 0x93fc 0x3b6 0x8c08 0x93c1 0x3a2 0x8e09 0x936c 0x37d 0x9009 0x9322 0x377 0x9209 0x92ea 0x38d 0x9409 0x92b6 0x398 0x9609 0x9283 0x384 0x9809 0x9250 0x384 0x9a09 0x9224 0x397 0x9c09 0x91fa 0x39d 0x9e0a 0x91cf 0x39d 0xa00a 0x91a4 0x3a5 0xa20a 0x9176 0x3b6 0xa40a 0x913a 0x3b5 0xa60a 0x90ed 0x38a 0xa80a 0x90af 0x396 0xaa0a 0x906d 0x3ac 0xac0a 0x9020 0x395 0xae0b 0x8fdf 0x36b 0xb00b 0x8fc9 0x36f 0xb20b 0x8fc0 0x385 0xb40b 0x8fb7 0x3c5 0xb60b 0x8fa8 0x417 0xb80b 0x8f7f 0x45e 0xba0b 0x8ee5 0x433 0xbc0b 0x8d9f 0x3d6 0xbe0c 0x8bad 0x3f2 0xc00c 0x8924 0x432 0xc20c 0x856c 0x4b1 0xc40c 0x7eb2 0x864 0xc60c 0x7134 0x9ab>;
		battery0_profile_t1_num = <0x64>;
		battery0_profile_t1_col = <0x03>;
		battery0_profile_t1 = <0x00 0xac76 0x46a 0x200 0xabff 0x466 0x400 0xab95 0x477 0x600 0xab29 0x470 0x800 0xaabe 0x46f 0xa01 0xaa55 0x477 0xc01 0xa9e7 0x468 0xe01 0xa981 0x47d 0x1001 0xa912 0x47e 0x1201 0xa89d 0x47e 0x1401 0xa825 0x471 0x1601 0xa7ae 0x465 0x1801 0xa736 0x465 0x1a02 0xa6be 0x465 0x1c02 0xa63e 0x465 0x1e02 0xa5c6 0x465 0x2002 0xa54e 0x475 0x2202 0xa4d7 0x47e 0x2402 0xa45b 0x475 0x2602 0xa3db 0x465 0x2802 0xa364 0x467 0x2a03 0xa2ec 0x47d 0x2c03 0xa27d 0x47e 0x2e03 0xa207 0x47e 0x3003 0xa195 0x48b 0x3203 0xa122 0x497 0x3403 0xa0ad 0x497 0x3603 0xa03e 0x497 0x3803 0x9fcf 0x497 0x3a04 0x9f68 0x4aa 0x3c04 0x9efb 0x4b0 0x3e04 0x9e91 0x4b0 0x4004 0x9e2e 0x4c0 0x4204 0x9dce 0x4e2 0x4404 0x9d68 0x4e3 0x4604 0x9d0a 0x4f8 0x4804 0x9ca5 0x50e 0x4a04 0x9c4a 0x532 0x4c05 0x9bf0 0x551 0x4e05 0x9b93 0x567 0x5005 0x9b31 0x578 0x5205 0x9ac2 0x577 0x5405 0x9a4b 0x54d 0x5605 0x99b7 0x4ec 0x5805 0x9928 0x49e 0x5a05 0x98b1 0x473 0x5c06 0x9850 0x45e 0x5e06 0x97fd 0x44c 0x6006 0x97b9 0x44c 0x6206 0x9775 0x44c 0x6406 0x9737 0x44c 0x6606 0x96fc 0x44c 0x6806 0x96c0 0x442 0x6a06 0x9686 0x439 0x6c07 0x9653 0x449 0x6e07 0x961f 0x434 0x7007 0x95f4 0x448 0x7207 0x95c3 0x44c 0x7407 0x9595 0x44c 0x7607 0x956a 0x44c 0x7807 0x9542 0x452 0x7a07 0x9520 0x467 0x7c08 0x94fe 0x47d 0x7e08 0x94d4 0x46a 0x8008 0x94b0 0x465 0x8208 0x9493 0x472 0x8408 0x9475 0x47e 0x8608 0x9453 0x484 0x8808 0x9431 0x497 0x8a08 0x940f 0x497 0x8c08 0x93e5 0x483 0x8e09 0x93ba 0x46e 0x9009 0x938b 0x459 0x9209 0x935b 0x44c 0x9409 0x932e 0x44c 0x9609 0x92fb 0x44b 0x9809 0x92c8 0x435 0x9a09 0x929c 0x433 0x9c09 0x9278 0x433 0x9e0a 0x9251 0x433 0xa00a 0x9226 0x43b 0xa20a 0x91f6 0x44c 0xa40a 0x91b2 0x44b 0xa60a 0x916e 0x436 0xa80a 0x9138 0x458 0xaa0a 0x90ee 0x456 0xac0a 0x909d 0x436 0xae0b 0x9064 0x421 0xb00b 0x9055 0x437 0xb20b 0x904c 0x44c 0xb40b 0x903b 0x462 0xb60b 0x902a 0x49b 0xb80b 0x9001 0x4db 0xba0b 0x8f67 0x4db 0xbc0b 0x8e15 0x4b0 0xbe0c 0x8bff 0x4be 0xc00c 0x8943 0x513 0xc20c 0x84fb 0x5a8 0xc40c 0x7afc 0x13f9 0xc60c 0x73a0 0xfb9>;
		battery0_profile_t2_num = <0x64>;
		battery0_profile_t2_col = <0x03>;
		battery0_profile_t2 = <0x00 0xac94 0x6c2 0x200 0xac0b 0x6be 0x400 0xab98 0x6cf 0x600 0xab2f 0x6d6 0x800 0xaac4 0x6d6 0xa01 0xaa58 0x6d6 0xc01 0xa9f0 0x6d3 0xe01 0xa981 0x6be 0x1001 0xa912 0x6d2 0x1201 0xa89d 0x6c5 0x1401 0xa825 0x6bd 0x1601 0xa7ae 0x6bd 0x1801 0xa736 0x6bd 0x1a02 0xa6be 0x6bb 0x1c02 0xa63e 0x6a5 0x1e02 0xa5c6 0x6b8 0x2002 0xa548 0x6ad 0x2202 0xa4cd 0x6b1 0x2402 0xa454 0x6bd 0x2602 0xa3db 0x6bd 0x2802 0xa364 0x6bd 0x2a03 0xa2ec 0x6bd 0x2c03 0xa275 0x6bd 0x2e03 0xa1fd 0x6bd 0x3003 0xa18b 0x6ca 0x3203 0xa118 0x6d6 0x3403 0xa0a3 0x6d6 0x3603 0xa034 0x6d8 0x3803 0x9fc5 0x6ed 0x3a04 0x9f5e 0x702 0x3c04 0x9ef7 0x718 0x3e04 0x9e91 0x739 0x4004 0x9e27 0x75b 0x4204 0x9dba 0x76c 0x4404 0x9d54 0x76d 0x4604 0x9ced 0x782 0x4804 0x9c8e 0x798 0x4a04 0x9c30 0x79e 0x4c05 0x9bd2 0x7a9 0x4e05 0x9b75 0x7bf 0x5005 0x9b13 0x7cc 0x5205 0x9aa4 0x7b6 0x5405 0x9a24 0x78c 0x5605 0x9996 0x72b 0x5805 0x9910 0x6cf 0x5a05 0x9899 0x684 0x5c06 0x9832 0x659 0x5e06 0x97de 0x656 0x6006 0x9791 0x640 0x6206 0x974d 0x640 0x6406 0x970f 0x640 0x6606 0x96d4 0x64e 0x6806 0x9698 0x659 0x6a06 0x965e 0x659 0x6c07 0x962b 0x659 0x6e07 0x95f7 0x659 0x7007 0x95c4 0x659 0x7207 0x9591 0x659 0x7407 0x9563 0x659 0x7607 0x9538 0x663 0x7807 0x9510 0x672 0x7a07 0x94ee 0x674 0x7c08 0x94cc 0x68a 0x7e08 0x94aa 0x69f 0x8008 0x9481 0x6a4 0x8208 0x9461 0x6b1 0x8408 0x9443 0x6bd 0x8608 0x9423 0x6bd 0x8808 0x9409 0x6bd 0x8a08 0x93e7 0x6bd 0x8c08 0x93cd 0x6bd 0x8e09 0x93b3 0x6bd 0x9009 0x9394 0x6bd 0x9209 0x9372 0x6b4 0x9409 0x934e 0x6a4 0x9609 0x9324 0x6a4 0x9809 0x92f9 0x6a4 0x9a09 0x92ce 0x6b7 0x9c09 0x92aa 0x6cc 0x9e0a 0x9283 0x6e2 0xa00a 0x9252 0x6f7 0xa20a 0x9214 0x708 0xa40a 0x91d0 0x70a 0xa60a 0x9195 0x74a 0xa80a 0x9152 0x753 0xaa0a 0x9102 0x770 0xac0a 0x90b1 0x7a6 0xae0b 0x9072 0x7d7 0xb00b 0x9052 0x7f8 0xb20b 0x9038 0x84e 0xb40b 0x9027 0x8a4 0xb60b 0x9007 0x90b 0xb80b 0x8fd4 0x9af 0xba0b 0x8f42 0xa6f 0xbc0b 0x8dff 0xb4c 0xbe0c 0x8bde 0xc94 0xc00c 0x8911 0xeea 0xc20c 0x84b8 0x140c 0xc40c 0x7cb6 0x235e 0xc60c 0x71f2 0xbea>;
		battery0_profile_t3_num = <0x64>;
		battery0_profile_t3_col = <0x03>;
		battery0_profile_t3 = <0x00 0xaca8 0xb54 0x200 0xac0e 0xb54 0x400 0xab8a 0xb42 0x600 0xab15 0xb57 0x800 0xaaaa 0xb6d 0xa01 0xaa41 0xb66 0xc01 0xa9d2 0xb54 0xe01 0xa963 0xb54 0x1001 0xa8f4 0xb54 0x1201 0xa87f 0xb43 0x1401 0xa80c 0xb3b 0x1601 0xa79a 0xb3b 0x1801 0xa722 0xb35 0x1a02 0xa6aa 0xb20 0x1c02 0xa62a 0xb0a 0x1e02 0xa5b2 0xb09 0x2002 0xa53a 0xb19 0x2202 0xa4bd 0xb15 0x2402 0xa440 0xb00 0x2602 0xa3c7 0xaf0 0x2802 0xa350 0xaf0 0x2a03 0xa2d8 0xaf0 0x2c03 0xa269 0xb04 0x2e03 0xa1f3 0xaf9 0x3003 0xa17c 0xb09 0x3203 0xa108 0xb22 0x3403 0xa099 0xb22 0x3603 0xa02a 0xb24 0x3803 0x9fbb 0xb39 0x3a04 0x9f54 0xb61 0x3c04 0x9ee7 0xb7d 0x3e04 0x9e7d 0xb9e 0x4004 0x9e10 0xbb8 0x4204 0x9d9a 0xbb8 0x4404 0x9d2c 0xbb8 0x4604 0x9cc5 0xbb8 0x4804 0x9c57 0xba5 0x4a04 0x9bee 0xb90 0x4c05 0x9b91 0xb91 0x4e05 0x9b32 0xb97 0x5005 0x9ac0 0xb7a 0x5205 0x9a40 0xb3a 0x5405 0x99c0 0xae4 0x5605 0x9940 0xa8f 0x5805 0x98cc 0xa56 0x5a05 0x9865 0xa36 0x5c06 0x980a 0xa28 0x5e06 0x97b5 0xa21 0x6006 0x975f 0x9f7 0x6206 0x971b 0xa0b 0x6406 0x96dd 0xa20 0x6606 0x96a2 0xa28 0x6806 0x9666 0xa28 0x6a06 0x962a 0xa2e 0x6c07 0x95ef 0xa41 0x6e07 0x95bb 0xa41 0x7007 0x9590 0xa56 0x7207 0x955f 0xa6b 0x7407 0x9531 0xa80 0x7607 0x9506 0xa8c 0x7807 0x94de 0xa98 0x7a07 0x94bb 0xabe 0x7c08 0x9490 0xabe 0x7e08 0x946e 0xad2 0x8008 0x9452 0xaf8 0x8208 0x9433 0xb09 0x8408 0x9415 0xb12 0x8608 0x93fb 0xb22 0x8808 0x93e3 0xb28 0x8a08 0x93d1 0xb68 0x8c08 0x93c0 0xb94 0x8e09 0x93af 0xbbf 0x9009 0x939e 0xbf6 0x9209 0x938a 0xc36 0x9409 0x936e 0xc6c 0x9609 0x934c 0xc82 0x9809 0x9321 0xcad 0x9a09 0x92ef 0xcfe 0x9c09 0x92bb 0xd44 0x9e0a 0x9288 0xda6 0xa00a 0x9252 0xe1f 0xa20a 0x9213 0xe92 0xa40a 0x91c6 0xf27 0xa60a 0x9182 0xfbc 0xa80a 0x913e 0x1076 0xaa0a 0x90e8 0x1136 0xac0a 0x908a 0x1201 0xae0b 0x903d 0x12e5 0xb00b 0x9014 0x13f1 0xb20b 0x8ff1 0x1538 0xb40b 0x8fcf 0x16b8 0xb60b 0x8fa6 0x18c8 0xb80b 0x8f6a 0x1b83 0xba0b 0x8ed4 0x1f24 0xbc0b 0x8d93 0x2469 0xbe0c 0x8b7b 0x2e15 0xc00c 0x88b7 0x4416 0xc20c 0x84d1 0x3acc 0xc40c 0x826e 0x34bc 0xc60c 0x826e 0x34bc>;
		battery0_profile_t4_num = <0x64>;
		battery0_profile_t4_col = <0x03>;
		battery0_profile_t4 = <0x00 0xacbc 0x15e0 0x200 0xabf8 0x15e0 0x400 0xab5e 0x1603 0x600 0xaad2 0x1612 0x800 0xaa4e 0x1608 0xa01 0xa9ce 0x15f2 0xc01 0xa94f 0x15e0 0xe01 0xa8d8 0x15e0 0x1001 0xa858 0x15b7 0x1201 0xa7df 0x159d 0x1401 0xa767 0x157a 0x1601 0xa6f0 0x1563 0x1801 0xa678 0x1551 0x1a02 0xa601 0x151a 0x1c02 0xa589 0x1530 0x1e02 0xa50a 0x151d 0x2002 0xa490 0x14f7 0x2202 0xa41e 0x1500 0x2402 0xa3aa 0x150f 0x2602 0xa331 0x14ff 0x2802 0xa2ba 0x14fd 0x2a03 0xa242 0x14e7 0x2c03 0xa1d3 0x14fa 0x2e03 0xa15d 0x14ef 0x3003 0xa0eb 0x14e6 0x3203 0xa07c 0x14ef 0x3403 0xa00f 0x1504 0x3603 0x9fa8 0x151a 0x3803 0x9f39 0x152f 0x3a04 0x9ec2 0x1531 0x3c04 0x9e4b 0x1541 0x3e04 0x9dcf 0x1532 0x4004 0x9d4f 0x1508 0x4204 0x9cd2 0x14e1 0x4404 0x9c63 0x14cb 0x4604 0x9beb 0x14a0 0x4804 0x9b7b 0x1476 0x4a04 0x9b18 0x1478 0x4c05 0x9ab1 0x1460 0x4e05 0x9a42 0x1437 0x5005 0x99d2 0x142b 0x5205 0x995b 0x13ec 0x5405 0x98f4 0x13ec 0x5605 0x988e 0x13c8 0x5805 0x982d 0x13ba 0x5a05 0x97cf 0x13af 0x5c06 0x9777 0x13a8 0x5e06 0x972a 0x13ba 0x6006 0x96dd 0x13ba 0x6206 0x9699 0x13cf 0x6406 0x965b 0x13e4 0x6606 0x9620 0x1407 0x6806 0x95e8 0x143c 0x6a06 0x95b2 0x1469 0x6c07 0x9578 0x146f 0x6e07 0x954d 0x149a 0x7007 0x9522 0x14d9 0x7207 0x94f8 0x1519 0x7407 0x94cd 0x154c 0x7607 0x94a6 0x1577 0x7807 0x9487 0x15a7 0x7a07 0x946d 0x15e5 0x7c08 0x9453 0x1610 0x7e08 0x943a 0x1663 0x8008 0x9427 0x16b8 0x8208 0x9416 0x170d 0x8408 0x9405 0x177e 0x8608 0x93f1 0x1803 0x8808 0x93d9 0x185e 0x8a08 0x93c7 0x18f3 0x8c08 0x93af 0x1975 0x8e09 0x9395 0x1a05 0x9009 0x937b 0x1aa7 0x9209 0x9362 0x1b5a 0x9409 0x9346 0x1c1f 0x9609 0x9324 0x1cf3 0x9809 0x92f9 0x1db3 0x9a09 0x92ce 0x1e86 0x9c09 0x929d 0x1f89 0x9e0a 0x9261 0x207c 0xa00a 0x921d 0x2169 0xa20a 0x91d8 0x2287 0xa40a 0x9194 0x23c8 0xa60a 0x9150 0x2533 0xa80a 0x90fd 0x268b 0xaa0a 0x90a8 0x282a 0xac0a 0x9057 0x2a15 0xae0b 0x9013 0x2c48 0xb00b 0x8fe1 0x2ed9 0xb20b 0x8fb5 0x322c 0xb40b 0x8f93 0x3682 0xb60b 0x8f6a 0x3c76 0xb80b 0x8f2e 0x4513 0xba0b 0x8ec2 0x4f7d 0xbc0b 0x8db8 0x50ea 0xbe0c 0x8bbe 0x4c41 0xc00c 0x8b10 0x4b32 0xc20c 0x8b10 0x4b32 0xc40c 0x8b10 0x4b32 0xc60c 0x8b10 0x4b32>;
		battery1_profile_t0_num = <0x64>;
		battery1_profile_t0_col = <0x03>;
		battery1_profile_t0 = <0x00 0xace4 0x3a2 0x205 0xac5a 0x39e 0x40a 0xabdf 0x38b 0x610 0xab6c 0x384 0x815 0xab00 0x384 0xa1a 0xaa99 0x384 0xc1f 0xaa30 0x384 0xe24 0xa9c0 0x384 0x1029 0xa959 0x384 0x122f 0xa8ea 0x384 0x1434 0xa873 0x384 0x1639 0xa7ff 0x390 0x183e 0xa788 0x394 0x1a43 0xa709 0x389 0x1c48 0xa691 0x39d 0x1e4e 0xa618 0x39d 0x2053 0xa597 0x389 0x2258 0xa51d 0x394 0x245d 0xa49d 0x390 0x2662 0xa41f 0x38e 0x2867 0xa3a6 0x39d 0x2a6d 0xa32e 0x39d 0x2c72 0xa2b5 0x39d 0x2e77 0xa23c 0x39d 0x307c 0xa1c4 0x39d 0x3281 0xa14b 0x39d 0x3486 0xa0d6 0x39d 0x368c 0xa063 0x39d 0x3891 0x9fee 0x3a1 0x3a96 0x9f86 0x3b6 0x3c9b 0x9f16 0x3b6 0x3ea0 0x9ea6 0x3b6 0x40a5 0x9e3c 0x3b6 0x42ab 0x9dd5 0x3b6 0x44b0 0x9d6d 0x3b6 0x46b5 0x9d08 0x3bb 0x48ba 0x9ca9 0x3d0 0x4abf 0x9c4a 0x3e6 0x4cc5 0x9beb 0x3e8 0x4eca 0x9b8c 0x3f8 0x50cf 0x9b33 0x40d 0x52d4 0x9ad9 0x42c 0x54d9 0x9a71 0x447 0x56de 0x99eb 0x429 0x58e4 0x9936 0x3bd 0x5ae9 0x98b1 0x38e 0x5cee 0x9851 0x395 0x5ef3 0x9800 0x39d 0x60f8 0x97b3 0x393 0x62fd 0x976a 0x38a 0x6503 0x972d 0x39a 0x6708 0x96e8 0x385 0x690d 0x96ab 0x384 0x6b12 0x9675 0x384 0x6d17 0x963b 0x384 0x6f1c 0x9604 0x384 0x7122 0x95d0 0x384 0x7327 0x959e 0x384 0x752c 0x9573 0x385 0x7731 0x9548 0x39a 0x7936 0x951c 0x39d 0x7b3b 0x94f1 0x39d 0x7d41 0x94cb 0x3a9 0x7f46 0x94a5 0x3ae 0x814b 0x947c 0x3a2 0x8350 0x945a 0x3b8 0x8555 0x9440 0x3cd 0x875b 0x9417 0x3bb 0x8960 0x93f9 0x3d6 0x8b65 0x93ca 0x3cf 0x8d6a 0x9387 0x3ad 0x8f6f 0x9337 0x391 0x9174 0x92e4 0x36d 0x937a 0x92b1 0x383 0x957f 0x928d 0x398 0x9784 0x9256 0x38c 0x9989 0x9225 0x392 0x9b8e 0x91fa 0x39d 0x9d93 0x91d1 0x3a4 0x9f99 0x91ae 0x3b6 0xa19e 0x9183 0x3b6 0xa3a3 0x914f 0x3b6 0xa5a8 0x910d 0x3a4 0xa7ad 0x90ce 0x39d 0xa9b2 0x9091 0x3b3 0xabb8 0x904c 0x3c0 0xadbd 0x8ffb 0x395 0xafc2 0x8fc0 0x36c 0xb1c7 0x8fb7 0x382 0xb3cc 0x8fae 0x3aa 0xb5d1 0x8f9f 0x3d5 0xb7d7 0x8f89 0x40d 0xb9dc 0x8f5b 0x444 0xbbe1 0x8ed0 0x445 0xbde6 0x8d7a 0x3d5 0xbfeb 0x8b8f 0x415 0xc1f0 0x88e4 0x442 0xc3f6 0x8515 0x4d0 0xc5fb 0x7e2c 0xceb 0xc800 0x7288 0xd61>;
		battery1_profile_t1_num = <0x64>;
		battery1_profile_t1_col = <0x03>;
		battery1_profile_t1 = <0x00 0xac76 0x47e 0x205 0xac06 0x47e 0x40a 0xab9d 0x47e 0x610 0xab36 0x47e 0x815 0xaace 0x47e 0xa1a 0xaa64 0x476 0xc1f 0xa9f5 0x469 0xe24 0xa98e 0x47e 0x1029 0xa91e 0x47e 0x122f 0xa8a6 0x47e 0x1434 0xa82d 0x47e 0x1639 0xa7b5 0x47e 0x183e 0xa738 0x475 0x1a43 0xa6b9 0x465 0x1c48 0xa640 0x465 0x1e4e 0xa5bf 0x465 0x2053 0xa545 0x465 0x2258 0xa4c6 0x465 0x245d 0xa449 0x465 0x2662 0xa3cf 0x46f 0x2867 0xa356 0x47e 0x2a6d 0xa2de 0x47e 0x2c72 0xa265 0x47e 0x2e77 0xa1ec 0x47e 0x307c 0xa17b 0x490 0x3281 0xa105 0x497 0x3486 0xa090 0x497 0x368c 0xa020 0x497 0x3891 0x9fb0 0x49b 0x3a96 0x9f40 0x4b0 0x3c9b 0x9ed9 0x4c6 0x3ea0 0x9e72 0x4c9 0x40a5 0x9e0a 0x4d8 0x42ab 0x9da3 0x4ee 0x44b0 0x9d3b 0x503 0x46b5 0x9cd4 0x514 0x48ba 0x9c6d 0x516 0x4abf 0x9c0e 0x541 0x4cc5 0x9baf 0x559 0x4eca 0x9b50 0x57f 0x50cf 0x9ae8 0x585 0x52d4 0x9a6d 0x554 0x54d9 0x99e1 0x4fe 0x56de 0x9950 0x4aa 0x58e4 0x98cf 0x469 0x5ae9 0x986e 0x451 0x5cee 0x9815 0x44c 0x5ef3 0x97c4 0x43f 0x60f8 0x977b 0x433 0x62fd 0x9738 0x433 0x6503 0x96fc 0x433 0x6708 0x96c0 0x433 0x690d 0x9683 0x433 0x6b12 0x964d 0x433 0x6d17 0x961f 0x441 0x6f1c 0x95f0 0x441 0x7122 0x95bc 0x433 0x7327 0x958a 0x433 0x752c 0x955f 0x433 0x7731 0x9534 0x433 0x7936 0x9510 0x446 0x7b3b 0x94ee 0x45b 0x7d41 0x94cb 0x465 0x7f46 0x94a9 0x46d 0x814b 0x9486 0x47e 0x8350 0x9464 0x480 0x8555 0x944a 0x495 0x875b 0x9429 0x497 0x8960 0x9406 0x497 0x8b65 0x93df 0x48a 0x8d6a 0x93b3 0x475 0x8f6f 0x9386 0x459 0x9174 0x9354 0x435 0x937a 0x9332 0x44b 0x957f 0x9307 0x44c 0x9784 0x92d5 0x43b 0x9989 0x92a7 0x433 0x9b8e 0x9280 0x433 0x9d93 0x925d 0x43a 0x9f99 0x9238 0x44c 0xa19e 0x9205 0x44c 0xa3a3 0x91c0 0x44c 0xa5a8 0x9182 0x45e 0xa7ad 0x9146 0x465 0xa9b2 0x9105 0x470 0xabb8 0x90ba 0x477 0xadbd 0x906f 0x465 0xafc2 0x9056 0x466 0xb1c7 0x9044 0x47c 0xb3cc 0x903a 0x4a4 0xb5d1 0x902b 0x4cf 0xb7d7 0x9010 0x513 0xb9dc 0x8fbd 0x54f 0xbbe1 0x8edc 0x554 0xbde6 0x8d17 0x534 0xbfeb 0x8abb 0x58b 0xc1f0 0x8759 0x61d 0xc3f6 0x81b0 0x81e 0xc5fb 0x76ed 0x17ee 0xc800 0x74ae 0x1243>;
		battery1_profile_t2_num = <0x64>;
		battery1_profile_t2_col = <0x03>;
		battery1_profile_t2 = <0x00 0xac76 0x9c4 0x205 0xabec 0x9c4 0x40a 0xab78 0x9e8 0x610 0xab08 0x9d9 0x815 0xaa9c 0x9da 0xa1a 0xaa32 0x9df 0xc1f 0xa9c3 0x9af 0xe24 0xa95b 0x9c2 0x1029 0xa8e3 0x997 0x122f 0xa86a 0x992 0x1434 0xa7f1 0x983 0x1639 0xa779 0x96d 0x183e 0xa6fc 0x957 0x1a43 0xa67d 0x94c 0x1c48 0xa604 0x95e 0x1e4e 0xa583 0x949 0x2053 0xa501 0x933 0x2258 0xa487 0x92e 0x245d 0xa40d 0x92e 0x2662 0xa393 0x92e 0x2867 0xa31a 0x92e 0x2a6d 0xa2a2 0x92e 0x2c72 0xa229 0x92e 0x2e77 0xa1b0 0x92e 0x307c 0xa138 0x92e 0x3281 0xa0c4 0x92e 0x3486 0xa054 0x939 0x368c 0x9fe4 0x94e 0x3891 0x9f74 0x960 0x3a96 0x9f05 0x961 0x3c9b 0x9ea6 0x9a2 0x3ea0 0x9e38 0x9bd 0x40a5 0x9dc2 0x9c4 0x42ab 0x9d4e 0x9c4 0x44b0 0x9ce1 0x9c4 0x46b5 0x9c7c 0x9c9 0x48ba 0x9c1c 0x9dd 0x4abf 0x9bb5 0x9dd 0x4cc5 0x9b4d 0x9dd 0x4eca 0x9ae6 0x9dd 0x50cf 0x9a75 0x9c4 0x52d4 0x99f5 0x987 0x54d9 0x996d 0x937 0x56de 0x98ed 0x8f6 0x58e4 0x9874 0x8b5 0x5ae9 0x9814 0x89d 0x5cee 0x97bb 0x887 0x5ef3 0x976a 0x872 0x60f8 0x9721 0x870 0x62fd 0x96de 0x87f 0x6503 0x96a2 0x87f 0x6708 0x9666 0x87f 0x690d 0x9629 0x894 0x6b12 0x95f3 0x8aa 0x6d17 0x95bf 0x8b1 0x6f1c 0x958c 0x8bc 0x7122 0x955b 0x8d2 0x7327 0x9530 0x8e7 0x752c 0x9505 0x8fc 0x7731 0x94da 0x8fc 0x7936 0x94b6 0x934 0x7b3b 0x948d 0x956 0x7d41 0x9467 0x96c 0x7f46 0x9445 0x971 0x814b 0x9424 0x965 0x8350 0x940a 0x97c 0x8555 0x93f0 0x9a7 0x875b 0x93d6 0x9bf 0x8960 0x93bd 0x9c4 0x8b65 0x93a3 0x9d1 0x8d6a 0x938d 0x9f0 0x8f6f 0x9379 0xa0f 0x9174 0x935e 0xa16 0x937a 0x933c 0xa57 0x957f 0x9311 0xa5a 0x9784 0x92e6 0xa6b 0x9989 0x92bb 0xa9c 0x9b8e 0x9290 0xadc 0x9d93 0x9262 0xb1d 0x9f99 0x922d 0xb64 0xa19e 0x91f1 0xbd0 0xa3a3 0x91ac 0xc51 0xa5a8 0x9167 0xcae 0xa7ad 0x911c 0xd13 0xa9b2 0x90ca 0xd95 0xabb8 0x907a 0xe2b 0xadbd 0x903c 0xed6 0xafc2 0x9019 0xfda 0xb1c7 0x8ff6 0x110d 0xb3cc 0x8fdb 0x129b 0xb5d1 0x8fae 0x1492 0xb7d7 0x8f5d 0x1727 0xb9dc 0x8eb7 0x1a56 0xbbe1 0x8d7b 0x1e7e 0xbde6 0x8b7c 0x2542 0xbfeb 0x88a8 0x3391 0xc1f0 0x849f 0x3a45 0xc3f6 0x7d24 0x27ae 0xc5fb 0x7a80 0x20d0 0xc800 0x7a80 0x20d0>;
		battery1_profile_t3_num = <0x64>;
		battery1_profile_t3_col = <0x03>;
		battery1_profile_t3 = <0x00 0xac8a 0x9c4 0x205 0xabe6 0x1285 0x40a 0xab5f 0x1446 0x610 0xaae4 0x144c 0x815 0xaa6b 0x1437 0xa1a 0xa9f3 0x1428 0xc1f 0xa97a 0x1401 0xe24 0xa901 0x13e9 0x1029 0xa880 0x13a9 0x122f 0xa806 0x138e 0x1434 0xa78d 0x1369 0x1639 0xa710 0x1356 0x183e 0xa692 0x133c 0x1a43 0xa617 0x1301 0x1c48 0xa596 0x12d6 0x1e4e 0xa515 0x12ab 0x2053 0xa49b 0x12a7 0x2258 0xa423 0x12a7 0x245d 0xa3a9 0x1280 0x2662 0xa32f 0x125c 0x2867 0xa2b6 0x1256 0x2a6d 0xa23e 0x1240 0x2c72 0xa1c5 0x122b 0x2e77 0xa14c 0x1200 0x307c 0xa0db 0x122d 0x3281 0xa06a 0x1235 0x3486 0x9ffa 0x121f 0x368c 0x9f8d 0x121f 0x3891 0x9f24 0x124b 0x3a96 0x9eb4 0x1275 0x3c9b 0x9e44 0x1275 0x3ea0 0x9dcd 0x1275 0x40a5 0x9d4e 0x1266 0x42ab 0x9cd6 0x1245 0x44b0 0x9c66 0x1222 0x46b5 0x9bfa 0x1211 0x48ba 0x9b9a 0x1210 0x4abf 0x9b2a 0x11fa 0x4cc5 0x9aba 0x11d1 0x4eca 0x9a4a 0x11c6 0x50cf 0x99d5 0x11a1 0x52d4 0x995c 0x1169 0x54d9 0x98e6 0x113e 0x56de 0x9876 0x1115 0x58e4 0x980f 0x10ff 0x5ae9 0x97b0 0x10fe 0x5cee 0x975e 0x10fe 0x5ef3 0x9710 0x110b 0x60f8 0x96c7 0x1121 0x62fd 0x9684 0x113d 0x6503 0x9648 0x1168 0x6708 0x960c 0x1193 0x690d 0x95d8 0x11a9 0x6b12 0x95a3 0x11f4 0x6d17 0x956f 0x1211 0x6f1c 0x953c 0x1227 0x7122 0x950e 0x125a 0x7327 0x94ea 0x129a 0x752c 0x94bf 0x12d9 0x7731 0x9494 0x12d9 0x7936 0x9470 0x1324 0x7b3b 0x944e 0x135c 0x7d41 0x9430 0x1387 0x7f46 0x9416 0x13c3 0x814b 0x9400 0x1419 0x8350 0x93f7 0x146f 0x8555 0x93e6 0x14c5 0x875b 0x93d4 0x1508 0x8960 0x93bd 0x1589 0x8b65 0x93a8 0x15fa 0x8d6a 0x9393 0x1675 0x8f6f 0x9379 0x171c 0x9174 0x935e 0x17b9 0x937a 0x933c 0x1891 0x957f 0x9311 0x192b 0x9784 0x92e6 0x19f5 0x9989 0x92b5 0x1ae8 0x9b8e 0x9282 0x1bea 0x9d93 0x924b 0x1d07 0x9f99 0x920f 0x1e5d 0xa19e 0x91d3 0x1fa0 0xa3a3 0x9185 0x214e 0xa5a8 0x913f 0x22d9 0xa7ad 0x90f4 0x24d0 0xa9b2 0x90ab 0x270b 0xabb8 0x9069 0x2985 0xadbd 0x902e 0x2c86 0xafc2 0x8ffb 0x3028 0xb1c7 0x8fcf 0x3444 0xb3cc 0x8fa4 0x3851 0xb5d1 0x8f6c 0x3b9f 0xb7d7 0x8f1c 0x3e82 0xb9dc 0x8e97 0x41b2 0xbbe1 0x8da2 0x4678 0xbde6 0x8bea 0x4c5f 0xbfeb 0x8943 0x45ee 0xc1f0 0x7a80 0x214d 0xc3f6 0x7a80 0x214d 0xc5fb 0x7a80 0x214d 0xc800 0x7a80 0x214d>;
		battery1_profile_t4_num = <0x64>;
		battery1_profile_t4_col = <0x03>;
		battery1_profile_t4 = <0x00 0xacb2 0x299a 0x205 0xabec 0x299a 0x40a 0xab42 0x2a19 0x610 0xaa9f 0x2a66 0x815 0xa9fb 0x2a59 0xa1a 0xa95a 0x2a09 0xc1f 0xa8bf 0x29af 0xe24 0xa824 0x2995 0x1029 0xa792 0x2914 0x122f 0xa6ff 0x28a5 0x1434 0xa673 0x283a 0x1639 0xa5e4 0x27c2 0x183e 0xa558 0x2740 0x1a43 0xa4d7 0x26d4 0x1c48 0xa457 0x26a5 0x1e4e 0xa3de 0x264f 0x2053 0xa365 0x260d 0x2258 0xa2e6 0x25bc 0x245d 0xa26e 0x257f 0x2662 0xa1f9 0x2549 0x2867 0xa180 0x2502 0x2a6d 0xa10a 0x24b5 0x2c72 0xa0a2 0x24a0 0x2e77 0xa03b 0x248a 0x307c 0x9fd4 0x2474 0x3281 0x9f61 0x2451 0x3486 0x9ee8 0x241b 0x368c 0x9e6d 0x23e2 0x3891 0x9deb 0x23ab 0x3a96 0x9d6a 0x2340 0x3c9b 0x9cf1 0x2315 0x3ea0 0x9c80 0x22ea 0x40a5 0x9c16 0x22bf 0x42ab 0x9bb3 0x22ab 0x44b0 0x9b54 0x22a3 0x46b5 0x9af4 0x228d 0x48ba 0x9a8c 0x2278 0x4abf 0x9a1c 0x2262 0x4cc5 0x99ac 0x2213 0x4eca 0x9942 0x220c 0x50cf 0x98e0 0x2209 0x52d4 0x987d 0x21fc 0x54d9 0x981a 0x21f7 0x56de 0x97c4 0x21e5 0x58e4 0x976e 0x21fb 0x5ae9 0x9720 0x2224 0x5cee 0x96d9 0x223f 0x5ef3 0x9694 0x2261 0x60f8 0x9653 0x2296 0x62fd 0x9616 0x22d1 0x6503 0x95db 0x22fc 0x6708 0x95a7 0x2327 0x690d 0x9574 0x237c 0x6b12 0x9546 0x23c1 0x6d17 0x9521 0x2402 0x6f1c 0x94fa 0x244e 0x7122 0x94d5 0x24b3 0x7327 0x94bb 0x2531 0x752c 0x94a1 0x259a 0x7731 0x947e 0x25c5 0x7936 0x946b 0x264e 0x7b3b 0x945a 0x26b7 0x7d41 0x9444 0x2731 0x7f46 0x942d 0x27d0 0x814b 0x941a 0x2878 0x8350 0x9401 0x2916 0x8555 0x93f0 0x2a19 0x875b 0x93d6 0x2acd 0x8960 0x93c3 0x2bda 0x8b65 0x93ad 0x2cfb 0x8d6a 0x938f 0x2dee 0x8f6f 0x936f 0x2ecd 0x9174 0x9354 0x2ff9 0x937a 0x9332 0x3111 0x957f 0x930f 0x3229 0x9784 0x92e6 0x3330 0x9989 0x92c0 0x3433 0x9b8e 0x9296 0x352b 0x9d93 0x9262 0x3604 0x9f99 0x922d 0x36b4 0xa19e 0x91f1 0x3776 0xa3a3 0x91b4 0x3838 0xa5a8 0x9171 0x38d6 0xa7ad 0x912c 0x396d 0xa9b2 0x90e3 0x3a24 0xabb8 0x9095 0x3b0b 0xadbd 0x904e 0x3c1e 0xafc2 0x9023 0x3d7b 0xb1c7 0x9009 0x3f73 0xb3cc 0x8fef 0x425b 0xb5d1 0x8fcf 0x468c 0xb7d7 0x8fa3 0x4d46 0xb9dc 0x8f5a 0x53c0 0xbbe1 0x8e86 0x52e6 0xbde6 0x8c9d 0x4e1f 0xbfeb 0x8b88 0x4be1 0xc1f0 0x8b88 0x4be1 0xc3f6 0x8b88 0x4be1 0xc5fb 0x8b88 0x4be1 0xc800 0x8b88 0x4be1>;
		phandle = <0xae>;
	};

	md_ccif3@1023f000 {
		compatible = "mediatek,md_ccif3";
		reg = <0x00 0x1023f000 0x00 0x1000>;
	};

	sspm@10440000 {
		compatible = "mediatek,sspm";
		reg = <0x00 0x10440000 0x00 0x10000 0x00 0x10450000 0x00 0x100 0x00 0x10451000 0x00 0x08 0x00 0x10460000 0x00 0x100 0x00 0x10461000 0x00 0x08 0x00 0x10470000 0x00 0x100 0x00 0x10471000 0x00 0x08 0x00 0x10480000 0x00 0x100 0x00 0x10481000 0x00 0x08 0x00 0x10490000 0x00 0x100 0x00 0x10491000 0x00 0x08>;
		reg-names = "cfgreg", "mbox0_base", "mbox0_ctrl", "mbox1_base", "mbox1_ctrl", "mbox2_base", "mbox2_ctrl", "mbox3_base", "mbox3_ctrl", "mbox4_base", "mbox4_ctrl";
		interrupts = <0x00 0xd7 0x04 0x00 0xda 0x04 0x00 0xdb 0x04 0x00 0xdc 0x04 0x00 0xdd 0x04 0x00 0xde 0x04>;
		interrupt-names = "ipc", "mbox0", "mbox1", "mbox2", "mbox3", "mbox4";
	};

	gic500@0c000000 {
		compatible = "mediatek,gic500";
		reg = <0x00 0xc000000 0x00 0x400000>;
	};

	gic_cpu@0c400000 {
		compatible = "mediatek,gic_cpu";
		reg = <0x00 0xc400000 0x00 0x40000>;
	};

	lastbus@10001000 {
		compatible = "mediatek,lastbus-v1";
		reg = <0x00 0x10001000 0x00 0x1000 0x00 0x10003000 0x00 0x1000>;
	};

	dfd@10200b00 {
		compatible = "mediatek,dfd";
		reg = <0x00 0x10200b00 0x00 0x10000>;
		mediatek,enabled = <0x01>;
		mediatek,chain_length = <0xa7f8>;
		mediatek,rg_dfd_timeout = <0xa0>;
	};

	dfd_cache {
		compatible = "mediatek,dfd_cache";
		mediatek,enabled = <0x00>;
		mediatek,rg_dfd_timeout = <0x3e80>;
		phandle = <0xaf>;
	};

	dbg_cti@0d020000 {
		compatible = "mediatek,dbg_cti";
		reg = <0x00 0xd020000 0x00 0x10000>;
	};

	dbg_etr@0d030000 {
		compatible = "mediatek,dbg_etr";
		reg = <0x00 0xd030000 0x00 0x10000>;
	};

	dbg_funnel@0d040000 {
		compatible = "mediatek,dbg_funnel";
		reg = <0x00 0xd040000 0x00 0x10000>;
	};

	dbg_dem@0d0a0000 {
		compatible = "mediatek,dbg_dem";
		reg = <0x00 0xd0a0000 0x00 0x10000>;
		interrupts = <0x00 0x9d 0x08>;
	};

	dbg_mdsys1@0d0c0000 {
		compatible = "mediatek,dbg_mdsys1";
		reg = <0x00 0xd0c0000 0x00 0x40000>;
	};

	dbg_apmcu_mp0@0d400000 {
		compatible = "mediatek,dbg_apmcu_mp0";
		reg = <0x00 0xd400000 0x00 0x1000>;
	};

	dbg_apmcu_mp0@0d410000 {
		compatible = "mediatek,dbg_apmcu_mp0";
		reg = <0x00 0xd410000 0x00 0x1000>;
	};

	dbg_apmcu_mp0@0d420000 {
		compatible = "mediatek,dbg_apmcu_mp0";
		reg = <0x00 0xd420000 0x00 0x1000>;
	};

	dbg_apmcu_mp0@0d430000 {
		compatible = "mediatek,dbg_apmcu_mp0";
		reg = <0x00 0xd430000 0x00 0x1000>;
	};

	dbg_apmcu_mp0@0d440000 {
		compatible = "mediatek,dbg_apmcu_mp0";
		reg = <0x00 0xd440000 0x00 0x1000>;
	};

	dbg_apmcu_mp0@0d510000 {
		compatible = "mediatek,dbg_apmcu_mp0";
		reg = <0x00 0xd510000 0x00 0x1000>;
	};

	dbg_apmcu_mp0@0d520000 {
		compatible = "mediatek,dbg_apmcu_mp0";
		reg = <0x00 0xd520000 0x00 0x1000>;
	};

	dbg_apmcu_mp0@0d530000 {
		compatible = "mediatek,dbg_apmcu_mp0";
		reg = <0x00 0xd530000 0x00 0x1000>;
	};

	dbg_apmcu_mp0@0d540000 {
		compatible = "mediatek,dbg_apmcu_mp0";
		reg = <0x00 0xd540000 0x00 0x1000>;
	};

	dbg_apmcu_mp0@0d610000 {
		compatible = "mediatek,dbg_apmcu_mp0";
		reg = <0x00 0xd610000 0x00 0x1000>;
	};

	dbg_apmcu_mp0@0d620000 {
		compatible = "mediatek,dbg_apmcu_mp0";
		reg = <0x00 0xd620000 0x00 0x1000>;
	};

	dbg_apmcu_mp0@0d630000 {
		compatible = "mediatek,dbg_apmcu_mp0";
		reg = <0x00 0xd630000 0x00 0x1000>;
	};

	dbg_apmcu_mp0@0d640000 {
		compatible = "mediatek,dbg_apmcu_mp0";
		reg = <0x00 0xd640000 0x00 0x1000>;
	};

	dbg_apmcu_mp0@0d710000 {
		compatible = "mediatek,dbg_apmcu_mp0";
		reg = <0x00 0xd710000 0x00 0x1000>;
	};

	dbg_apmcu_mp0@0d720000 {
		compatible = "mediatek,dbg_apmcu_mp0";
		reg = <0x00 0xd720000 0x00 0x1000>;
	};

	dbg_apmcu_mp0@0d730000 {
		compatible = "mediatek,dbg_apmcu_mp0";
		reg = <0x00 0xd730000 0x00 0x1000>;
	};

	dbg_apmcu_mp0@0d740000 {
		compatible = "mediatek,dbg_apmcu_mp0";
		reg = <0x00 0xd740000 0x00 0x1000>;
	};

	dbg_apmcu_mp1@0d800000 {
		compatible = "mediatek,dbg_apmcu_mp1";
		reg = <0x00 0xd800000 0x00 0x1000>;
	};

	dbg_apmcu_mp1@0d810000 {
		compatible = "mediatek,dbg_apmcu_mp1";
		reg = <0x00 0xd810000 0x00 0x1000>;
	};

	dbg_apmcu_mp1@0d820000 {
		compatible = "mediatek,dbg_apmcu_mp1";
		reg = <0x00 0xd820000 0x00 0x1000>;
	};

	dbg_apmcu_mp1@0d830000 {
		compatible = "mediatek,dbg_apmcu_mp1";
		reg = <0x00 0xd830000 0x00 0x1000>;
	};

	dbg_apmcu_mp1@0d840000 {
		compatible = "mediatek,dbg_apmcu_mp1";
		reg = <0x00 0xd840000 0x00 0x1000>;
	};

	dbg_apmcu_mp1@0d910000 {
		compatible = "mediatek,dbg_apmcu_mp1";
		reg = <0x00 0xd910000 0x00 0x1000>;
	};

	dbg_apmcu_mp1@0d920000 {
		compatible = "mediatek,dbg_apmcu_mp1";
		reg = <0x00 0xd920000 0x00 0x1000>;
	};

	dbg_apmcu_mp1@0d930000 {
		compatible = "mediatek,dbg_apmcu_mp1";
		reg = <0x00 0xd930000 0x00 0x1000>;
	};

	dbg_apmcu_mp1@0d940000 {
		compatible = "mediatek,dbg_apmcu_mp1";
		reg = <0x00 0xd940000 0x00 0x1000>;
	};

	dbg_apmcu_mp1@0da10000 {
		compatible = "mediatek,dbg_apmcu_mp1";
		reg = <0x00 0xda10000 0x00 0x1000>;
	};

	dbg_apmcu_mp1@0da20000 {
		compatible = "mediatek,dbg_apmcu_mp1";
		reg = <0x00 0xda20000 0x00 0x1000>;
	};

	dbg_apmcu_mp1@0da30000 {
		compatible = "mediatek,dbg_apmcu_mp1";
		reg = <0x00 0xda30000 0x00 0x1000>;
	};

	dbg_apmcu_mp1@0da40000 {
		compatible = "mediatek,dbg_apmcu_mp1";
		reg = <0x00 0xda40000 0x00 0x1000>;
	};

	dbg_apmcu_mp1@0db10000 {
		compatible = "mediatek,dbg_apmcu_mp1";
		reg = <0x00 0xdb10000 0x00 0x1000>;
	};

	dbg_apmcu_mp1@0db20000 {
		compatible = "mediatek,dbg_apmcu_mp1";
		reg = <0x00 0xdb20000 0x00 0x1000>;
	};

	dbg_apmcu_mp1@0db30000 {
		compatible = "mediatek,dbg_apmcu_mp1";
		reg = <0x00 0xdb30000 0x00 0x1000>;
	};

	dbg_apmcu_mp1@0db40000 {
		compatible = "mediatek,dbg_apmcu_mp1";
		reg = <0x00 0xdb40000 0x00 0x1000>;
	};

	infra_dbgsystop_cpu0@0e000000 {
		compatible = "mediatek,infra_dbgsystop_cpu0";
		reg = <0x00 0xe000000 0x00 0x100000>;
	};

	infra_dbgsystop_cpu1@0e100000 {
		compatible = "mediatek,infra_dbgsystop_cpu1";
		reg = <0x00 0xe100000 0x00 0x100000>;
	};

	infra_dbgsystop_cpu2@0e200000 {
		compatible = "mediatek,infra_dbgsystop_cpu2";
		reg = <0x00 0xe200000 0x00 0x100000>;
	};

	infra_dbgsystop_cpu3@0e300000 {
		compatible = "mediatek,infra_dbgsystop_cpu3";
		reg = <0x00 0xe300000 0x00 0x100000>;
	};

	infra_dbgsystop_cpu4@0e400000 {
		compatible = "mediatek,infra_dbgsystop_cpu4";
		reg = <0x00 0xe400000 0x00 0x100000>;
	};

	infra_dbgsystop_cpu5@0e500000 {
		compatible = "mediatek,infra_dbgsystop_cpu5";
		reg = <0x00 0xe500000 0x00 0x100000>;
	};

	infra_dbgsystop_cpu6@0e600000 {
		compatible = "mediatek,infra_dbgsystop_cpu6";
		reg = <0x00 0xe600000 0x00 0x100000>;
	};

	infra_dbgsystop_cpu7@0e700000 {
		compatible = "mediatek,infra_dbgsystop_cpu7";
		reg = <0x00 0xe700000 0x00 0x100000>;
	};

	ap_dma@11000000 {
		compatible = "mediatek,ap_dma";
		reg = <0x00 0x11000000 0x00 0x1000>;
		interrupts = <0x00 0x66 0x08>;
	};

	auxadc@11001000 {
		compatible = "mediatek,mt6768-auxadc";
		reg = <0x00 0x11001000 0x00 0x1000>;
		interrupts = <0x00 0x42 0x02>;
		clocks = <0x21 0x21>;
		clock-names = "main";
		#io-channel-cells = <0x01>;
		mediatek,cali-en-bit = <0x14>;
		mediatek,cali-ge-bit = <0x0a>;
		mediatek,cali-oe-bit = <0x00>;
		mediatek,cali-efuse-index = <0x6a>;
		phandle = <0x23>;
	};

	dma-controller@11000980 {
		compatible = "mediatek,mt6577-uart-dma";
		reg = <0x00 0x11000980 0x00 0x80 0x00 0x11000a00 0x00 0x80 0x00 0x11000a80 0x00 0x80 0x00 0x11000b00 0x00 0x80>;
		interrupts = <0x00 0x66 0x08 0x00 0x67 0x08 0x00 0x68 0x08 0x00 0x72 0x08>;
		clocks = <0x21 0x26>;
		clock-names = "apdma";
		#dma-cells = <0x01>;
		dma-bits = <0x22>;
		phandle = <0x30>;
	};

	serial@11002000 {
		compatible = "mediatek,mt6577-uart";
		reg = <0x00 0x11002000 0x00 0x1000>;
		interrupts = <0x00 0x70 0x08>;
		clocks = <0x13 0x21 0x16>;
		clock-names = "baud", "bus";
		dmas = <0x30 0x00 0x30 0x01>;
		dma-names = "tx", "rx";
		phandle = <0xb0>;
	};

	serial@11003000 {
		compatible = "mediatek,mt6577-uart";
		reg = <0x00 0x11003000 0x00 0x1000>;
		interrupts = <0x00 0x71 0x08>;
		clocks = <0x13 0x21 0x17>;
		clock-names = "baud", "bus";
		dmas = <0x30 0x02 0x30 0x03>;
		dma-names = "tx", "rx";
		phandle = <0xb1>;
	};

	i2c_common {
		compatible = "mediatek,i2c_common";
		dma_support = [03];
		idvfs = [01];
		set_dt_div = [01];
		check_max_freq = [01];
		ver = [02];
		set_ltiming = [01];
		ext_time_config = [18 01];
		cnt_constraint = [01];
		control_irq_sel = [01];
		phandle = <0xb2>;
	};

	pwm@11006000 {
		compatible = "mediatek,pwm";
		reg = <0x00 0x11006000 0x00 0x1000>;
		interrupts = <0x00 0x62 0x08>;
		clocks = <0x21 0x10 0x21 0x11 0x21 0x12 0x21 0x13 0x21 0x14 0x21 0x30 0x21 0x0f 0x21 0x15>;
		clock-names = "PWM1-main", "PWM2-main", "PWM3-main", "PWM4-main", "PWM5-main", "PWM6-main", "PWM-HCLK-main", "PWM-main";
	};

	i2c0@11007000 {
		compatible = "mediatek,i2c";
		id = <0x00>;
		reg = <0x00 0x11007000 0x00 0x1000 0x00 0x11000080 0x00 0x80>;
		interrupts = <0x00 0x69 0x08>;
		clocks = <0x21 0x0b 0x21 0x26>;
		clock-names = "main", "dma";
		clock-div = <0x05>;
		scl-gpio-id = <0x53>;
		sda-gpio-id = <0x52>;
		gpio_start = <0x10002a00>;
		mem_len = <0x200>;
		eh_cfg = <0x30>;
		pu_cfg = <0x70>;
		rsel_cfg = <0x90>;
		aed = <0x1a>;
		phandle = <0xb3>;
	};

	i2c1@11008000 {
		compatible = "mediatek,i2c";
		id = <0x01>;
		reg = <0x00 0x11008000 0x00 0x1000 0x00 0x11000100 0x00 0x80>;
		interrupts = <0x00 0x6a 0x08>;
		clocks = <0x21 0x0b 0x21 0x26>;
		clock-names = "main", "dma";
		clock-div = <0x05>;
		scl-gpio-id = <0x54>;
		sda-gpio-id = <0x51>;
		gpio_start = <0x10002a00>;
		mem_len = <0x200>;
		eh_cfg = <0x30>;
		pu_cfg = <0x70>;
		rsel_cfg = <0x90>;
		aed = <0x1a>;
		phandle = <0xb4>;
	};

	i2c2@11009000 {
		compatible = "mediatek,i2c";
		id = <0x02>;
		reg = <0x00 0x11009000 0x00 0x1000 0x00 0x11000180 0x00 0x180>;
		interrupts = <0x00 0x6b 0x08>;
		clocks = <0x21 0x0b 0x21 0x26>;
		clock-names = "main", "dma";
		clock-div = <0x05>;
		scl-gpio-id = <0x67>;
		sda-gpio-id = <0x68>;
		gpio_start = <0x10002800>;
		mem_len = <0x200>;
		eh_cfg = <0x40>;
		pu_cfg = <0xa0>;
		rsel_cfg = <0xf0>;
		aed = <0x1a>;
		ch_offset_default = <0x100>;
		ch_offset_ccu = <0x200>;
		phandle = <0xb5>;
	};

	i2c3@1100f000 {
		compatible = "mediatek,i2c";
		id = <0x03>;
		reg = <0x00 0x1100f000 0x00 0x1000 0x00 0x11000300 0x00 0x100>;
		interrupts = <0x00 0x6c 0x08>;
		clocks = <0x21 0x0b 0x21 0x26>;
		clock-names = "main", "dma";
		clock-div = <0x05>;
		scl-gpio-id = <0x32>;
		sda-gpio-id = <0x33>;
		gpio_start = <0x10002600>;
		mem_len = <0x200>;
		eh_cfg = <0x30>;
		pu_cfg = <0x60>;
		rsel_cfg = <0x90>;
		aed = <0x1a>;
		ch_offset_default = <0x100>;
		ch_offset_ccu = <0x200>;
		phandle = <0xb6>;
	};

	i2c4@11011000 {
		compatible = "mediatek,i2c";
		id = <0x04>;
		reg = <0x00 0x11011000 0x00 0x1000 0x00 0x11000400 0x00 0x180>;
		interrupts = <0x00 0x6d 0x08>;
		clocks = <0x21 0x0b 0x21 0x26>;
		clock-names = "main", "dma";
		clock-div = <0x05>;
		scl-gpio-id = <0x69>;
		sda-gpio-id = <0x6a>;
		gpio_start = <0x10002800>;
		mem_len = <0x200>;
		eh_cfg = <0x40>;
		pu_cfg = <0xa0>;
		rsel_cfg = <0xf0>;
		aed = <0x1a>;
		ch_offset_default = <0x100>;
		ch_offset_ccu = <0x200>;
		phandle = <0xb7>;
	};

	i2c5@11016000 {
		compatible = "mediatek,i2c";
		id = <0x05>;
		reg = <0x00 0x11016000 0x00 0x1000 0x00 0x11000580 0x00 0x80>;
		interrupts = <0x00 0x93 0x08>;
		clocks = <0x21 0x0b 0x21 0x26>;
		clock-names = "main", "dma";
		clock-div = <0x05>;
		scl-gpio-id = <0x30>;
		sda-gpio-id = <0x31>;
		gpio_start = <0x10002600>;
		mem_len = <0x200>;
		eh_cfg = <0x30>;
		pu_cfg = <0x60>;
		rsel_cfg = <0x90>;
		aed = <0x1a>;
		phandle = <0xb8>;
	};

	i2c6@1100d000 {
		compatible = "mediatek,i2c";
		id = <0x06>;
		reg = <0x00 0x1100d000 0x00 0x1000 0x00 0x11000600 0x00 0x80>;
		interrupts = <0x00 0x94 0x08>;
		clocks = <0x21 0x0b 0x21 0x26>;
		clock-names = "main", "dma";
		clock-div = <0x05>;
		scl-gpio-id = <0x59>;
		sda-gpio-id = <0x5a>;
		gpio_start = <0x10002000>;
		mem_len = <0x200>;
		eh_cfg = <0x30>;
		pu_cfg = <0x60>;
		rsel_cfg = <0x90>;
		aed = <0x1a>;
		phandle = <0xb9>;
	};

	i2c7@11004000 {
		compatible = "mediatek,i2c";
		id = <0x07>;
		reg = <0x00 0x11004000 0x00 0x1000 0x00 0x11000680 0x00 0x180>;
		interrupts = <0x00 0x6e 0x08>;
		clocks = <0x21 0x0b 0x21 0x26>;
		clock-names = "main", "dma";
		clock-div = <0x05>;
		scl-gpio-id = <0xaf>;
		sda-gpio-id = <0xb0>;
		gpio_start = <0x10002600>;
		mem_len = <0x200>;
		eh_cfg = <0x30>;
		pu_cfg = <0x60>;
		rsel_cfg = <0x90>;
		aed = <0x1a>;
		phandle = <0xba>;

		speaker_amp@34 {
			status = "disable";
			phandle = <0x55>;
		};
	};

	i2c8@11005000 {
		compatible = "mediatek,i2c";
		id = <0x08>;
		reg = <0x00 0x11005000 0x00 0x1000 0x00 0x11000800 0x00 0x180>;
		interrupts = <0x00 0x6f 0x08>;
		clocks = <0x21 0x0b 0x21 0x26>;
		clock-names = "main", "dma";
		clock-div = <0x05>;
		aed = <0x1a>;
		phandle = <0xbb>;
	};

	spi0@1100a000 {
		compatible = "mediatek,mt6765-spi";
		mediatek,pad-select = <0x00>;
		reg = <0x00 0x1100a000 0x00 0x1000>;
		interrupts = <0x00 0x8a 0x08>;
		clocks = <0x12 0x0b 0x12 0x5b 0x21 0x1b>;
		clock-names = "parent-clk", "sel-clk", "spi-clk";
		phandle = <0xbc>;
	};

	eem_fsm@1100b000 {
		compatible = "mediatek,eem_fsm";
		reg = <0x00 0x1100b000 0x00 0x1000>;
		interrupts = <0x00 0x8e 0x08>;
		eem-status = <0x01>;
		eem-initmon-little = <0x0f>;
		eem-initmon-big = <0x0f>;
		eem-initmon-cci = <0x0f>;
		eem-initmon-gpu = <0x0f>;
		eem-clamp-little = <0x00>;
		eem-clamp-big = <0x00>;
		eem-clamp-cci = <0x00>;
		eem-clamp-gpu = <0x00>;
		eem-offset-little = <0xff>;
		eem-offset-big = <0xff>;
		eem-offset-cci = <0xff>;
		eem-offset-gpu = <0xff>;
		phandle = <0xbd>;
	};

	therm_ctrl@1100b000 {
		compatible = "mediatek,therm_ctrl";
		reg = <0x00 0x1100b000 0x00 0x1000>;
		interrupts = <0x00 0x63 0x08>;
		clocks = <0x21 0x0a>;
		clock-names = "therm-main";
	};

	thermal-sensor1 {
		compatible = "mediatek,mtboard-thermistor1";
		io-channels = <0x23 0x00>;
		io-channel-names = "thermistor-ch0";
		phandle = <0xbe>;
	};

	thermal-sensor2 {
		compatible = "mediatek,mtboard-thermistor2";
		io-channels = <0x23 0x01>;
		io-channel-names = "thermistor-ch1";
		phandle = <0xbf>;
	};

	drcc {
		compatible = "mediatek,drcc";
		state = <0xff>;
		drcc0_Vref = <0xff>;
		drcc1_Vref = <0xff>;
		drcc2_Vref = <0xff>;
		drcc3_Vref = <0xff>;
		drcc4_Vref = <0xff>;
		drcc5_Vref = <0xff>;
		drcc6_Vref = <0xff>;
		drcc7_Vref = <0xff>;
		drcc0_Hwgatepct = <0xff>;
		drcc1_Hwgatepct = <0xff>;
		drcc2_Hwgatepct = <0xff>;
		drcc3_Hwgatepct = <0xff>;
		drcc4_Hwgatepct = <0xff>;
		drcc5_Hwgatepct = <0xff>;
		drcc6_Hwgatepct = <0xff>;
		drcc7_Hwgatepct = <0xff>;
		drcc0_Code = <0xff>;
		drcc1_Code = <0xff>;
		drcc2_Code = <0xff>;
		drcc3_Code = <0xff>;
		drcc4_Code = <0xff>;
		drcc5_Code = <0xff>;
		drcc6_Code = <0xff>;
		drcc7_Code = <0xff>;
		phandle = <0xc0>;
	};

	btif@1100c000 {
		compatible = "mediatek,btif";
		reg = <0x00 0x1100c000 0x00 0x1000 0x00 0x11000b80 0x00 0x80 0x00 0x11000c00 0x00 0x80>;
		interrupts = <0x00 0x85 0x08 0x00 0x73 0x08 0x00 0x8d 0x08>;
		clocks = <0x21 0x1a 0x21 0x26>;
		clock-names = "btifc", "apdmac";
	};

	consys@18002000 {
		compatible = "mediatek,mt6768-consys";
		#address-cells = <0x02>;
		#size-cells = <0x02>;
		reg = <0x00 0x18002000 0x00 0x1000 0x00 0x10007000 0x00 0x100 0x00 0x10001000 0x00 0x1000 0x00 0x10006000 0x00 0x1000 0x00 0x18007000 0x00 0x1000 0x00 0x180b1000 0x00 0x1000 0x00 0x180a3000 0x00 0x1000 0x00 0x180a5000 0x00 0x800 0x00 0x180c1000 0x00 0x1000 0x00 0x18004000 0x00 0x1000>;
		interrupts = <0x00 0x11c 0x08 0x00 0x4e 0x08 0x00 0x11f 0x01>;
		clocks = <0x22 0x01>;
		clock-names = "conn";
		wifi_ant_swap_gpio = <0x1e 0x6c 0x00>;
		phandle = <0xc1>;
	};

	disp_pwm@1100e000 {
		compatible = "mediatek,disp_pwm";
		reg = <0x00 0x1100e000 0x00 0x1000>;
	};

	spi1@11010000 {
		compatible = "mediatek,mt6765-spi";
		mediatek,pad-select = <0x00>;
		reg = <0x00 0x11010000 0x00 0x1000>;
		interrupts = <0x00 0x8b 0x08>;
		clocks = <0x12 0x0b 0x12 0x5b 0x21 0x34>;
		clock-names = "parent-clk", "sel-clk", "spi-clk";
		phandle = <0xc2>;
	};

	spi2@11012000 {
		compatible = "mediatek,mt6765-spi";
		mediatek,pad-select = <0x00>;
		reg = <0x00 0x11012000 0x00 0x1000>;
		interrupts = <0x00 0x91 0x08>;
		clocks = <0x12 0x0b 0x12 0x5b 0x21 0x37>;
		clock-names = "parent-clk", "sel-clk", "spi-clk";
		phandle = <0xc3>;
	};

	spi3@11013000 {
		compatible = "mediatek,mt6765-spi";
		mediatek,pad-select = <0x00>;
		reg = <0x00 0x11013000 0x00 0x1000>;
		interrupts = <0x00 0x92 0x08>;
		clocks = <0x12 0x0b 0x12 0x5b 0x21 0x38>;
		clock-names = "parent-clk", "sel-clk", "spi-clk";
		phandle = <0xc4>;
	};

	spi4@11014000 {
		compatible = "mediatek,mt6765-spi";
		mediatek,pad-select = <0x00>;
		reg = <0x00 0x11014000 0x00 0x1000>;
		interrupts = <0x00 0x74 0x08>;
		clocks = <0x12 0x0b 0x12 0x5b 0x21 0x41>;
		clock-names = "parent-clk", "sel-clk", "spi-clk";
		phandle = <0xc5>;
	};

	spi5@11015000 {
		compatible = "mediatek,mt6765-spi";
		mediatek,pad-select = <0x00>;
		reg = <0x00 0x11015000 0x00 0x1000>;
		interrupts = <0x00 0x75 0x08>;
		clocks = <0x12 0x0b 0x12 0x5b 0x21 0x42>;
		clock-names = "parent-clk", "sel-clk", "spi-clk";
		phandle = <0xc6>;
	};

	imp_iic@11017000 {
		compatible = "mediatek,imp_iic";
		reg = <0x00 0x11017000 0x00 0x1000>;
	};

	nfi@11018000 {
		compatible = "mediatek,nfi";
		reg = <0x00 0x11018000 0x00 0x1000>;
	};

	nfiecc@11019000 {
		compatible = "mediatek,nfiecc";
		reg = <0x00 0x11019000 0x00 0x1000>;
	};

	usb0@11200000 {
		compatible = "mediatek,mt6768-usb20";
		reg = <0x00 0x11200000 0x00 0x10000 0x00 0x11cc0000 0x00 0x10000>;
		interrupts = <0x00 0x61 0x08>;
		mode = <0x02>;
		multipoint = <0x01>;
		num_eps = <0x10>;
		clocks = <0x21 0x08 0x12 0x66 0x12 0x20>;
		clock-names = "usb0", "usb0_clk_top_sel", "usb0_clk_univpll3_d4";
	};

	msdc@11230000 {
		compatible = "mediatek,msdc";
		reg = <0x00 0x11230000 0x00 0x10000>;
		interrupts = <0x00 0x64 0x08>;
		index = [00];
		clk_src = [01];
		bus-width = <0x08>;
		max-frequency = <0xbebc200>;
		cap-mmc-highspeed;
		mmc-ddr-1_8v;
		mmc-hs200-1_8v;
		mmc-hs400-1_8v;
		no-sd;
		no-sdio;
		non-removable;
		pinctl = <0x31>;
		pinctl_hs400 = <0x32>;
		pinctl_hs200 = <0x33>;
		register_setting = <0x34>;
		host_function = [00];
		bootable;
		status = "okay";
		vmmc-supply = <0x35>;
		clocks = <0x21 0x4c 0x21 0x1c 0x21 0x44>;
		clock-names = "msdc0-clock", "msdc0-hclock", "msdc0-aes-clock";
		phandle = <0xc7>;
	};

	msdc@11240000 {
		compatible = "mediatek,msdc";
		reg = <0x00 0x11240000 0x00 0x10000>;
		interrupts = <0x00 0x65 0x08>;
		index = [01];
		clk_src = [02];
		bus-width = <0x04>;
		max-frequency = <0xbebc200>;
		cap-sd-highspeed;
		sd-uhs-sdr12;
		sd-uhs-sdr25;
		sd-uhs-sdr50;
		sd-uhs-sdr104;
		sd-uhs-ddr50;
		no-mmc;
		no-sdio;
		pinctl = <0x36>;
		pinctl_sdr104 = <0x37>;
		pinctl_sdr50 = <0x38>;
		pinctl_ddr50 = <0x39>;
		register_setting = <0x3a>;
		host_function = [01];
		cd_level = [01];
		cd-gpios = <0x1e 0x12 0x00>;
		status = "okay";
		vmmc-supply = <0x3b>;
		vqmmc-supply = <0x3c>;
		clocks = <0x21 0x4d 0x21 0x1d>;
		clock-names = "msdc1-clock", "msdc1-hclock";
		phandle = <0xc8>;
	};

	msdc0_top@11cd0000 {
		compatible = "mediatek,msdc0_top";
		reg = <0x00 0x11cd0000 0x00 0x1000>;
	};

	msdc1_top@11c90000 {
		compatible = "mediatek,msdc1_top";
		reg = <0x00 0x11c90000 0x00 0x1000>;
	};

	usb1p_sif@11210000 {
		compatible = "mediatek,usb1p_sif";
		reg = <0x00 0x11210000 0x00 0x10000>;
	};

	audio@11220000 {
		compatible = "mediatek,audio", "syscon";
		reg = <0x00 0x11220000 0x00 0x1000>;
		#clock-cells = <0x01>;
		phandle = <0x3e>;
	};

	mt6768-afe-pcm@11220000 {
		compatible = "mediatek,mt6768-sound";
		reg = <0x00 0x11220000 0x00 0x1000>;
		interrupts = <0x00 0xa9 0x08>;
		topckgen = <0x12>;
		apmixed = <0x3d>;
		clocks = <0x3e 0x00 0x3e 0x05 0x3e 0x06 0x3e 0x04 0x3e 0x01 0x3e 0x02 0x3e 0x03 0x3e 0x07 0x21 0x2b 0x21 0x33 0x12 0x5f 0x12 0x60 0x12 0x03 0x12 0x61 0x12 0x29 0x12 0x62 0x12 0x2c 0x12 0x82 0x12 0x83 0x12 0x84 0x12 0x85 0x12 0x70 0x12 0x71 0x12 0x72 0x12 0x73 0x3d 0x08 0x13>;
		clock-names = "aud_afe_clk", "aud_dac_clk", "aud_dac_predis_clk", "aud_adc_clk", "aud_apll22m_clk", "aud_apll24m_clk", "aud_apll1_tuner_clk", "aud_tml_clk", "aud_infra_axi_clk", "aud_infra_26m_clk", "top_mux_audio", "top_mux_audio_int", "top_sys_pll1_d4", "top_mux_aud_1", "top_apll1_ck", "top_mux_aud_eng1", "top_apll1_d8", "top_i2s0_m_sel", "top_i2s1_m_sel", "top_i2s2_m_sel", "top_i2s3_m_sel", "top_apll12_div0", "top_apll12_div1", "top_apll12_div2", "top_apll12_div3", "apmixed_apll1", "top_clk26m_clk";
		pinctrl-names = "aud_clk_mosi_off", "aud_clk_mosi_on", "aud_clk_miso_off", "aud_clk_miso_on", "aud_dat_mosi_off", "aud_dat_mosi_on", "aud_dat_miso_off", "aud_dat_miso_on", "aud_gpio_i2s0_off", "aud_gpio_i2s0_on", "aud_gpio_i2s1_off", "aud_gpio_i2s1_on", "aud_gpio_i2s2_off", "aud_gpio_i2s2_on", "aud_gpio_i2s3_off", "aud_gpio_i2s3_on", "vow_dat_miso_off", "vow_dat_miso_on", "vow_clk_miso_off", "vow_clk_miso_on";
		pinctrl-0 = <0x3f>;
		pinctrl-1 = <0x40>;
		pinctrl-2 = <0x41>;
		pinctrl-3 = <0x42>;
		pinctrl-4 = <0x43>;
		pinctrl-5 = <0x44>;
		pinctrl-6 = <0x45>;
		pinctrl-7 = <0x46>;
		pinctrl-8 = <0x47>;
		pinctrl-9 = <0x48>;
		pinctrl-10 = <0x49>;
		pinctrl-11 = <0x4a>;
		pinctrl-12 = <0x4b>;
		pinctrl-13 = <0x4c>;
		pinctrl-14 = <0x4d>;
		pinctrl-15 = <0x4e>;
		pinctrl-16 = <0x4f>;
		pinctrl-17 = <0x50>;
		pinctrl-18 = <0x51>;
		pinctrl-19 = <0x52>;
		phandle = <0x54>;
	};

	mt6358_snd {
		compatible = "mediatek,mt6358-sound";
		mediatek,pwrap-regmap = <0x20>;
		phandle = <0x53>;
	};

	sound {
		compatible = "mediatek,mt6768-mt6358-sound";
		mediatek,audio-codec = <0x53>;
		mediatek,platform = <0x54>;
		mtk_spk_i2s_out = <0x03>;
		mtk_spk_i2s_in = <0x00>;
		phandle = <0xc9>;

		mediatek,speaker-codec {
			sound-dai = <0x55>;
		};
	};

	snd_scp_spk {
		compatible = "mediatek,snd_scp_spk";
		phandle = <0xca>;
	};

	audio_sram@11221000 {
		compatible = "mediatek,audio_sram";
		reg = <0x00 0x11221000 0x00 0x9000>;
		prefer_mode = <0x01>;
		mode_size = <0x6c00 0x9000>;
		block_size = <0x1000>;
	};

	mtk-btcvsd-snd@18050000 {
		compatible = "mediatek,mtk-btcvsd-snd";
		reg = <0x00 0x18050000 0x00 0x1000 0x00 0x18080000 0x00 0x10000>;
		interrupts = <0x00 0x11b 0x08>;
		mediatek,infracfg = <0x21>;
		mediatek,offset = <0xf00 0x800 0x140 0x144 0x148>;
		disable_write_silence = <0x00>;
	};

	mt_soc_playback_offload {
		compatible = "mediatek,mt_soc_offload_common";
	};

	mipi_rx_ana_csi0a@11c10000 {
		compatible = "mediatek,mipi_rx_ana_csi0a", "syscon";
		reg = <0x00 0x11c10000 0x00 0x1000>;
		#clock-cells = <0x01>;
		phandle = <0x60>;
	};

	mipi_rx_ana_csi0b@11c11000 {
		compatible = "mediatek,mipi_rx_ana_csi0b", "syscon";
		reg = <0x00 0x11c11000 0x00 0x1000>;
		#clock-cells = <0x01>;
		phandle = <0x61>;
	};

	mipi_rx_ana_csi1a@11c12000 {
		compatible = "mediatek,mipi_rx_ana_csi1a", "syscon";
		reg = <0x00 0x11c12000 0x00 0x1000>;
		#clock-cells = <0x01>;
		phandle = <0x62>;
	};

	mipi_rx_ana_csi1b@11c13000 {
		compatible = "mediatek,mipi_rx_ana_csi1b", "syscon";
		reg = <0x00 0x11c13000 0x00 0x1000>;
		#clock-cells = <0x01>;
		phandle = <0x63>;
	};

	mipi_rx_ana_csi2a@11c14000 {
		compatible = "mediatek,mipi_rx_ana_csi2a", "syscon";
		reg = <0x00 0x11c14000 0x00 0x1000>;
		#clock-cells = <0x01>;
		phandle = <0x64>;
	};

	mipi_rx_ana_csi2b@11c15000 {
		compatible = "mediatek,mipi_rx_ana_csi2b", "syscon";
		reg = <0x00 0x11c15000 0x00 0x1000>;
		#clock-cells = <0x01>;
		phandle = <0x65>;
	};

	mipi_tx0@11c80000 {
		compatible = "mediatek,mipi_tx0";
		reg = <0x00 0x11c80000 0x00 0x10000>;
	};

	efusec@11ce0000 {
		compatible = "mediatek,efusec";
		reg = <0x00 0x11ce0000 0x00 0x10000>;
	};

	mfg_cfg@13000000 {
		compatible = "mediatek,mfgcfg", "syscon";
		reg = <0x00 0x13000000 0x00 0x1000>;
		#clock-cells = <0x01>;
		phandle = <0x56>;
	};

	mali@13040000 {
		compatible = "mediatek,mali", "arm,mali-midgard", "arm,mali-bifrost";
		reg = <0x00 0x13040000 0x00 0x4000>;
		interrupts = <0x00 0x112 0x08 0x00 0x113 0x08 0x00 0x114 0x08 0x00 0x115 0x08 0x00 0x116 0x08>;
		interrupt-names = "GPU", "MMU", "JOB", "EVENT", "PWR";
	};

	gpufreq {
		compatible = "mediatek,mt6768-gpufreq";
		clocks = <0x12 0x54 0x12 0x26 0x12 0x06 0x56 0x00 0x22 0x09 0x22 0x04 0x22 0x07 0x22 0x08>;
		clock-names = "clk_mux", "clk_main_parent", "clk_sub_parent", "subsys_mfg_cg", "mtcmos_mfg_async", "mtcmos_mfg", "mtcmos_mfg_core0", "mtcmos_mfg_core1";
	};

	mmsys_config@14000000 {
		compatible = "mediatek,mmsys_config", "syscon";
		reg = <0x00 0x14000000 0x00 0x1000>;
		interrupts = <0x00 0xf0 0x08>;
		#clock-cells = <0x01>;
		clocks = <0x24 0x17 0x24 0x1c 0x24 0x1d>;
		clock-names = "CAM_MDP", "IMG_DL_RELAY", "IMG_DL_ASYNC_TOP";
		phandle = <0x24>;
	};

	disp_mutex0@14001000 {
		compatible = "mediatek,disp_mutex0";
		reg = <0x00 0x14001000 0x00 0x1000>;
		interrupts = <0x00 0xdf 0x08>;
		phandle = <0x2d>;
	};

	smi_common@14002000 {
		compatible = "mediatek,smi_common";
		reg = <0x00 0x14002000 0x00 0x1000>;
		mediatek,smi-id = <0x05>;
		clocks = <0x22 0x03 0x24 0x15 0x24 0x16 0x24 0x13>;
		clock-names = "scp-dis", "mm-comm0", "mm-comm1", "mm-common";
		mmsys_config = <0x24>;
	};

	mmdvfs_pmqos {
		compatible = "mediatek,mmdvfs_pmqos";
		mm_step0 = <0x1c9 0x01 0x00 0x03>;
		mm_step1 = <0x138 0x01 0x00 0x04>;
		mm_step2 = <0xe4 0x01 0x00 0x05>;
		venc_step0 = <0x1c9 0x01 0x01 0x03>;
		venc_step1 = <0x1a0 0x01 0x01 0x06>;
		venc_step2 = <0x138 0x01 0x01 0x04>;
		cam_step0 = <0x222 0x01 0x02 0x07>;
		cam_step1 = <0x138 0x01 0x02 0x04>;
		cam_step2 = <0xe4 0x01 0x02 0x05>;
		vopp_steps = <0x00 0x01 0x03>;
		disp_freq = "mm_step0", "mm_step1", "mm_step2";
		mdp_freq = "mm_step0", "mm_step1", "mm_step2";
		cam_freq = "cam_step0", "cam_step1", "cam_step2";
		img_freq = "mm_step0", "mm_step1", "mm_step2";
		vdec_freq = "mm_step0", "mm_step1", "mm_step2";
		venc_freq = "venc_step0", "venc_step1", "venc_step2";
		clocks = <0x12 0x52 0x12 0x6e 0x12 0x6f 0x12 0x21 0x12 0x17 0x12 0x22 0x12 0x19 0x12 0x01>;
		clock-names = "mmdvfs_clk_mm_sel_ck", "mmdvfs_clk_venc_sel_ck", "mmdvfs_clk_cam_sel_ck", "mmdvfs_clk_mmpll_ck", "mmdvfs_clk_univpll1_d2_ck", "mmdvfs_clk_mmpll_d2_ck", "mmdvfs_clk_univpll_d3_ck", "mmdvfs_clk_syspll_d2_ck";
	};

	smi_larb0@14003000 {
		compatible = "mediatek,smi_larb0", "mediatek,smi_larb";
		reg = <0x00 0x14003000 0x00 0x1000>;
		mediatek,smi-id = <0x00>;
		clocks = <0x22 0x03 0x24 0x14>;
		clock-names = "scp-dis", "mm-larb0";
		phandle = <0x57>;
	};

	mdp_rdma0@14004000 {
		compatible = "mediatek,mdp_rdma0";
		reg = <0x00 0x14004000 0x00 0x1000>;
		interrupts = <0x00 0xe0 0x08>;
		clocks = <0x24 0x00>;
		clock-names = "MDP_RDMA0";
		phandle = <0x25>;
	};

	mdp_ccorr0@14005000 {
		compatible = "mediatek,mdp_ccorr0";
		reg = <0x00 0x14005000 0x00 0x1000>;
		interrupts = <0x00 0xef 0x08>;
		clocks = <0x24 0x01>;
		clock-names = "MDP_CCORR";
		phandle = <0x2c>;
	};

	mdp_rsz0@14006000 {
		compatible = "mediatek,mdp_rsz0";
		reg = <0x00 0x14006000 0x00 0x1000>;
		interrupts = <0x00 0xe1 0x08>;
		clocks = <0x24 0x02>;
		clock-names = "MDP_RSZ0";
		phandle = <0x26>;
	};

	mdp_rsz1@14007000 {
		compatible = "mediatek,mdp_rsz1";
		reg = <0x00 0x14007000 0x00 0x1000>;
		interrupts = <0x00 0xe2 0x08>;
		clocks = <0x24 0x03>;
		clock-names = "MDP_RSZ1";
		phandle = <0x27>;
	};

	mdp_wdma0@14008000 {
		compatible = "mediatek,mdp_wdma0";
		reg = <0x00 0x14008000 0x00 0x1000>;
		interrupts = <0x00 0xe5 0x08>;
		clocks = <0x24 0x06>;
		clock-names = "MDP_WDMA";
		phandle = <0x28>;
	};

	mdp_wrot0@14009000 {
		compatible = "mediatek,mdp_wrot0";
		reg = <0x00 0x14009000 0x00 0x1000>;
		interrupts = <0x00 0xe4 0x08>;
		clocks = <0x24 0x05>;
		clock-names = "MDP_WROT0";
		phandle = <0x29>;
	};

	mdp_tdshp0@1400a000 {
		compatible = "mediatek,mdp_tdshp0";
		reg = <0x00 0x1400a000 0x00 0x1000>;
		clocks = <0x24 0x04>;
		clock-names = "MDP_TDSHP";
		phandle = <0x2a>;
	};

	disp_ovl0@1400b000 {
		compatible = "mediatek,disp_ovl0";
		reg = <0x00 0x1400b000 0x00 0x1000>;
		interrupts = <0x00 0xe6 0x08>;
	};

	disp_rdma0@1400d000 {
		compatible = "mediatek,disp_rdma0";
		reg = <0x00 0x1400d000 0x00 0x1000>;
		interrupts = <0x00 0xe7 0x08>;
	};

	disp_wdma0@1400e000 {
		compatible = "mediatek,disp_wdma0";
		reg = <0x00 0x1400e000 0x00 0x1000>;
		interrupts = <0x00 0xe8 0x08>;
	};

	disp_color0@1400f000 {
		compatible = "mediatek,disp_color0";
		reg = <0x00 0x1400f000 0x00 0x1000>;
		interrupts = <0x00 0xe9 0x08>;
		clocks = <0x24 0x0c>;
		clock-names = "MDP_COLOR";
		phandle = <0x2b>;
	};

	disp_ccorr0@14010000 {
		compatible = "mediatek,disp_ccorr0";
		reg = <0x00 0x14010000 0x00 0x1000>;
		interrupts = <0x00 0xea 0x08>;
	};

	disp_aal0@14011000 {
		compatible = "mediatek,disp_aal0";
		reg = <0x00 0x14011000 0x00 0x1000>;
		interrupts = <0x00 0xeb 0x08>;
	};

	disp_gamma0@14012000 {
		compatible = "mediatek,disp_gamma0";
		reg = <0x00 0x14012000 0x00 0x1000>;
		interrupts = <0x00 0xec 0x08>;
	};

	disp_dither0@14013000 {
		compatible = "mediatek,disp_dither0";
		reg = <0x00 0x14013000 0x00 0x1000>;
		interrupts = <0x00 0xed 0x08>;
	};

	dsi0@14014000 {
		compatible = "mediatek,dsi0";
		reg = <0x00 0x14014000 0x00 0x1000>;
		interrupts = <0x00 0xee 0x08>;
	};

	disp_ovl0_2l@1400c000 {
		compatible = "mediatek,disp_ovl0_2l";
		reg = <0x00 0x1400c000 0x00 0x1000>;
		interrupts = <0x00 0xf2 0x08>;
	};

	disp_rsz0@14015000 {
		compatible = "mediatek,disp_rsz0";
		reg = <0x00 0x14015000 0x00 0x1000>;
		interrupts = <0x00 0x125 0x08>;
	};

	mtkfb@0 {
		compatible = "mediatek,mtkfb";
		phandle = <0xcb>;
	};

	dispsys {
		compatible = "mediatek,dispsys";
		mediatek,larb = <0x57>;
		clocks = <0x22 0x03 0x24 0x13 0x24 0x14 0x24 0x15 0x24 0x16 0x24 0x07 0x24 0x08 0x24 0x0a 0x24 0x0b 0x24 0x0c 0x24 0x0d 0x24 0x0e 0x24 0x0f 0x24 0x10 0x24 0x11 0x24 0x1e 0x24 0x1c 0x24 0x1f 0x24 0x09 0x3d 0x15 0x12 0x63 0x21 0x31 0x13 0x12 0x1b 0x12 0x2e 0x12 0x30>;
		clock-names = "MMSYS_MTCMOS", "MMSYS_SMI_COMMON", "MMSYS_SMI_LARB0", "MMSYS_GALS_COMM0", "MMSYS_GALS_COMM1", "MMSYS_DISP_OVL0", "MMSYS_DISP_OVL0_2L", "MMSYS_DISP_RDMA0", "MMSYS_DISP_WDMA0", "MMSYS_DISP_COLOR0", "MMSYS_DISP_CCORR0", "MMSYS_DISP_AAL0", "MMSYS_DISP_GAMMA0", "MMSYS_DISP_DITHER0", "MMSYS_DSI0_MM_CK", "MMSYS_DSI0_IF_CK", "MMSYS_IMG_DL_RELAY", "MMSYS_26M", "MMSYS_DISP_RSZ0", "APMIXED_MIPI_26M", "TOP_MUX_DISP_PWM", "DISP_PWM", "TOP_26M", "TOP_UNIVPLL2_D4", "TOP_ULPOSC1_D2", "TOP_ULPOSC1_D8";
	};

	dsi_te {
		compatible = "mediatek, dsi_te-eint";
		status = "disabled";
		phandle = <0xcc>;
	};

	mm_mutex@14016000 {
		compatible = "mediatek,mm_mutex";
		reg = <0x00 0x14016000 0x00 0x1000>;
	};

	imgsys@15020000 {
		compatible = "mediatek,imgsys", "syscon";
		reg = <0x00 0x15020000 0x00 0x1000>;
		#clock-cells = <0x01>;
		clocks = <0x22 0x03 0x22 0x05 0x22 0x0a 0x58 0x01 0x59 0x02 0x59 0x03 0x59 0x04 0x59 0x05 0x59 0x06 0x59 0x07>;
		clock-names = "ISP_SCP_SYS_DIS", "ISP_SCP_SYS_ISP", "ISP_SCP_SYS_CAM", "ISP_CLK_IMG_DIP", "ISP_CLK_CAM", "ISP_CLK_CAMTG", "ISP_CLK_CAM_SENINF", "ISP_CLK_CAMSV0", "ISP_CLK_CAMSV1", "ISP_CLK_CAMSV2";
		phandle = <0x58>;
	};

	dip1@15022000 {
		compatible = "mediatek,dip1";
		reg = <0x00 0x15022000 0x00 0x3000>;
		interrupts = <0x00 0x10e 0x08>;
	};

	fdvt@1502b000 {
		compatible = "mediatek,fdvt";
		reg = <0x00 0x1502b000 0x00 0x1000>;
		interrupts = <0x00 0x111 0x08>;
		clocks = <0x58 0x02>;
		clock-names = "FD_CLK_IMG_FDVT";
	};

	dpe@15028000 {
		compatible = "mediatek,dpe";
		reg = <0x00 0x15028000 0x00 0x1000>;
		interrupts = <0x00 0x10f 0x08>;
		clocks = <0x58 0x03>;
		clock-names = "DPE_CG_IMG_DPE";
	};

	smi_larb2@15021000 {
		compatible = "mediatek,smi_larb2", "mediatek,smi_larb";
		reg = <0x00 0x15021000 0x00 0x1000>;
		mediatek,smi-id = <0x02>;
		clocks = <0x22 0x05 0x24 0x18 0x58 0x00>;
		clock-names = "scp-isp", "mm-img", "img-larb2";
		phandle = <0xcd>;
	};

	vcu@16000000 {
		compatible = "mediatek-vcu";
		mediatek,vcuid = <0x00>;
		mediatek,vcuname = "vcu";
		reg = <0x00 0x16000000 0x00 0x40000 0x00 0x17020000 0x00 0x10000 0x00 0x19002000 0x00 0x1000>;
		mediatek,mailbox-gce = <0x2e>;
		mboxes = <0x2e 0x01 0x00 0x01 0x2e 0x05 0x00 0x01>;
		gce-event-names = "venc_eof", "venc_cmdq_pause_done", "venc_mb_done", "venc_128B_cnt_done";
		gce-events = <0x2e 0x121 0x2e 0x122 0x2e 0x124 0x2e 0x125>;
		phandle = <0x5b>;
	};

	vdec_gcon@16000000 {
		compatible = "mediatek,vdec_gcon", "syscon";
		reg = <0x00 0x16000000 0x00 0x1000 0x00 0x16025000 0x00 0x1000>;
		mediatek,larb = <0x5a>;
		interrupts = <0x00 0xf6 0x08>;
		mediatek,vcu = <0x5b>;
		clocks = <0x22 0x03 0x22 0x0c 0x5c 0x00>;
		clock-names = "MT_SCP_SYS_DIS", "MT_SCP_SYS_VDE", "MT_CG_VDEC";
		#clock-cells = <0x01>;
		phandle = <0x5c>;
	};

	smi_larb1@16010000 {
		compatible = "mediatek,smi_larb1", "mediatek,smi_larb";
		reg = <0x00 0x16010000 0x00 0x1000>;
		interrupts = <0x00 0xf7 0x08>;
		mediatek,smi-id = <0x01>;
		clocks = <0x22 0x0c 0x24 0x1b 0x5c 0x03>;
		clock-names = "scp-vdec", "mm-vdec", "vdec-larb1";
		phandle = <0x5a>;
	};

	vdec@16020000 {
		compatible = "mediatek,vdec";
		reg = <0x00 0x16020000 0x00 0x10000>;
		interrupts = <0x00 0xf6 0x08>;
	};

	reserve@16030000 {
		compatible = "mediatek,reserve";
		reg = <0x00 0x16030000 0x00 0x10000>;
	};

	vdec_mbist_ctrl@16001000 {
		compatible = "mediatek,vdec_mbist_ctrl";
		reg = <0x00 0x16001000 0x00 0x1000>;
	};

	venc_gcon@17000000 {
		compatible = "mediatek,venc_gcon", "syscon";
		reg = <0x00 0x17000000 0x00 0x1000 0x00 0x17020000 0x00 0x1000>;
		mediatek,larb = <0x5d>;
		interrupts = <0x00 0xf3 0x08>;
		mediatek,vcu = <0x5b>;
		clocks = <0x22 0x03 0x22 0x0b 0x5e 0x01>;
		clock-names = "MT_SCP_SYS_DIS", "MT_SCP_SYS_VEN", "MT_CG_VENC";
		#clock-cells = <0x01>;
		phandle = <0x5e>;
	};

	smi_larb4@17010000 {
		compatible = "mediatek,smi_larb4", "mediatek,smi_larb";
		reg = <0x00 0x17010000 0x00 0x1000>;
		mediatek,smi-id = <0x04>;
		clocks = <0x22 0x0b 0x24 0x1a 0x5e 0x01 0x5e 0x02>;
		clock-names = "scp-venc", "mm-venc", "venc-venc", "venc-jpgenc";
		phandle = <0x5d>;
	};

	venc@17020000 {
		compatible = "mediatek,venc";
		reg = <0x00 0x17020000 0x00 0x10000>;
		interrupts = <0x00 0xf3 0x08>;
	};

	venc_jpg@17030000 {
		compatible = "mediatek,venc_jpg";
		reg = <0x00 0x17030000 0x00 0x10000>;
		interrupts = <0x00 0xf5 0x08>;
		clocks = <0x5e 0x02>;
		clock-names = "MT_CG_VENC_JPGENC";
	};

	mbist@17040000 {
		compatible = "mediatek,mbist";
		reg = <0x00 0x17040000 0x00 0x10000>;
	};

	mbist@17050000 {
		compatible = "mediatek,mbist";
		reg = <0x00 0x17050000 0x00 0x10000>;
	};

	mbist@17060000 {
		compatible = "mediatek,mbist";
		reg = <0x00 0x17060000 0x00 0x10000>;
	};

	mbist@17070000 {
		compatible = "mediatek,mbist";
		reg = <0x00 0x17070000 0x00 0x10000>;
	};

	wifi@18000000 {
		compatible = "mediatek,wifi";
		reg = <0x00 0x18000000 0x00 0x100000>;
		interrupts = <0x00 0x11d 0x08>;
		memory-region = <0x5f>;
	};

	camsys@1a000000 {
		compatible = "mediatek,camsys", "syscon";
		reg = <0x00 0x1a000000 0x00 0x1000>;
		#clock-cells = <0x01>;
		phandle = <0x59>;
	};

	smi_larb3@1a002000 {
		compatible = "mediatek,smi_larb3", "mediatek,smi_larb";
		reg = <0x00 0x1a002000 0x00 0x1000>;
		mediatek,smi-id = <0x03>;
		clocks = <0x22 0x0a 0x24 0x19 0x59 0x00>;
		clock-names = "scp-cam", "mm-cam", "cam-larb3";
		phandle = <0xce>;
	};

	cam1@1a003000 {
		compatible = "mediatek,cam1";
		reg = <0x00 0x1a003000 0x00 0x1000>;
		interrupts = <0x00 0xfa 0x08>;
	};

	cam2@1a004000 {
		compatible = "mediatek,cam2";
		reg = <0x00 0x1a004000 0x00 0x1000>;
		interrupts = <0x00 0xfb 0x08>;
	};

	cam3@1a005000 {
		compatible = "mediatek,cam3";
		reg = <0x00 0x1a005000 0x00 0x1000>;
		interrupts = <0x00 0xfc 0x08>;
	};

	cam_set@1a00b000 {
		compatible = "mediatek,cam_set";
		reg = <0x00 0x1a00b000 0x00 0x1000>;
	};

	cama_set@1a00c000 {
		compatible = "mediatek,cama_set";
		reg = <0x00 0x1a00c000 0x00 0x1000>;
	};

	camb_set@1a00d000 {
		compatible = "mediatek,camb_set";
		reg = <0x00 0x1a00d000 0x00 0x1000>;
	};

	cam_inner@1a013000 {
		compatible = "mediatek,cam_inner";
		reg = <0x00 0x1a013000 0x00 0x1000>;
	};

	cama_inner@1a014000 {
		compatible = "mediatek,cama_inner";
		reg = <0x00 0x1a014000 0x00 0x1000>;
	};

	camb_inner@1a015000 {
		compatible = "mediatek,camb_inner";
		reg = <0x00 0x1a015000 0x00 0x1000>;
	};

	cam_clear@1a01b000 {
		compatible = "mediatek,cam_clear";
		reg = <0x00 0x1a01b000 0x00 0x1000>;
	};

	cama_clear@1a01c000 {
		compatible = "mediatek,cama_clear";
		reg = <0x00 0x1a01c000 0x00 0x1000>;
	};

	camb_clear@1a01d000 {
		compatible = "mediatek,camb_clear";
		reg = <0x00 0x1a01d000 0x00 0x1000>;
	};

	cama_ext@1a024000 {
		compatible = "mediatek,cama_ext";
		reg = <0x00 0x1a024000 0x00 0x1000>;
	};

	camb_ext@1a025000 {
		compatible = "mediatek,camb_ext";
		reg = <0x00 0x1a025000 0x00 0x1000>;
	};

	seninf1@1a040000 {
		compatible = "mediatek,seninf1";
		reg = <0x00 0x1a040000 0x00 0x1000>;
	};

	seninf2@1a041000 {
		compatible = "mediatek,seninf2";
		reg = <0x00 0x1a041000 0x00 0x1000>;
	};

	seninf3@1a042000 {
		compatible = "mediatek,seninf3";
		reg = <0x00 0x1a042000 0x00 0x1000>;
	};

	seninf4@1a043000 {
		compatible = "mediatek,seninf4";
		reg = <0x00 0x1a043000 0x00 0x1000>;
	};

	kd_camera_hw1@1a040000 {
		compatible = "mediatek,camera_hw";
		reg = <0x00 0x1a040000 0x00 0x1000>;
		clocks = <0x12 0x56 0x12 0x57 0x12 0x58 0x12 0x59 0x12 0x14 0x12 0x13 0x12 0x1d 0x12 0x11 0x12 0x1c 0x12 0x12 0x13 0x59 0x04 0x3d 0x0e 0x3d 0x12 0x60 0x00 0x61 0x00 0x62 0x00 0x63 0x00 0x64 0x00 0x65 0x00 0x12 0x6d 0x12 0x1a 0x22 0x0a>;
		clock-names = "CLK_TOP_CAMTG_SEL", "CLK_TOP_CAMTG1_SEL", "CLK_TOP_CAMTG2_SEL", "CLK_TOP_CAMTG3_SEL", "CLK_MCLK_6M", "CLK_MCLK_12M", "CLK_MCLK_13M", "CLK_MCLK_48M", "CLK_MCLK_52M", "CLK_MCLK_24M", "CLK_MCLK_26M", "CLK_CAM_SENINF_CG", "CLK_MIPI_C0_26M_CG", "CLK_MIPI_C1_26M_CG", "CLK_MIPI_ANA_0A_CG", "CLK_MIPI_ANA_0B_CG", "CLK_MIPI_ANA_1A_CG", "CLK_MIPI_ANA_1B_CG", "CLK_MIPI_ANA_2A_CG", "CLK_MIPI_ANA_2B_CG", "CLK_TOP_CAMTM_SEL_CG", "CLK_TOP_CAMTM_208_CG", "CLK_SCP_SYS_CAM";
		phandle = <0xcf>;
	};

	flashlight_core {
		compatible = "mediatek,flashlight_core";
		phandle = <0xd0>;
	};

	flashlights_led191 {
		compatible = "mediatek,flashlights_led191";
		decouple = <0x00>;
		phandle = <0xd1>;

		channel@1 {
			type = <0x00>;
			ct = <0x00>;
			part = <0x00>;
		};

		channel@2 {
			type = <0x00>;
			ct = <0x01>;
			part = <0x00>;
		};
	};

	flashlights_mt6370 {
		compatible = "mediatek,flashlights_mt6370";
		decouple = <0x00>;
		phandle = <0xd2>;

		channel@1 {
			type = <0x00>;
			ct = <0x00>;
			part = <0x00>;
		};

		channel@2 {
			type = <0x00>;
			ct = <0x01>;
			part = <0x00>;
		};
	};

	camsv1@1a050000 {
		compatible = "mediatek,camsv1";
		reg = <0x00 0x1a050000 0x00 0x1000>;
		interrupts = <0x00 0x102 0x08>;
	};

	camsv2@1a051000 {
		compatible = "mediatek,camsv2";
		reg = <0x00 0x1a051000 0x00 0x1000>;
		interrupts = <0x00 0x103 0x08>;
	};

	camsv3@1a052000 {
		compatible = "mediatek,camsv3";
		reg = <0x00 0x1a052000 0x00 0x1000>;
		interrupts = <0x00 0x100 0x08>;
	};

	camsv4@1a053000 {
		compatible = "mediatek,camsv4";
		reg = <0x00 0x1a053000 0x00 0x1000>;
		interrupts = <0x00 0x101 0x08>;
	};

	ccu@1a0b1000 {
		compatible = "mediatek,ccu";
		reg = <0x00 0x1a0b1000 0x00 0x10000>;
		interrupts = <0x00 0x105 0x08>;
		clocks = <0x59 0x08 0x22 0x0a>;
		clock-names = "CCU_CLK_CAM_CCU", "CAM_PWR";
	};

	atf_logger {
		compatible = "mediatek,atf_logger";
		interrupts = <0x00 0x128 0x01>;
	};

	amms_control {
		compatible = "mediatek,amms";
		interrupts = <0x00 0x131 0x01>;
	};

	odm {
		compatible = "simple-bus";
		phandle = <0xd3>;
	};

	memory-ssmr-features {
		compatible = "mediatek,memory-ssmr-features";
		svp-size = <0x00 0x10000000>;
		iris-recognition-size = <0x00 0x10000000>;
		2d_fr-size = <0x00 0x00>;
		tui-size = <0x00 0x4000000>;
		wfd-size = <0x00 0x4000000>;
		prot-sharedmem-size = <0x00 0x8000000>;
		ta-elf-size = <0x00 0x1000000>;
		ta-stack-heap-size = <0x00 0x6000000>;
		sdsp-tee-sharedmem-size = <0x00 0x1000000>;
		sdsp-firmware-size = <0x00 0x1000000>;
		phandle = <0xd4>;
	};

	radio_md_cfg {
		compatible = "mediatek,radio_md_cfg";
		phandle = <0xd5>;
	};

	mt_charger {
		compatible = "mediatek,mt-charger";
		phandle = <0xd6>;
	};

	lk_charger {
		compatible = "mediatek,lk_charger";
		enable_anime;
		enable_pd20_reset;
		power_path_support;
		max_charger_voltage = <0xe4e1c0>;
		fast_charge_voltage = <0x2dc6c0>;
		usb_charger_current = <0x7a120>;
		ac_charger_current = <0x1f47d0>;
		ac_charger_input_current = <0x30d400>;
		non_std_ac_charger_current = <0x7a120>;
		charging_host_charger_current = <0x16e360>;
		ta_ac_charger_current = <0x2dc6c0>;
		pd_charger_current = <0x7a120>;
		temp_t4_threshold = <0x32>;
		temp_t3_threshold = <0x2d>;
		temp_t1_threshold = <0x00>;
		phandle = <0xd7>;
	};

	charger {
		compatible = "mediatek,charger";
		algorithm_name = "SwitchCharging";
		enable_type_c;
		power_path_support;
		enable_dynamic_mivr;
		disable_pd_dual;
		battery_cv = <0x426030>;
		max_charger_voltage = <0xe4e1c0>;
		min_charger_voltage = <0x4630c0>;
		min_charger_voltage_1 = <0x432380>;
		min_charger_voltage_2 = <0x401640>;
		max_dmivr_charger_current = <0x155cc0>;
		usb_charger_current_suspend = <0x00>;
		usb_charger_current_unconfigured = <0x11170>;
		usb_charger_current_configured = <0x7a120>;
		usb_charger_current = <0x7a120>;
		ac_charger_current = <0x1f47d0>;
		ac_charger_input_current = <0x30d400>;
		non_std_ac_charger_current = <0x7a120>;
		charging_host_charger_current = <0x16e360>;
		apple_1_0a_charger_current = <0x9eb10>;
		apple_2_1a_charger_current = "", "\f5";
		ta_ac_charger_current = <0x2dc6c0>;
		jeita_temp_above_t4_cv = <0x40b280>;
		jeita_temp_t3_to_t4_cv = <0x40b280>;
		jeita_temp_t2_to_t3_cv = <0x423920>;
		jeita_temp_t1_to_t2_cv = <0x40b280>;
		jeita_temp_t0_to_t1_cv = <0x3da540>;
		jeita_temp_below_t0_cv = <0x3da540>;
		temp_t4_thres = <0x32>;
		temp_t4_thres_minus_x_degree = <0x2f>;
		temp_t3_thres = <0x2d>;
		temp_t3_thres_minus_x_degree = <0x27>;
		temp_t2_thres = <0x0a>;
		temp_t2_thres_plus_x_degree = <0x10>;
		temp_t1_thres = <0x00>;
		temp_t1_thres_plus_x_degree = <0x06>;
		temp_t0_thres = <0x00>;
		temp_t0_thres_plus_x_degree = <0x00>;
		temp_neg_10_thres = <0x00>;
		enable_min_charge_temp;
		min_charge_temp = <0x00>;
		min_charge_temp_plus_x_degree = <0x06>;
		max_charge_temp = <0x32>;
		max_charge_temp_minus_x_degree = <0x2f>;
		pe_ichg_level_threshold = <0xf4240>;
		ta_ac_12v_input_current = <0x30d400>;
		ta_ac_9v_input_current = <0x30d400>;
		ta_ac_7v_input_current = <0x30d400>;
		pe20_ichg_level_threshold = <0xf4240>;
		ta_start_battery_soc = <0x00>;
		ta_stop_battery_soc = <0x55>;
		high_temp_to_leave_pe40 = <0x2e>;
		high_temp_to_enter_pe40 = <0x27>;
		low_temp_to_leave_pe40 = <0x0a>;
		low_temp_to_enter_pe40 = <0x10>;
		pe40_single_charger_input_current = <0x2dc6c0>;
		pe40_single_charger_current = <0x2dc6c0>;
		pe40_dual_charger_input_current = <0x2dc6c0>;
		pe40_dual_charger_chg1_current = <0x1e8480>;
		pe40_dual_charger_chg2_current = <0x1e8480>;
		pe40_stop_battery_soc = <0x50>;
		pe40_r_cable_1a_lower = <0x206>;
		pe40_r_cable_2a_lower = <0x17f>;
		pe40_r_cable_3a_lower = <0xf5>;
		chg1_ta_ac_charger_current = <0x16e360>;
		chg2_ta_ac_charger_current = <0x16e360>;
		slave_mivr_diff = <0x186a0>;
		dual_polling_ieoc = <0x6ddd0>;
		cable_imp_threshold = <0x2bb>;
		vbat_cable_imp_threshold = <0x3b8260>;
		bif_threshold1 = <0x40d990>;
		bif_threshold2 = <0x419ce0>;
		bif_cv_under_threshold2 = <0x43e6d0>;
		pd_vbus_low_bound = <0x4c4b40>;
		pd_vbus_upper_bound = <0x4c4b40>;
		pd_ichg_level_threshold = <0xf4240>;
		pd_stop_battery_soc = <0x50>;
		ibus_err = <0x0e>;
		vsys_watt = <0x4c4b40>;
		phandle = <0xd8>;
	};

	pd_adapter {
		compatible = "mediatek,pd_adapter";
		adapter_name = "pd_adapter";
		phandle = <0xd9>;
	};

	rt9465_slave_chr {
		compatible = "richtek,rt9465";
		phandle = <0xda>;
	};

	rt-pd-manager {
		compatible = "mediatek,rt-pd-manager";
	};

	mt6370_pmu_eint {
		phandle = <0xdb>;
	};

	tcpc_pd_eint {
		phandle = <0xdc>;
	};

	irtx_pwm {
		compatible = "mediatek,irtx-pwm";
		pwm_ch = <0x00>;
		pwm_data_invert = <0x00>;
		phandle = <0xdd>;
	};

	pmic_clock_buffer_ctrl {
		compatible = "mediatek,pmic_clock_buffer";
		mediatek,clkbuf-quantity = <0x07>;
		mediatek,clkbuf-config = <0x02 0x01 0x01 0x02 0x00 0x00 0x00>;
		mediatek,clkbuf-driving-current = <0x01 0x01 0x01 0x01 0x01 0x01 0x01>;
		phandle = <0xde>;
	};

	touch {
		compatible = "mediatek,touch";
		phandle = <0xdf>;
	};

	xiaomi_touch {
		compatible = "xiaomi-touch";
		status = "ok";
		touch,name = "xiaomi-touch";
	};

	irq_nfc {
		compatible = "mediatek,irq_nfc-eint";
		phandle = <0xe0>;
	};

	smart_pa {
		phandle = <0xe1>;
	};

	board_id {
		compatible = "mediatek,board_id";
		phandle = <0xe2>;
	};

	blk_thermal {
		compatible = "mediatek,blk_thermal_ntc";
		io-channels = <0x23 0x04>;
		io-channel-names = "blk_thermal-channel";
		status = "okay";
		phandle = <0xe3>;
	};

	gpio {
		compatible = "mediatek,gpio_usage_mapping";
		phandle = <0xe4>;
	};

	md1_sim1_hot_plug_eint {
		phandle = <0xe5>;
	};

	md1_sim2_hot_plug_eint {
		phandle = <0xe6>;
	};

	mt6370_pmu_dts {
		interrupt-controller;
		#interrupt-cells = <0x01>;
		mt6370,intr_gpio_num = <0x03>;
		mt6370,intr_gpio = <0x1e 0x03 0x00>;
		phandle = <0xe7>;

		core {
			compatible = "mediatek,mt6370_pmu_core";
			interrupt-names = "otp", "vdda_ovp", "vdda_uv";
			i2cstmr_rst_tmr = <0x00>;
			mrstb_en;
			mrstb_tmr = <0x03>;
			int_wdt = <0x00>;
			int_deg = <0x00>;
		};

		charger {
			compatible = "mediatek,mt6370_pmu_charger";
			interrupt-names = "chg_mivr", "chg_aiclmeasi", "attachi", "ovpctrl_uvp_d_evt", "chg_wdtmri", "chg_vbusov", "chg_tmri", "chg_treg", "dcdti";
			charger_name = "primary_chg";
			load_switch_name = "primary_load_switch";
			ichg = <0x1e8480>;
			aicr = <0x7a120>;
			mivr = <0x432380>;
			cv = <0x426030>;
			ieoc = <0x249f0>;
			safety_timer = <0x0c>;
			dc_wdt = "", "=\t";
			ircmp_resistor = <0x61a8>;
			ircmp_vclamp = <0x7d00>;
			enable_te;
			enable_wdt;
			lbp_hys_sel = <0x01>;
			lbp_dt = <0x01>;
		};

		mt6370_pmu_fled1 {
			compatible = "mediatek,mt6370_pmu_fled1";
			interrupt-names = "fled_lvf", "fled2_short", "fled1_short";
			fled_enable = <0x01>;
			torch_cur = <0x493e0>;
			strobe_cur = <0x124f80>;
			strobe_timeout = <0x960>;
		};

		mt6370_pmu_fled2 {
			compatible = "mediatek,mt6370_pmu_fled2";
			fled_enable = <0x01>;
			torch_cur = <0x30d40>;
			strobe_cur = <0xf4240>;
			strobe_timeout = <0x4b0>;
		};

		ldo {
			compatible = "mediatek,mt6370_pmu_ldo";
			interrupt-names = "ldo_oc";
			ldo_oms = <0x01>;
			ldo_vrc_lt = <0x01>;

			mt6370_ldo {
				regulator-name = "irtx_ldo";
				regulator-min-microvolt = <0x186a00>;
				regulator-max-microvolt = "", "=\t";
			};
		};

		rgbled {
			compatible = "mediatek,mt6370_pmu_rgbled";
			interrupt-names = "isink4_short", "isink3_short", "isink2_short", "isink1_short", "isink4_open", "isink3_open", "isink2_open", "isink1_open";
			mt,led_name = "mt6370_pmu_led1", "mt6370_pmu_led2", "mt6370_pmu_led3", "mt6370_pmu_led4";
			mt,led_default_trigger = "cc_mode", "cc_mode", "cc_mode", "none";
		};

		bled {
			compatible = "mediatek,mt6370_pmu_bled";
			interrupt-names = "bled_ocp";
			mt,bled_name = "mt6370_pmu_bled";
			mt,chan_en = <0x0f>;
			mt,map_linear;
			mt,bl_ovp_level = <0x03>;
			mt,bl_ocp_level = <0x02>;
			mt,use_pwm;
			mt,pwm_fsample = <0x02>;
			mt,pwm_deglitch = <0x01>;
			mt,pwm_hys_en = <0x01>;
			mt,pwm_hys = <0x00>;
			mt,pwm_avg_cycle = <0x00>;
			mt,bled_ramptime = <0x03>;
			mt,bled_flash_ramp = <0x01>;
			mt,max_bled_brightness = <0x200>;
			mt,bled_curr_scale = <0x00>;
			mt,pwm_lpf_coef = <0x00>;
		};

		dsv {
			compatible = "mediatek,mt6370_pmu_dsv";
			interrupt-names = "dsv_vneg_ocp", "dsv_vpos_ocp", "dsv_bst_ocp", "dsv_vneg_scp", "dsv_vpos_scp";
			db_ext_en = <0x00>;
			db_periodic_fix = <0x00>;
			db_single_pin = <0x00>;
			db_freq_pm = <0x00>;
			db_periodic_mode = <0x00>;
			db_startup = <0x00>;
			db_vneg_20ms = <0x01>;
			db_vneg_disc = <0x00>;
			db_vpos_20ms = <0x01>;
			db_vpos_disc = <0x01>;
			db_delay = <0x03>;
			db_vbst = <0x1644>;
			db_vpos_slew = <0x01>;
			db_vneg_slew = <0x01>;

			mt6370_dsvp {
				regulator-name = "dsv_pos";
				regulator-min-microvolt = "", "=\t";
				regulator-max-microvolt = <0x5b8d80>;
			};

			mt6370_dsvn {
				regulator-name = "dsv_neg";
				regulator-min-microvolt = "", "=\t";
				regulator-max-microvolt = <0x5b8d80>;
			};
		};
	};

	type_c_port0 {
		tcpc-dual,supported_modes = <0x00>;
		mt-tcpc,name = "type_c_port0";
		mt-tcpc,role_def = <0x04>;
		mt-tcpc,rp_level = <0x01>;
		mt-tcpc,vconn_supply = <0x01>;
		mt-tcpc,notifier_supply_num = <0x03>;
		mt6370pd,intr_gpio = <0x1e 0x18 0x00>;
		mt6370pd,intr_gpio_num = <0x18>;
		phandle = <0xe8>;

		pd-data {
			pd,vid = <0x29cf>;
			pd,pid = <0x5081>;
			pd,source-cap-ext = <0x508129cf 0x00 0x00 0x00 0x00 0x7000000>;
			pd,mfrs = "RichtekTCPC";
			pd,charging_policy = <0x31>;
			pd,source-pdo-size = <0x01>;
			pd,source-pdo-data = <0x19096>;
			pd,sink-pdo-size = <0x01>;
			pd,sink-pdo-data = <0x190c8>;
			pd,id-vdo-size = <0x03>;
			pd,id-vdo-data = <0xd10029cf 0x00 0x50810000>;
			bat,nr = <0x01>;
			pd,country_nr = <0x00>;

			bat-info0 {
				bat,vid = <0x29cf>;
				bat,pid = <0x5081>;
				bat,mfrs = "bat1";
				bat,design_cap = <0xbb8>;
			};
		};

		dpm_caps {
			local_dr_power;
			local_dr_data;
			local_usb_comm;
			local_no_suspend;
			local_vconn_supply;
			attemp_enter_dp_mode;
			attemp_discover_cable;
			attemp_discover_id;
			pr_check = <0x00>;
			dr_check = <0x00>;
		};

		displayport {
			1st_connection = "dfp_d";
			2nd_connection = "dfp_d";
			signal,dp_v13;
			usbr20_not_used;
			typec,receptacle;

			ufp_d {
			};

			dfp_d {
				pin_assignment,mode_c;
				pin_assignment,mode_d;
				pin_assignment,mode_e;
				pin_assignment,mode_f;
			};
		};
	};

	__symbols__ {
		chosen = "/chosen";
		cpu0 = "/cpus/cpu@000";
		cpu1 = "/cpus/cpu@001";
		cpu2 = "/cpus/cpu@002";
		cpu3 = "/cpus/cpu@003";
		cpu4 = "/cpus/cpu@100";
		cpu5 = "/cpus/cpu@101";
		cpu6 = "/cpus/cpu@102";
		cpu7 = "/cpus/cpu@103";
		doe_dvfs_cl0 = "/cpus/cpu-map/cluster0/doe";
		doe_dvfs_cl1 = "/cpus/cpu-map/cluster1/doe";
		STANDBY = "/cpus/idle-states/standby";
		MCDI_CPU = "/cpus/idle-states/mcdi-cpu";
		MCDI_CLUSTER = "/cpus/idle-states/mcdi-cluster";
		idledram = "/cpus/idle-states/idledram";
		idlesyspll = "/cpus/idle-states/idlesyspll";
		idlebus26m = "/cpus/idle-states/idlebus26m";
		SUSPEND = "/cpus/idle-states/suspend";
		reserved_memory = "/reserved-memory";
		wifi_mem = "/reserved-memory/wifi-reserve-memory";
		cpu_dbgapb = "/cpu_dbgapb@0e010000";
		gic = "/interrupt-controller";
		sysirq = "/intpol-controller@0";
		timer = "/timer";
		infracfg_ao = "/infracfg_ao@10001000";
		scpsys = "/scpsys@10001000";
		mcdi = "/mcdi@0010fc00";
		topckgen = "/topckgen@10000000";
		io_cfg_lt = "/io_cfg_lt@10002000";
		io_cfg_lm = "/io_cfg_lm@10002200";
		io_cfg_lb = "/io_cfg_lb@10002400";
		io_cfg_bl = "/io_cfg_bl@10002600";
		io_cfg_rm = "/io_cfg_rm@10002800";
		io_cfg_rb = "/io_cfg_rb@10002a00";
		io_cfg_rt = "/io_cfg_rt@10002c00";
		io_cfg_tl = "/io_cfg_tl@10002e00";
		pericfg = "/pericfg@10003000";
		gpio = "/gpio@10005000";
		pio = "/pinctrl";
		aud_clk_mosi_off = "/pinctrl/aud_clk_mosi_off";
		aud_clk_mosi_on = "/pinctrl/aud_clk_mosi_on";
		aud_clk_miso_off = "/pinctrl/aud_clk_miso_off";
		aud_clk_miso_on = "/pinctrl/aud_clk_miso_on";
		aud_dat_mosi_off = "/pinctrl/aud_dat_mosi_off";
		aud_dat_mosi_on = "/pinctrl/aud_dat_mosi_on";
		aud_dat_miso_off = "/pinctrl/aud_dat_miso_off";
		aud_dat_miso_on = "/pinctrl/aud_dat_miso_on";
		aud_gpio_i2s0_off = "/pinctrl/aud_gpio_i2s0_off";
		aud_gpio_i2s0_on = "/pinctrl/aud_gpio_i2s0_on";
		aud_gpio_i2s1_off = "/pinctrl/aud_gpio_i2s1_off";
		aud_gpio_i2s1_on = "/pinctrl/aud_gpio_i2s1_on";
		aud_gpio_i2s2_off = "/pinctrl/aud_gpio_i2s2_off";
		aud_gpio_i2s2_on = "/pinctrl/aud_gpio_i2s2_on";
		aud_gpio_i2s3_off = "/pinctrl/aud_gpio_i2s3_off";
		aud_gpio_i2s3_on = "/pinctrl/aud_gpio_i2s3_on";
		vow_dat_miso_off = "/pinctrl/vow_dat_miso_off";
		vow_dat_miso_on = "/pinctrl/vow_dat_miso_on";
		vow_clk_miso_off = "/pinctrl/vow_clk_miso_off";
		vow_clk_miso_on = "/pinctrl/vow_clk_miso_on";
		reverse_high = "/pinctrl/reverse_high";
		reverse_low = "/pinctrl/reverse_low";
		msdc0_pins_default = "/pinctrl/msdc0@default";
		msdc0_pins_hs400 = "/pinctrl/msdc0@hs400";
		msdc0_pins_hs200 = "/pinctrl/msdc0@hs200";
		msdc0_register_setting_default = "/pinctrl/msdc0@register_default";
		msdc1_pins_default = "/pinctrl/msdc1@default";
		msdc1_pins_sdr104 = "/pinctrl/msdc1@sdr104";
		msdc1_pins_sdr50 = "/pinctrl/msdc1@sdr50";
		msdc1_pins_ddr50 = "/pinctrl/msdc1@ddr50";
		msdc1_register_setting_default = "/pinctrl/msdc1@register_default";
		sleep = "/sleep@10006000";
		toprgu = "/toprgu@10007000";
		clk26m = "/clocks/clk26m";
		clk32k = "/clocks/clk32k";
		dcm = "/dcm";
		eint = "/apirq@1000b000";
		apmixed = "/apmixed@1000c000";
		pwrap = "/pwrap@1000d000";
		main_pmic = "/pwrap@1000d000/mt6358-pmic";
		pmic = "/pwrap@1000d000/mt6358-pmic/mt-pmic";
		pmic_auxadc = "/pwrap@1000d000/mt6358-pmic/mt635x-auxadc";
		mt6358regulator = "/pwrap@1000d000/mt6358-pmic/mt6358regulator";
		mt_pmic_vdram1_buck_reg = "/pwrap@1000d000/mt6358-pmic/mt6358regulator/buck_vdram1";
		mt_pmic_vcore_buck_reg = "/pwrap@1000d000/mt6358-pmic/mt6358regulator/buck_vcore";
		mt_pmic_vpa_buck_reg = "/pwrap@1000d000/mt6358-pmic/mt6358regulator/buck_vpa";
		mt_pmic_vproc11_buck_reg = "/pwrap@1000d000/mt6358-pmic/mt6358regulator/buck_vproc11";
		mt_pmic_vproc12_buck_reg = "/pwrap@1000d000/mt6358-pmic/mt6358regulator/buck_vproc12";
		mt_pmic_vgpu_buck_reg = "/pwrap@1000d000/mt6358-pmic/mt6358regulator/buck_vgpu";
		mt_pmic_vs2_buck_reg = "/pwrap@1000d000/mt6358-pmic/mt6358regulator/buck_vs2";
		mt_pmic_vmodem_buck_reg = "/pwrap@1000d000/mt6358-pmic/mt6358regulator/buck_vmodem";
		mt_pmic_vs1_buck_reg = "/pwrap@1000d000/mt6358-pmic/mt6358regulator/buck_vs1";
		mt_pmic_vdram2_ldo_reg = "/pwrap@1000d000/mt6358-pmic/mt6358regulator/ldo_vdram2";
		mt_pmic_vsim1_ldo_reg = "/pwrap@1000d000/mt6358-pmic/mt6358regulator/ldo_vsim1";
		mt_pmic_vibr_ldo_reg = "/pwrap@1000d000/mt6358-pmic/mt6358regulator/ldo_vibr";
		mt_pmic_vrf12_ldo_reg = "/pwrap@1000d000/mt6358-pmic/mt6358regulator/ldo_vrf12";
		mt_pmic_vio18_ldo_reg = "/pwrap@1000d000/mt6358-pmic/mt6358regulator/ldo_vio18";
		mt_pmic_vusb_ldo_reg = "/pwrap@1000d000/mt6358-pmic/mt6358regulator/ldo_vusb";
		mt_pmic_vcamio_ldo_reg = "/pwrap@1000d000/mt6358-pmic/mt6358regulator/ldo_vcamio";
		mt_pmic_vcamd_ldo_reg = "/pwrap@1000d000/mt6358-pmic/mt6358regulator/ldo_vcamd";
		mt_pmic_vcn18_ldo_reg = "/pwrap@1000d000/mt6358-pmic/mt6358regulator/ldo_vcn18";
		mt_pmic_vfe28_ldo_reg = "/pwrap@1000d000/mt6358-pmic/mt6358regulator/ldo_vfe28";
		mt_pmic_vsram_proc11_ldo_reg = "/pwrap@1000d000/mt6358-pmic/mt6358regulator/ldo_vsram_proc11";
		mt_pmic_vcn28_ldo_reg = "/pwrap@1000d000/mt6358-pmic/mt6358regulator/ldo_vcn28";
		mt_pmic_vsram_others_ldo_reg = "/pwrap@1000d000/mt6358-pmic/mt6358regulator/ldo_vsram_others";
		mt_pmic_vsram_gpu_ldo_reg = "/pwrap@1000d000/mt6358-pmic/mt6358regulator/ldo_vsram_gpu";
		mt_pmic_vxo22_ldo_reg = "/pwrap@1000d000/mt6358-pmic/mt6358regulator/ldo_vxo22";
		mt_pmic_vefuse_ldo_reg = "/pwrap@1000d000/mt6358-pmic/mt6358regulator/ldo_vefuse";
		mt_pmic_vaux18_ldo_reg = "/pwrap@1000d000/mt6358-pmic/mt6358regulator/ldo_vaux18";
		mt_pmic_vmch_ldo_reg = "/pwrap@1000d000/mt6358-pmic/mt6358regulator/ldo_vmch";
		mt_pmic_vbif28_ldo_reg = "/pwrap@1000d000/mt6358-pmic/mt6358regulator/ldo_vbif28";
		mt_pmic_vsram_proc12_ldo_reg = "/pwrap@1000d000/mt6358-pmic/mt6358regulator/ldo_vsram_proc12";
		mt_pmic_vcama1_ldo_reg = "/pwrap@1000d000/mt6358-pmic/mt6358regulator/ldo_vcama1";
		mt_pmic_vemc_ldo_reg = "/pwrap@1000d000/mt6358-pmic/mt6358regulator/ldo_vemc";
		mt_pmic_vio28_ldo_reg = "/pwrap@1000d000/mt6358-pmic/mt6358regulator/ldo_vio28";
		mt_pmic_va12_ldo_reg = "/pwrap@1000d000/mt6358-pmic/mt6358regulator/ldo_va12";
		mt_pmic_vrf18_ldo_reg = "/pwrap@1000d000/mt6358-pmic/mt6358regulator/ldo_vrf18";
		mt_pmic_vcn33_bt_ldo_reg = "/pwrap@1000d000/mt6358-pmic/mt6358regulator/ldo_vcn33_bt";
		mt_pmic_vcn33_wifi_ldo_reg = "/pwrap@1000d000/mt6358-pmic/mt6358regulator/ldo_vcn33_wifi";
		mt_pmic_vcama2_ldo_reg = "/pwrap@1000d000/mt6358-pmic/mt6358regulator/ldo_vcama2";
		mt_pmic_vmc_ldo_reg = "/pwrap@1000d000/mt6358-pmic/mt6358regulator/ldo_vmc";
		mt_pmic_vldo28_ldo_reg = "/pwrap@1000d000/mt6358-pmic/mt6358regulator/ldo_vldo28";
		mt_pmic_vaud28_ldo_reg = "/pwrap@1000d000/mt6358-pmic/mt6358regulator/ldo_vaud28";
		mt_pmic_vsim2_ldo_reg = "/pwrap@1000d000/mt6358-pmic/mt6358regulator/ldo_vsim2";
		mt_pmic_va09_ldo_reg = "/pwrap@1000d000/mt6358-pmic/mt6358regulator/ldo_va09";
		mt6358_rtc = "/pwrap@1000d000/mt6358-pmic/mt6358_rtc";
		mt6358_misc = "/pwrap@1000d000/mt6358-pmic/mt6358_misc";
		pwraph = "/pwraphal@";
		keypad = "/kp@10010000";
		mrdump_ext_rst = "/mrdump_ext_rst";
		dvfsrc = "/dvfsrc@10012000";
		mcucfg = "/mcucfg@0c530000";
		hwrng = "/hwrng";
		mdcldma = "/mdcldma@10014000";
		md_auxadc = "/md_auxadc";
		dvfsp = "/dvfsp@00110800";
		mt_cpufreq = "/mt_cpufreq";
		gce = "/gce@10238000";
		gce_mbox = "/gce_mbox@10238000";
		gce_mbox_svp = "/gce_mbox_svp@10238000";
		goodix_fp = "/fingerprint";
		accdet = "/accdet";
		swtp = "/swtp";
		bat_gm30 = "/battery";
		dfd_cache = "/dfd_cache";
		auxadc = "/auxadc@11001000";
		apdma = "/dma-controller@11000980";
		apuart0 = "/serial@11002000";
		apuart1 = "/serial@11003000";
		i2c_common = "/i2c_common";
		i2c0 = "/i2c0@11007000";
		i2c1 = "/i2c1@11008000";
		i2c2 = "/i2c2@11009000";
		i2c3 = "/i2c3@1100f000";
		i2c4 = "/i2c4@11011000";
		i2c5 = "/i2c5@11016000";
		i2c6 = "/i2c6@1100d000";
		i2c7 = "/i2c7@11004000";
		speaker_amp = "/i2c7@11004000/speaker_amp@34";
		i2c8 = "/i2c8@11005000";
		spi0 = "/spi0@1100a000";
		eem_fsm = "/eem_fsm@1100b000";
		tboard_thermistor1 = "/thermal-sensor1";
		tboard_thermistor2 = "/thermal-sensor2";
		drcc = "/drcc";
		consys = "/consys@18002000";
		spi1 = "/spi1@11010000";
		spi2 = "/spi2@11012000";
		spi3 = "/spi3@11013000";
		spi4 = "/spi4@11014000";
		spi5 = "/spi5@11015000";
		msdc0 = "/msdc@11230000";
		msdc1 = "/msdc@11240000";
		audio = "/audio@11220000";
		afe = "/mt6768-afe-pcm@11220000";
		mt6358_snd = "/mt6358_snd";
		sound = "/sound";
		snd_scp_spk = "/snd_scp_spk";
		mipi_rx_ana_csi0a = "/mipi_rx_ana_csi0a@11c10000";
		mipi_rx_ana_csi0b = "/mipi_rx_ana_csi0b@11c11000";
		mipi_rx_ana_csi1a = "/mipi_rx_ana_csi1a@11c12000";
		mipi_rx_ana_csi1b = "/mipi_rx_ana_csi1b@11c13000";
		mipi_rx_ana_csi2a = "/mipi_rx_ana_csi2a@11c14000";
		mipi_rx_ana_csi2b = "/mipi_rx_ana_csi2b@11c15000";
		mfg_cfg = "/mfg_cfg@13000000";
		mmsys_config = "/mmsys_config@14000000";
		disp_mutex0 = "/disp_mutex0@14001000";
		smi_larb0 = "/smi_larb0@14003000";
		mdp_rdma0 = "/mdp_rdma0@14004000";
		mdp_ccorr = "/mdp_ccorr0@14005000";
		mdp_rsz0 = "/mdp_rsz0@14006000";
		mdp_rsz1 = "/mdp_rsz1@14007000";
		mdp_wdma0 = "/mdp_wdma0@14008000";
		mdp_wrot0 = "/mdp_wrot0@14009000";
		mdp_tdshp0 = "/mdp_tdshp0@1400a000";
		disp_color0 = "/disp_color0@1400f000";
		mtkfb = "/mtkfb@0";
		dsi_te = "/dsi_te";
		imgsys = "/imgsys@15020000";
		smi_larb2 = "/smi_larb2@15021000";
		vcu = "/vcu@16000000";
		vdec_gcon = "/vdec_gcon@16000000";
		smi_larb1 = "/smi_larb1@16010000";
		venc_gcon = "/venc_gcon@17000000";
		smi_larb4 = "/smi_larb4@17010000";
		camsys = "/camsys@1a000000";
		smi_larb3 = "/smi_larb3@1a002000";
		kd_camera_hw1 = "/kd_camera_hw1@1a040000";
		flashlight_core = "/flashlight_core";
		flashlights_led191 = "/flashlights_led191";
		flashlights_mt6370 = "/flashlights_mt6370";
		odm = "/odm";
		memory_ssmr_features = "/memory-ssmr-features";
		radio_md_cfg = "/radio_md_cfg";
		mt_charger = "/mt_charger";
		lk_charger = "/lk_charger";
		charger = "/charger";
		pd_adapter = "/pd_adapter";
		rt9465_slave_chr = "/rt9465_slave_chr";
		subpmic_pmu_eint = "/mt6370_pmu_eint";
		tcpc_pd = "/tcpc_pd_eint";
		irtx_pwm = "/irtx_pwm";
		pmic_clock_buffer_ctrl = "/pmic_clock_buffer_ctrl";
		touch = "/touch";
		irq_nfc = "/irq_nfc";
		smart_pa = "/smart_pa";
		board_id = "/board_id";
		blk_thermal = "/blk_thermal";
		gpio_usage_mapping = "/gpio";
		md1_sim1_hot_plug_eint = "/md1_sim1_hot_plug_eint";
		md1_sim2_hot_plug_eint = "/md1_sim2_hot_plug_eint";
		mt6370_pmu = "/mt6370_pmu_dts";
		mt6370_typec = "/type_c_port0";
	};
};
